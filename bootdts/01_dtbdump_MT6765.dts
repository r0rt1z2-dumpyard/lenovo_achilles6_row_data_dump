/dts-v1/;

/ {
	#address-cells = <0x2>;
	#size-cells = <0x2>;
	compatible = "mediatek,MT6765";
	interrupt-parent = <0x1>;
	model = "MT6765";

	__symbols__ {
		DPIDLE = "/cpus/idle-states/dpidle";
		MCDI_CLUSTER = "/cpus/idle-states/mcdi-cluster";
		MCDI_CPU = "/cpus/idle-states/mcdi-cpu";
		SODI = "/cpus/idle-states/sodi";
		SODI3 = "/cpus/idle-states/sodi3";
		STANDBY = "/cpus/idle-states/standby";
		SUSPEND = "/cpus/idle-states/suspend";
		accdet = "/accdet";
		apdma = "/dma-controller@11000580";
		apmixed = "/apmixed@1000c000";
		audgpio = "/mt_soc_dl1_pcm@11220000";
		audio = "/audio@11220000";
		auxadc = "/auxadc@11001000";
		bat_gm30 = "/battery";
		btcvsd_snd = "/mtk-btcvsd-snd@18050000";
		camsys = "/camsys@1a000000";
		charger = "/charger";
		chosen = "/chosen";
		clk26m = "/clocks/clk26m";
		clk32k = "/clocks/clk32k";
		consys = "/consys@18002000";
		cpu0 = "/cpus/cpu@000";
		cpu1 = "/cpus/cpu@001";
		cpu2 = "/cpus/cpu@002";
		cpu3 = "/cpus/cpu@003";
		cpu4 = "/cpus/cpu@100";
		cpu5 = "/cpus/cpu@101";
		cpu6 = "/cpus/cpu@102";
		cpu7 = "/cpus/cpu@103";
		cpu_dbgapb = "/cpu_dbgapb@0d410000";
		disp_color0 = "/disp_color0@1400f000";
		disp_mutex0 = "/disp_mutex0@14001000";
		dsi_te = "/dsi_te";
		dynamic_options = "/dynamic_options";
		flashlight_core = "/flashlight_core";
		flashlights_mt6370 = "/flashlights_mt6370";
		gce = "/gce@10238000";
		gce_mbox = "/gce_mbox@10238000";
		gce_mbox_svp = "/gce_mbox_svp@10238000";
		gic = "/interrupt-controller@0c000000";
		goodix_fp = "/fingerprint";
		gpio = "/gpio@10005000";
		gpio_usage_mapping = "/gpio";
		i2c0 = "/i2c0@11007000";
		i2c1 = "/i2c1@11008000";
		i2c2 = "/i2c2@11009000";
		i2c3 = "/i2c3@1100f000";
		i2c4 = "/i2c4@11011000";
		i2c5 = "/i2c5@11016000";
		i2c6 = "/i2c6@1100d000";
		i2c7 = "/i2c7";
		i2c8 = "/i2c8";
		i2c9 = "/i2c9";
		i2c_common = "/i2c_common";
		imgsys = "/imgsys@15020000";
		infracfg_ao = "/infracfg_ao@10001000";
		iommu = "/m4u@10205000";
		irq_nfc = "/irq_nfc";
		irtx_pwm = "/irtx_pwm";
		kd_camera_hw1 = "/kd_camera_hw1@1a040000";
		keypad = "/kp@10010000";
		lk_charger = "/lk_charger";
		main_pmic = "/mt-pmic";
		md1_sim1_hot_plug_eint = "/md1_sim1_hot_plug_eint";
		md1_sim2_hot_plug_eint = "/md1_sim2_hot_plug_eint";
		mdcldma = "/mdcldma@10014000";
		mdp_ccorr = "/mdp_ccorr0@14005000";
		mdp_rdma0 = "/mdp_rdma0@14004000";
		mdp_rsz0 = "/mdp_rsz0@14006000";
		mdp_rsz1 = "/mdp_rsz1@14007000";
		mdp_tdshp0 = "/mdp_tdshp0@1400a000";
		mdp_wdma0 = "/mdp_wdma0@14008000";
		mdp_wrot0 = "/mdp_wrot0@14009000";
		mfg_cfg = "/mfg_cfg@13ffe000";
		mipi_rx_ana_csi0a = "/mipi_rx_ana_csi0a@11c10000";
		mipi_rx_ana_csi0b = "/mipi_rx_ana_csi0b@11c11000";
		mipi_rx_ana_csi1a = "/mipi_rx_ana_csi1a@11c12000";
		mipi_rx_ana_csi1b = "/mipi_rx_ana_csi1b@11c13000";
		mipi_rx_ana_csi2a = "/mipi_rx_ana_csi2a@11c14000";
		mipi_rx_ana_csi2b = "/mipi_rx_ana_csi2b@11c15000";
		mmsys_config = "/mmsys_config@14000000";
		mrdump_ext_rst = "/mrdump_ext_rst";
		msdc0 = "/msdc@11230000";
		msdc0_pins_default = "/pinctrl@1000b000/msdc0@default";
		msdc0_pins_hs200 = "/pinctrl@1000b000/msdc0@hs200";
		msdc0_pins_hs400 = "/pinctrl@1000b000/msdc0@hs400";
		msdc0_register_setting_default = "/pinctrl@1000b000/msdc0@register_default";
		msdc1 = "/msdc@11240000";
		msdc1_ins = "/msdc1_ins@0";
		msdc1_pins_ddr50 = "/pinctrl@1000b000/msdc1@ddr50";
		msdc1_pins_default = "/pinctrl@1000b000/msdc1@default";
		msdc1_pins_sdr104 = "/pinctrl@1000b000/msdc1@sdr104";
		msdc1_pins_sdr50 = "/pinctrl@1000b000/msdc1@sdr50";
		msdc1_register_setting_default = "/pinctrl@1000b000/msdc1@register_default";
		msdc2 = "/msdc@11250000";
		msdc3 = "/msdc@11260000";
		msdc3_pins_default = "/pinctrl@1000b000/msdc3@default";
		msdc3_register_setting_default = "/pinctrl@1000b000/msdc3@register_default";
		mt6370_pmu = "/mt6370_pmu_dts";
		mt6370_typec = "/type_c_port0";
		mt_charger = "/mt_charger";
		mt_pmic_vaud28_ldo_reg = "/mt-pmic/ldo_regulators/ldo_vaud28";
		mt_pmic_vaux18_ldo_reg = "/mt-pmic/ldo_regulators/ldo_vaux18";
		mt_pmic_vcama_ldo_reg = "/mt-pmic/ldo_regulators/ldo_vcama";
		mt_pmic_vcamd_ldo_reg = "/mt-pmic/ldo_regulators/ldo_vcamd";
		mt_pmic_vcamio_ldo_reg = "/mt-pmic/ldo_regulators/ldo_vcamio";
		mt_pmic_vcn18_ldo_reg = "/mt-pmic/ldo_regulators/ldo_vcn18";
		mt_pmic_vcn28_ldo_reg = "/mt-pmic/ldo_regulators/ldo_vcn28";
		mt_pmic_vcn33_bt_ldo_reg = "/mt-pmic/ldo_regulators/ldo_vcn33_bt";
		mt_pmic_vcn33_wifi_ldo_reg = "/mt-pmic/ldo_regulators/ldo_vcn33_wifi";
		mt_pmic_vcore_buck_reg = "/mt-pmic/buck_regulators/buck_vcore";
		mt_pmic_vdram_ldo_reg = "/mt-pmic/ldo_regulators/ldo_vdram";
		mt_pmic_vefuse_ldo_reg = "/mt-pmic/ldo_regulators/ldo_vefuse";
		mt_pmic_vemc_ldo_reg = "/mt-pmic/ldo_regulators/ldo_vemc";
		mt_pmic_vfe28_ldo_reg = "/mt-pmic/ldo_regulators/ldo_vfe28";
		mt_pmic_vibr_ldo_reg = "/mt-pmic/ldo_regulators/ldo_vibr";
		mt_pmic_vio18_ldo_reg = "/mt-pmic/ldo_regulators/ldo_vio18";
		mt_pmic_vio28_ldo_reg = "/mt-pmic/ldo_regulators/ldo_vio28";
		mt_pmic_vldo28_ldo_reg = "/mt-pmic/ldo_regulators/ldo_vldo28";
		mt_pmic_vmc_ldo_reg = "/mt-pmic/ldo_regulators/ldo_vmc";
		mt_pmic_vmch_ldo_reg = "/mt-pmic/ldo_regulators/ldo_vmch";
		mt_pmic_vmodem_buck_reg = "/mt-pmic/buck_regulators/buck_vmodem";
		mt_pmic_vpa_buck_reg = "/mt-pmic/buck_regulators/buck_vpa";
		mt_pmic_vproc_buck_reg = "/mt-pmic/buck_regulators/buck_vproc";
		mt_pmic_vrf12_ldo_reg = "/mt-pmic/ldo_regulators/ldo_vrf12";
		mt_pmic_vrf18_ldo_reg = "/mt-pmic/ldo_regulators/ldo_vrf18";
		mt_pmic_vs1_buck_reg = "/mt-pmic/buck_regulators/buck_vs1";
		mt_pmic_vsim1_ldo_reg = "/mt-pmic/ldo_regulators/ldo_vsim1";
		mt_pmic_vsim2_ldo_reg = "/mt-pmic/ldo_regulators/ldo_vsim2";
		mt_pmic_vsram_others_ldo_reg = "/mt-pmic/ldo_regulators/ldo_vsram_others";
		mt_pmic_vsram_proc_ldo_reg = "/mt-pmic/ldo_regulators/ldo_vsram_proc";
		mt_pmic_vusb33_ldo_reg = "/mt-pmic/ldo_regulators/ldo_vusb33";
		mt_pmic_vxo22_ldo_reg = "/mt-pmic/ldo_regulators/ldo_vxo22";
		mtkfb = "/mtkfb@0";
		nfc = "/nfc";
		odm = "/odm";
		otg_iddig = "/otg_iddig";
		pd_adapter = "/pd_adapter";
		pericfg = "/pericfg@10003000";
		pio = "/pinctrl@1000b000";
		pmic_auxadc = "/mt-pmic/mt635x-auxadc";
		pmic_clock_buffer_ctrl = "/pmic_clock_buffer_ctrl";
		pwm = "/pwm@11006000";
		radio_md_cfg = "/radio_md_cfg";
		reserved_memory = "/reserved-memory";
		rt9465_slave_chr = "/rt9465_slave_chr";
		scpsys = "/scpsys@10001000";
		smart_pa = "/smart_pa";
		smi_larb0 = "/smi_larb0@14003000";
		smi_larb1 = "/smi_larb1@17010000";
		smi_larb2 = "/smi_larb2@15021000";
		smi_larb3 = "/smi_larb3@1a002000";
		soc = "/soc";
		spi0 = "/spi@1100a000";
		spi1 = "/spi@11010000";
		spi2 = "/spi@11012000";
		spi3 = "/spi@11013000";
		spi4 = "/spi@11014000";
		spi5 = "/spi@11015000";
		subpmic_pmu_eint = "/mt6370_pmu_eint";
		swtp = "/swtp";
		syscfg_pctl_0 = "/syscfg_pctl_0@10005000";
		syscfg_pctl_1 = "/syscfg_pctl_1@0x10002000";
		syscfg_pctl_2 = "/syscfg_pctl_2@0x10002200";
		syscfg_pctl_3 = "/syscfg_pctl_3@0x10002400";
		syscfg_pctl_4 = "/syscfg_pctl_4@0x10002600";
		syscfg_pctl_5 = "/syscfg_pctl_5@0x10002800";
		syscfg_pctl_6 = "/syscfg_pctl_6@0x10002a00";
		syscfg_pctl_7 = "/syscfg_pctl_7@0x10002c00";
		sysirq = "/intpol-controller@10200a80";
		tcpc_pd = "/mt6370_pd_eint";
		topckgen = "/topckgen@10000000";
		touch = "/touch";
		uart0 = "/serial@11020000";
		uart1 = "/serial@11030000";
		venc_gcon = "/venc_gcon@17000000";
	};

	accdet {
		compatible = "mediatek,pmic-accdet";
		linux,phandle = <0x78>;
		phandle = <0x78>;
	};

	aes_top0@10016000 {
		compatible = "mediatek,aes_top0";
		reg = <0x0 0x10016000 0x0 0x1000>;
	};

	amms_control {
		compatible = "mediatek,amms";
		interrupts = <0x0 0x86 0x1>;
	};

	ap_ccif0@10209000 {
		compatible = "mediatek,ap_ccif0";
		interrupts = <0x0 0x94 0x8>;
		reg = <0x0 0x10209000 0x0 0x1000>;
	};

	ap_ccif1@1020b000 {
		compatible = "mediatek,ap_ccif1";
		interrupts = <0x0 0x96 0x8>;
		reg = <0x0 0x1020b000 0x0 0x1000>;
	};

	ap_ccif2@1023c000 {
		compatible = "mediatek,ap_ccif2";
		interrupts = <0x0 0x8f 0x8>;
		reg = <0x0 0x1023c000 0x0 0x1000>;
	};

	ap_ccif3@1023e000 {
		compatible = "mediatek,ap_ccif3";
		interrupts = <0x0 0x92 0x8>;
		reg = <0x0 0x1023e000 0x0 0x1000>;
	};

	ap_dma@11000000 {
		compatible = "mediatek,ap_dma";
		interrupts = <0x0 0x61 0x8>;
		reg = <0x0 0x11000000 0x0 0x1000>;
	};

	apcldmain@1021b000 {
		compatible = "mediatek,apcldmain";
		reg = <0x0 0x1021b000 0x0 0x0>;
	};

	apcldmain_ao@10014000 {
		compatible = "mediatek,apcldmain_ao";
		reg = <0x0 0x10014000 0x0 0x400>;
	};

	apcldmamisc@1021b800 {
		compatible = "mediatek,apcldmamisc";
		interrupts = <0x0 0xa5 0x4>;
		reg = <0x0 0x1021b800 0x0 0x0>;
	};

	apcldmamisc_ao@10014800 {
		compatible = "mediatek,apcldmamisc_ao";
		reg = <0x0 0x10014800 0x0 0x400>;
	};

	apcldmaout@1021b400 {
		compatible = "mediatek,apcldmaout";
		reg = <0x0 0x1021b400 0x0 0x0>;
	};

	apcldmaout_ao@10014400 {
		compatible = "mediatek,apcldmaout_ao";
		reg = <0x0 0x10014400 0x0 0x400>;
	};

	apmixed@1000c000 {
		#clock-cells = <0x1>;
		compatible = "mediatek,apmixed", "syscon";
		linux,phandle = <0x42>;
		phandle = <0x42>;
		reg = <0x0 0x1000c000 0x0 0x1000>;
	};

	apxgpt@10008000 {
		clocks = <0x1d>;
		compatible = "mediatek,apxgpt";
		interrupts = <0x0 0xaa 0x8>;
		reg = <0x0 0x10008000 0x0 0x1000>;
	};

	atf_logger {
		compatible = "mediatek,atf_logger";
		interrupts = <0x0 0xf7 0x1>;
	};

	audio@11220000 {
		#clock-cells = <0x1>;
		compatible = "mediatek,audio", "syscon";
		linux,phandle = <0x41>;
		mediatek,btcvsd_snd = <0x40>;
		phandle = <0x41>;
		reg = <0x0 0x11220000 0x0 0x1000>;
	};

	audio_snd_card {
		compatible = "mediatek,audio_snd_card";
	};

	audio_sram@11221000 {
		compatible = "mediatek,audio_sram";
		reg = <0x0 0x11221000 0x0 0x9000>;
	};

	auxadc@11001000 {
		clock-names = "auxadc-main";
		clocks = <0x24 0x21>;
		compatible = "mediatek,auxadc";
		interrupts = <0x0 0x4c 0x2>;
		linux,phandle = <0x7d>;
		phandle = <0x7d>;
		reg = <0x0 0x11001000 0x0 0x10000>;
	};

	battery {
		CAR_TUNE_VALUE = <0x64>;
		DIFFERENCE_FULLOCV_ITH = <0xc8>;
		EMBEDDED_SEL = <0x1>;
		FG_METER_RESISTANCE = <0x4b>;
		KEEP_100_PERCENT = <0x1>;
		PMIC_MIN_VOL = <0x82dc>;
		PMIC_SHUTDOWN_CURRENT = <0x14>;
		POWERON_SYSTEM_IBOOT = <0x1f4>;
		Q_MAX_SYS_VOLTAGE_BAT0 = <0xd16>;
		Q_MAX_SYS_VOLTAGE_BAT1 = <0xd16>;
		Q_MAX_SYS_VOLTAGE_BAT2 = <0xd16>;
		Q_MAX_SYS_VOLTAGE_BAT3 = <0xd16>;
		R_FG_VALUE = <0xa>;
		SHUTDOWN_1_TIME = <0x1e>;
		SHUTDOWN_GAUGE0_VOLTAGE = <0x84d0>;
		TEMPERATURE_T0 = <0x32>;
		TEMPERATURE_T1 = <0x19>;
		TEMPERATURE_T2 = <0xa>;
		TEMPERATURE_T3 = <0x0>;
		TEMPERATURE_T4 = <0xfffffff6>;
		battery0_profile_t0 = <0x0 0xab81 0x42e 0x203 0xaafb 0x42e 0x406 0xaa89 0x43d 0x609 0xaa1c 0x43c 0x80d 0xa9a9 0x42f 0xa10 0xa936 0x43d 0xc13 0xa8c3 0x43d 0xe16 0xa850 0x43d 0x1019 0xa7db 0x43d 0x121c 0xa762 0x43d 0x1420 0xa6ea 0x442 0x1623 0xa673 0x442 0x1826 0xa5f6 0x439 0x1a29 0xa57c 0x446 0x1c2c 0xa503 0x43d 0x1e2f 0xa48c 0x444 0x2032 0xa413 0x44c 0x2236 0xa397 0x44d 0x2439 0xa321 0x44d 0x263c 0xa2ae 0x44d 0x283f 0xa237 0x44d 0x2a42 0xa1c2 0x44d 0x2c45 0xa14f 0x44d 0x2e48 0xa0e0 0x457 0x304c 0xa06f 0x45c 0x324f 0xa001 0x45c 0x3452 0x9f94 0x45c 0x3655 0x9f2c 0x469 0x3858 0x9ebc 0x45e 0x3a5b 0x9e59 0x477 0x3c5f 0x9df4 0x47b 0x3e62 0x9d8d 0x46c 0x4065 0x9d33 0x48a 0x4268 0x9cc7 0x47b 0x446b 0x9c6e 0x48b 0x466e 0x9c14 0x49b 0x4871 0x9bbb 0x4aa 0x4a75 0x9b62 0x4ad 0x4c78 0x9b0f 0x4cb 0x4e7b 0x9abb 0x4de 0x507e 0x9a63 0x4fa 0x5281 0x9a0b 0x507 0x5484 0x999b 0x4fa 0x5688 0x990b 0x4bc 0x588b 0x987c 0x471 0x5a8e 0x980e 0x456 0x5c91 0x97b7 0x44c 0x5e94 0x976b 0x44c 0x6097 0x9729 0x446 0x629a 0x96e8 0x445 0x649e 0x96af 0x445 0x66a1 0x9675 0x43d 0x68a4 0x9640 0x446 0x6aa7 0x960c 0x44d 0x6caa 0x95d9 0x44d 0x6ead 0x95aa 0x44d 0x70b0 0x9579 0x44d 0x72b4 0x954f 0x44c 0x74b7 0x9529 0x458 0x76ba 0x94fe 0x450 0x78bd 0x94db 0x466 0x7ac0 0x94b1 0x45e 0x7cc3 0x948f 0x45c 0x7ec7 0x946f 0x46a 0x80ca 0x944f 0x46b 0x82cd 0x942f 0x46c 0x84d0 0x9409 0x46c 0x86d3 0x93ef 0x47b 0x88d6 0x93d5 0x48b 0x8ad9 0x93b5 0x499 0x8cdd 0x938b 0x483 0x8ee0 0x9343 0x44a 0x90e3 0x92f3 0x43d 0x92e6 0x92b8 0x43d 0x94e9 0x9292 0x441 0x96ec 0x9268 0x448 0x98f0 0x9237 0x43d 0x9af3 0x920a 0x43d 0x9cf6 0x91e0 0x43d 0x9ef9 0x91bc 0x43d 0xa0fc 0x919c 0x444 0xa2ff 0x9176 0x454 0xa502 0x9144 0x454 0xa706 0x9104 0x445 0xa909 0x90c4 0x446 0xab0c 0x9087 0x444 0xad0f 0x9040 0x447 0xaf12 0x8fef 0x439 0xb115 0x8fc6 0x438 0xb318 0x8fbb 0x448 0xb51c 0x8fb0 0x458 0xb71f 0x8fa3 0x468 0xb922 0x8f92 0x478 0xbb25 0x8f6f 0x494 0xbd28 0x8f05 0x48d 0xbf2b 0x8dc2 0x47d 0xc12f 0x8bda 0x497 0xc332 0x894a 0x4a9 0xc535 0x85b5 0x504 0xc738 0x7f92 0x5fe>;
		battery0_profile_t0_num = <0x64>;
		battery0_profile_t1 = <0x0 0xab43 0x55a 0x203 0xaac9 0x555 0x406 0xaa51 0x549 0x609 0xa9e3 0x573 0x80d 0xa970 0x571 0xa10 0xa8fc 0x564 0xc13 0xa884 0x562 0xe16 0xa810 0x567 0x1019 0xa79a 0x573 0x121c 0xa728 0x56b 0x1420 0xa6ac 0x55e 0x1623 0xa637 0x573 0x1826 0xa5bb 0x56e 0x1a29 0xa53e 0x563 0x1c2c 0xa4c4 0x563 0x1e2f 0xa44b 0x564 0x2032 0xa3d2 0x56b 0x2236 0xa352 0x55c 0x2439 0xa2d9 0x567 0x263c 0xa266 0x583 0x283f 0xa1ec 0x57a 0x2a42 0xa177 0x573 0x2c45 0xa108 0x57d 0x2e48 0xa097 0x582 0x304c 0xa031 0x5a5 0x324f 0x9fcd 0x5a6 0x3452 0x9f5d 0x595 0x3655 0x9ef4 0x585 0x3858 0x9e98 0x5aa 0x3a5b 0x9e2f 0x5bf 0x3c5f 0x9dc2 0x5c1 0x3e62 0x9d5b 0x5cf 0x4065 0x9cf5 0x5de 0x4268 0x9c8f 0x5f0 0x446b 0x9c35 0x600 0x466e 0x9bdd 0x61f 0x4871 0x9b90 0x63d 0x4a75 0x9b3c 0x63f 0x4c78 0x9ae9 0x65b 0x4e7b 0x9a8f 0x661 0x507e 0x9a33 0x676 0x5281 0x99c7 0x65c 0x5484 0x9942 0x615 0x5688 0x98b3 0x5b3 0x588b 0x9837 0x569 0x5a8e 0x97d5 0x549 0x5c91 0x9783 0x535 0x5e94 0x973d 0x52e 0x6097 0x96fd 0x525 0x629a 0x96c6 0x52d 0x649e 0x968c 0x51c 0x66a1 0x9653 0x517 0x68a4 0x9624 0x52e 0x6aa7 0x95f3 0x52b 0x6caa 0x95c4 0x52f 0x6ead 0x9597 0x534 0x70b0 0x956a 0x535 0x72b4 0x9542 0x53f 0x74b7 0x951c 0x551 0x76ba 0x94f6 0x555 0x78bd 0x94d0 0x555 0x7ac0 0x94af 0x555 0x7cc3 0x948f 0x562 0x7ec7 0x946f 0x574 0x80ca 0x9455 0x573 0x82cd 0x9435 0x573 0x84d0 0x941b 0x582 0x86d3 0x9401 0x591 0x88d6 0x93e8 0x591 0x8ad9 0x93ce 0x592 0x8cdd 0x93ad 0x582 0x8ee0 0x9386 0x56e 0x90e3 0x9360 0x555 0x92e6 0x933b 0x555 0x94e9 0x931a 0x555 0x96ec 0x92f4 0x551 0x98f0 0x92cc 0x545 0x9af3 0x92a1 0x544 0x9cf6 0x927b 0x541 0x9ef9 0x9259 0x53d 0xa0fc 0x923a 0x54c 0xa2ff 0x920e 0x555 0xa502 0x91d5 0x555 0xa706 0x9195 0x555 0xa909 0x9155 0x54b 0xab0c 0x9119 0x556 0xad0f 0x90d4 0x564 0xaf12 0x9080 0x54f 0xb115 0x9053 0x558 0xb318 0x9040 0x559 0xb51c 0x9037 0x578 0xb71f 0x902b 0x58e 0xb922 0x901a 0x5ab 0xbb25 0x8ff7 0x5e3 0xbd28 0x8fa1 0x616 0xbf2b 0x8e62 0x5e6 0xc12f 0x8c70 0x617 0xc332 0x89cd 0x674 0xc535 0x8606 0x71e 0xc738 0x7f34 0x945>;
		battery0_profile_t1_num = <0x64>;
		battery0_profile_t2 = <0x0 0xab1e 0x85c 0x203 0xaa85 0x85d 0x406 0xaa05 0x889 0x609 0xa986 0x87c 0x80d 0xa90e 0x88c 0xa10 0xa89a 0x899 0xc13 0xa81f 0x896 0xe16 0xa7a1 0x88d 0x1019 0xa727 0x899 0x121c 0xa6ae 0x899 0x1420 0xa633 0x899 0x1623 0xa5b5 0x899 0x1826 0xa53c 0x893 0x1a29 0xa4c2 0x88a 0x1c2c 0xa449 0x890 0x1e2f 0xa3d0 0x892 0x2032 0xa359 0x891 0x2236 0xa2e6 0x899 0x2439 0xa270 0x899 0x263c 0xa1fa 0x8a2 0x283f 0xa187 0x8a9 0x2a42 0xa114 0x8a9 0x2c45 0xa0a1 0x8b3 0x2e48 0xa032 0x8c3 0x304c 0x9fc6 0x8c8 0x324f 0x9f63 0x8df 0x3452 0x9efe 0x8f3 0x3655 0x9e98 0x903 0x3858 0x9e2c 0x906 0x3a5b 0x9dc0 0x913 0x3c5f 0x9d53 0x923 0x3e62 0x9ce6 0x933 0x4065 0x9c80 0x934 0x4268 0x9c1a 0x944 0x446b 0x9bc0 0x955 0x466e 0x9b6c 0x982 0x4871 0x9b0e 0x983 0x4a75 0x9aba 0x991 0x4c78 0x9a5e 0x98a 0x4e7b 0x99ef 0x957 0x507e 0x9973 0x914 0x5281 0x98ee 0x8c1 0x5484 0x9874 0x86e 0x5688 0x980b 0x842 0x588b 0x97af 0x822 0x5a8e 0x975e 0x80e 0x5c91 0x9716 0x80e 0x5e94 0x96d9 0x80e 0x6097 0x96a0 0x815 0x629a 0x9669 0x81d 0x649e 0x9636 0x81d 0x66a1 0x9603 0x826 0x68a4 0x95cc 0x81b 0x6aa7 0x959a 0x80e 0x6caa 0x9572 0x821 0x6ead 0x9547 0x82d 0x70b0 0x951f 0x837 0x72b4 0x94f8 0x83c 0x74b7 0x94d2 0x83c 0x76ba 0x94b1 0x848 0x78bd 0x9491 0x858 0x7ac0 0x9471 0x868 0x7cc3 0x9451 0x85d 0x7ec7 0x9436 0x869 0x80ca 0x9411 0x85c 0x82cd 0x93f7 0x85b 0x84d0 0x93e4 0x86b 0x86d3 0x93ca 0x87a 0x88d6 0x93b1 0x87b 0x8ad9 0x939e 0x889 0x8cdd 0x938b 0x88b 0x8ee0 0x9376 0x897 0x90e3 0x935d 0x88f 0x92e6 0x9342 0x8a5 0x94e9 0x9321 0x89d 0x96ec 0x92fa 0x8ad 0x98f0 0x92d4 0x8b8 0x9af3 0x92ae 0x8c3 0x9cf6 0x9287 0x8e3 0x9ef9 0x925a 0x902 0xa0fc 0x9220 0x91c 0xa2ff 0x91e4 0x93a 0xa502 0x91a4 0x96a 0xa706 0x9167 0x99a 0xa909 0x9124 0x9ca 0xab0c 0x90d0 0x9fa 0xad0f 0x9082 0xa29 0xaf12 0x9053 0xa6d 0xb115 0x903b 0xadc 0xb318 0x9024 0xb66 0xb51c 0x900a 0xc45 0xb71f 0x8fe7 0xd68 0xb922 0x8fa4 0xec8 0xbb25 0x8f0b 0x1084 0xbd28 0x8d97 0x122b 0xbf2b 0x8b54 0x1548 0xc12f 0x883b 0x1b2f 0xc332 0x8389 0x2928 0xc535 0x8340 0x2a06 0xc738 0x8340 0x2a06>;
		battery0_profile_t2_num = <0x64>;
		battery0_profile_t3 = <0x0 0xaa76 0xfa0 0x203 0xa96d 0xfa3 0x406 0xa8bb 0x102d 0x609 0xa81e 0x104e 0x80d 0xa797 0x1078 0xa10 0xa710 0x1074 0xc13 0xa686 0x105c 0xe16 0xa608 0x1073 0x1019 0xa58d 0x1097 0x121c 0xa50d 0x108f 0x1420 0xa48f 0x1078 0x1623 0xa416 0x107d 0x1826 0xa39c 0x1088 0x1a29 0xa323 0x1082 0x1c2c 0xa2ac 0x1078 0x1e2f 0xa239 0x1086 0x2032 0xa1c6 0x1088 0x2236 0xa153 0x1088 0x2439 0xa0e0 0x1086 0x263c 0xa06d 0x106f 0x283f 0xa002 0x107c 0x2a42 0x9f9b 0x109b 0x2c45 0x9f31 0x109c 0x2e48 0x9ec9 0x10ad 0x304c 0x9e5e 0x10b6 0x324f 0x9df2 0x10b6 0x3452 0x9d80 0x109e 0x3655 0x9d0d 0x1097 0x3858 0x9c9f 0x108a 0x3a5b 0x9c38 0x10b1 0x3c5f 0x9bd8 0x10b7 0x3e62 0x9b6c 0x10b6 0x4065 0x9b0c 0x10a7 0x4268 0x9ab2 0x10c6 0x446b 0x9a52 0x10c5 0x466e 0x99eb 0x10a3 0x4871 0x9979 0x1065 0x4a75 0x990c 0x1035 0x4c78 0x989f 0x1007 0x4e7b 0x9834 0xfe7 0x507e 0x97cf 0xfc1 0x5281 0x9774 0xf94 0x5484 0x9727 0xf9b 0x5688 0x96de 0xf9e 0x588b 0x969e 0xfb9 0x5a8e 0x9661 0xfc0 0x5c91 0x962a 0xfe9 0x5e94 0x95f4 0x1003 0x6097 0x95bd 0x1013 0x629a 0x958a 0x1023 0x649e 0x955d 0x1043 0x66a1 0x9530 0x1062 0x68a4 0x9504 0x107b 0x6aa7 0x94de 0x10a4 0x6caa 0x94b8 0x10ca 0x6ead 0x9491 0x10ea 0x70b0 0x9474 0x1115 0x72b4 0x9451 0x112e 0x74b7 0x9434 0x114a 0x76ba 0x941a 0x116a 0x78bd 0x9401 0x118a 0x7ac0 0x93f2 0x11b7 0x7cc3 0x93d5 0x11cb 0x7ec7 0x93c6 0x11f8 0x80ca 0x93b3 0x1253 0x82cd 0x93a6 0x1295 0x84d0 0x9393 0x12e4 0x86d3 0x9380 0x1344 0x88d6 0x936c 0x1393 0x8ad9 0x9352 0x13e5 0x8cdd 0x9332 0x1445 0x8ee0 0x9311 0x14a7 0x90e3 0x92ec 0x151f 0x92e6 0x92ca 0x15bf 0x94e9 0x929b 0x165e 0x96ec 0x9268 0x16fe 0x98f0 0x9233 0x17ac 0x9af3 0x91f8 0x1881 0x9cf6 0x91b6 0x1960 0x9ef9 0x916f 0x1a4c 0xa0fc 0x9126 0x1b59 0xa2ff 0x90dd 0x1c71 0xa502 0x9099 0x1db5 0xa706 0x905d 0x1f3d 0xa909 0x9023 0x20ee 0xab0c 0x8fed 0x22f3 0xad0f 0x8fbe 0x257f 0xaf12 0x8f85 0x28a7 0xb115 0x8f3d 0x2c62 0xb318 0x8ece 0x3086 0xb51c 0x8e0a 0x34db 0xb71f 0x8cb5 0x3968 0xb922 0x8a9a 0x40a6 0xbb25 0x87cf 0x3b77 0xbd28 0x874b 0x39f3 0xbf2b 0x874b 0x39f3 0xc12f 0x874b 0x39f3 0xc332 0x874b 0x39f3 0xc535 0x874b 0x39f3 0xc738 0x874b 0x39f3>;
		battery0_profile_t3_num = <0x64>;
		battery0_profile_t4 = <0x0 0xaa5e 0x191e 0x203 0xa951 0x192b 0x406 0xa83d 0x1a77 0x609 0xa70e 0x1baa 0x80d 0xa616 0x1d8d 0xa10 0xa555 0x1e91 0xc13 0xa4b8 0x1f46 0xe16 0xa426 0x1fb5 0x1019 0xa39a 0x1fec 0x121c 0xa30f 0x2023 0x1420 0xa289 0x2026 0x1623 0xa205 0x205b 0x1826 0xa185 0x2095 0x1a29 0xa105 0x20b9 0x1c2c 0xa088 0x20cf 0x1e2f 0xa00c 0x20f6 0x2032 0x9f8c 0x2110 0x2236 0x9f0f 0x2110 0x2439 0x9e8f 0x2120 0x263c 0x9e02 0x212f 0x283f 0x9d73 0x211c 0x2a42 0x9ce2 0x2106 0x2c45 0x9c4f 0x20ec 0x2e48 0x9bc1 0x20c1 0x304c 0x9b39 0x209c 0x324f 0x9abc 0x209f 0x3452 0x9a42 0x208b 0x3655 0x99ce 0x206b 0x3858 0x996b 0x2072 0x3a5b 0x9911 0x2074 0x3c5f 0x98bd 0x2083 0x3e62 0x9864 0x2093 0x4065 0x981d 0x20d0 0x4268 0x97d0 0x20c2 0x446b 0x978a 0x20e2 0x466e 0x974a 0x2111 0x4871 0x970a 0x2133 0x4a75 0x96c5 0x215f 0x4c78 0x968b 0x2174 0x4e7b 0x964d 0x21a7 0x507e 0x9618 0x21d9 0x5281 0x95e0 0x21f0 0x5484 0x95ad 0x223f 0x5688 0x957a 0x225f 0x588b 0x9549 0x227e 0x5a8e 0x951a 0x22a4 0x5c91 0x94ea 0x22c8 0x5e94 0x94bf 0x22f2 0x6097 0x9499 0x2326 0x629a 0x9473 0x2354 0x649e 0x944c 0x238b 0x66a1 0x9429 0x23c5 0x68a4 0x940a 0x2415 0x6aa7 0x93e6 0x2464 0x6caa 0x93c3 0x24be 0x6ead 0x939f 0x2528 0x70b0 0x9379 0x25a3 0x72b4 0x934e 0x2617 0x74b7 0x931d 0x267b 0x76ba 0x92ea 0x26f4 0x78bd 0x92b7 0x2780 0x7ac0 0x9284 0x281d 0x7cc3 0x924b 0x28cb 0x7ec7 0x920c 0x296c 0x80ca 0x91d2 0x2a29 0x82cd 0x9192 0x2ae9 0x84d0 0x9152 0x2bb8 0x86d3 0x9119 0x2ca9 0x88d6 0x90e0 0x2dd9 0x8ad9 0x90ac 0x2f0e 0x8cdd 0x906b 0x3077 0x8ee0 0x9023 0x31bc 0x90e3 0x8fc9 0x331e 0x92e6 0x8f49 0x348a 0x94e9 0x8e9f 0x35de 0x96ec 0x8da8 0x36f4 0x98f0 0x8c4f 0x37cd 0x9af3 0x8a76 0x38f5 0x9cf6 0x87c2 0x3b32 0x9ef9 0x8599 0x3d47 0xa0fc 0x8599 0x3d47 0xa2ff 0x8599 0x3d47 0xa502 0x8599 0x3d47 0xa706 0x8599 0x3d47 0xa909 0x8599 0x3d47 0xab0c 0x8599 0x3d47 0xad0f 0x8599 0x3d47 0xaf12 0x8599 0x3d47 0xb115 0x8599 0x3d47 0xb318 0x8599 0x3d47 0xb51c 0x8599 0x3d47 0xb71f 0x8599 0x3d47 0xb922 0x8599 0x3d47 0xbb25 0x8599 0x3d47 0xbd28 0x8599 0x3d47 0xbf2b 0x8599 0x3d47 0xc12f 0x8599 0x3d47 0xc332 0x8599 0x3d47 0xc535 0x8599 0x3d47 0xc738 0x8599 0x3d47>;
		battery0_profile_t4_num = <0x64>;
		battery1_profile_t0 = <0x0 0xaa7f 0x11c29 0x1fe 0xaa01 0x41d 0x3fc 0xa98c 0x422 0x5fa 0xa916 0x420 0x7f8 0xa8a3 0x427 0x9f6 0xa82b 0x422 0xbf4 0xa7b6 0x428 0xdf2 0xa741 0x42f 0xfef 0xa6c9 0x42e 0x11ed 0xa650 0x42d 0x13eb 0xa5d8 0x431 0x15e9 0xa560 0x431 0x17e7 0xa4e6 0x430 0x19e5 0xa46f 0x433 0x1be3 0xa3f8 0x431 0x1de1 0xa381 0x432 0x1fdf 0xa30c 0x435 0x21dd 0xa298 0x43b 0x23db 0xa226 0x43f 0x25d9 0xa1b5 0x442 0x27d7 0xa144 0x447 0x29d5 0xa0d5 0x448 0x2bd2 0xa068 0x44a 0x2dd0 0x9ffc 0x450 0x2fce 0x9f91 0x451 0x31cc 0x9f26 0x451 0x33ca 0x9ec0 0x455 0x35c8 0x9e5b 0x45a 0x37c6 0x9dfa 0x461 0x39c4 0x9d9a 0x468 0x3bc2 0x9d3b 0x46c 0x3dc0 0x9cdd 0x472 0x3fbe 0x9c81 0x479 0x41bc 0x9c28 0x480 0x43ba 0x9bd2 0x48a 0x45b8 0x9b7f 0x499 0x47b6 0x9b2b 0x4a0 0x49b3 0x9ad9 0x4a9 0x4bb1 0x9a89 0x4b9 0x4daf 0x9a36 0x4c3 0x4fad 0x99da 0x4c5 0x51ab 0x995e 0x4a3 0x53a9 0x98ca 0x465 0x55a7 0x984e 0x446 0x57a5 0x97eb 0x436 0x59a3 0x97a0 0x436 0x5ba1 0x975c 0x432 0x5d9f 0x9719 0x42a 0x5f9d 0x96dd 0x42e 0x619b 0x96a8 0x42f 0x6399 0x9670 0x42c 0x6596 0x9640 0x42f 0x6794 0x960e 0x434 0x6992 0x95de 0x437 0x6b90 0x95af 0x43b 0x6d8e 0x9581 0x439 0x6f8c 0x9558 0x43c 0x718a 0x9530 0x443 0x7388 0x9507 0x444 0x7586 0x94e2 0x44a 0x7784 0x94c0 0x453 0x7982 0x949d 0x457 0x7b80 0x947d 0x460 0x7d7e 0x945e 0x464 0x7f7c 0x9441 0x46b 0x817a 0x9424 0x472 0x8377 0x9407 0x477 0x8575 0x93ea 0x47a 0x8773 0x93c4 0x476 0x8971 0x9387 0x458 0x8b6f 0x9337 0x438 0x8d6d 0x92f4 0x438 0x8f6b 0x92c4 0x43f 0x9169 0x9298 0x442 0x9367 0x926a 0x442 0x9565 0x923a 0x43e 0x9763 0x920f 0x43e 0x9961 0x91e9 0x440 0x9b5f 0x91c4 0x443 0x9d5d 0x919f 0x44b 0x9f5a 0x916f 0x44e 0xa158 0x9132 0x447 0xa356 0x90f2 0x441 0xa554 0x90b7 0x445 0xa752 0x9077 0x44a 0xa950 0x9025 0x43b 0xab4e 0x8fea 0x427 0xad4c 0x8fd4 0x42f 0xaf4a 0x8fca 0x443 0xb148 0x8fc0 0x452 0xb346 0x8fb0 0x46b 0xb544 0x8f93 0x48e 0xb742 0x8f44 0x497 0xb940 0x8e3a 0x463 0xbb3e 0x8c87 0x465 0xbd3b 0x8a42 0x47d 0xbf39 0x8729 0x4a8 0xc137 0x8256 0x508 0xc335 0x76b0 0xc5cb 0xc533 0x76b0 0xc5cb>;
		battery1_profile_t0_num = <0x64>;
		battery1_profile_t1 = <0x0 0xab81 0x55a 0x1fe 0xaadd 0x419 0x3fc 0xaa68 0x433 0x5fa 0xa9f6 0x43d 0x7f8 0xa984 0x439 0x9f6 0xa912 0x441 0xbf4 0xa89d 0x43e 0xdf2 0xa827 0x442 0xfef 0xa7b0 0x444 0x11ed 0xa738 0x448 0x13eb 0xa6bf 0x447 0x15e9 0xa646 0x446 0x17e7 0xa5cc 0x445 0x19e5 0xa556 0x44f 0x1be3 0xa4db 0x451 0x1de1 0xa461 0x451 0x1fdf 0xa3eb 0x456 0x21dd 0xa375 0x455 0x23db 0xa301 0x45b 0x25d9 0xa28b 0x45c 0x27d7 0xa219 0x462 0x29d5 0xa1a7 0x464 0x2bd2 0xa137 0x46b 0x2dd0 0xa0c8 0x473 0x2fce 0xa05b 0x47b 0x31cc 0x9fef 0x47e 0x33ca 0x9f84 0x47e 0x35c8 0x9f1c 0x487 0x37c6 0x9eb8 0x490 0x39c4 0x9e52 0x495 0x3bc2 0x9dee 0x49b 0x3dc0 0x9d8e 0x4a9 0x3fbe 0x9d2f 0x4b5 0x41bc 0x9cd2 0x4bc 0x43ba 0x9c76 0x4c5 0x45b8 0x9c1f 0x4d4 0x47b6 0x9bca 0x4dc 0x49b3 0x9b74 0x4e8 0x4bb1 0x9b1f 0x4f4 0x4daf 0x9ac7 0x4ff 0x4fad 0x9a6a 0x4fa 0x51ab 0x99fb 0x4e2 0x53a9 0x9975 0x4ae 0x55a7 0x98e6 0x46b 0x57a5 0x9870 0x441 0x59a3 0x9812 0x42e 0x5ba1 0x97c5 0x429 0x5d9f 0x977f 0x424 0x5f9d 0x9740 0x424 0x619b 0x9707 0x422 0x6399 0x96ca 0x422 0x6596 0x9695 0x423 0x6794 0x9665 0x42d 0x6992 0x9630 0x423 0x6b90 0x9601 0x429 0x6d8e 0x95d7 0x42d 0x6f8c 0x95ac 0x42f 0x718a 0x9583 0x438 0x7388 0x955d 0x43a 0x7586 0x9537 0x442 0x7784 0x9512 0x443 0x7982 0x94f0 0x448 0x7b80 0x94cf 0x44b 0x7d7e 0x94ae 0x44c 0x7f7c 0x9491 0x458 0x817a 0x9473 0x45b 0x8377 0x945a 0x465 0x8575 0x943e 0x469 0x8773 0x9421 0x467 0x8971 0x9406 0x46a 0x8b6f 0x93e3 0x462 0x8d6d 0x93bc 0x454 0x8f6b 0x9393 0x445 0x9169 0x936b 0x440 0x9367 0x9342 0x43b 0x9565 0x9314 0x430 0x9763 0x92e8 0x42a 0x9961 0x92bf 0x428 0x9b5f 0x929d 0x42c 0x9d5d 0x927d 0x431 0x9f5a 0x9256 0x436 0xa158 0x9223 0x435 0xa356 0x91e4 0x430 0xa554 0x91a6 0x431 0xa752 0x916e 0x436 0xa950 0x912d 0x438 0xab4e 0x90d8 0x431 0xad4c 0x9096 0x425 0xaf4a 0x907c 0x42f 0xb148 0x906f 0x43f 0xb346 0x9062 0x44a 0xb544 0x9056 0x462 0xb742 0x903f 0x482 0xb940 0x900a 0x4a1 0xbb3e 0x8f3b 0x47f 0xbd3b 0x8d95 0x47b 0xbf39 0x8b57 0x4a2 0xc137 0x8844 0x4d1 0xc335 0x8393 0x551 0xc533 0x7b3e 0x495>;
		battery1_profile_t1_num = <0x64>;
		battery1_profile_t2 = <0x0 0xab14 0x60e 0x1fe 0xaa93 0x613 0x3fc 0xaa21 0x613 0x5fa 0xa9af 0x613 0x7f8 0xa93d 0x60d 0x9f6 0xa8cb 0x607 0xbf4 0xa856 0x603 0xdf2 0xa7e1 0x5ff 0xfef 0xa768 0x5fe 0x11ed 0xa6f0 0x5f8 0x13eb 0xa679 0x5f5 0x15e9 0xa600 0x5f4 0x17e7 0xa586 0x5f1 0x19e5 0xa50f 0x5f2 0x1be3 0xa494 0x5ed 0x1de1 0xa41d 0x5eb 0x1fdf 0xa3a8 0x5f1 0x21dd 0xa332 0x5f0 0x23db 0xa2bc 0x5ee 0x25d9 0xa24a 0x5f5 0x27d7 0xa1d7 0x5f8 0x29d5 0xa167 0x5fe 0x2bd2 0xa0f6 0x603 0x2dd0 0xa089 0x60b 0x2fce 0xa01b 0x60e 0x31cc 0x9fad 0x613 0x33ca 0x9f47 0x61e 0x35c8 0x9ee2 0x629 0x37c6 0x9e7e 0x63c 0x39c4 0x9e18 0x64a 0x3bc2 0x9db2 0x659 0x3dc0 0x9d4b 0x65e 0x3fbe 0x9ce7 0x65c 0x41bc 0x9c89 0x65c 0x43ba 0x9c2f 0x663 0x45b8 0x9bd9 0x66a 0x47b6 0x9b81 0x66f 0x49b3 0x9b29 0x675 0x4bb1 0x9acc 0x66e 0x4daf 0x9a6d 0x667 0x4fad 0x9a04 0x64d 0x51ab 0x9996 0x62a 0x53a9 0x991d 0x5f9 0x55a7 0x98a9 0x5c7 0x57a5 0x983d 0x59d 0x59a3 0x97e2 0x584 0x5ba1 0x9792 0x579 0x5d9f 0x9749 0x56a 0x5f9d 0x9706 0x564 0x619b 0x96ca 0x564 0x6399 0x9690 0x569 0x6596 0x965b 0x564 0x6794 0x9625 0x569 0x6992 0x95f6 0x56e 0x6b90 0x95c7 0x56f 0x6d8e 0x959a 0x578 0x6f8c 0x956e 0x579 0x718a 0x9546 0x57e 0x7388 0x951d 0x57f 0x7586 0x94fa 0x58c 0x7784 0x94d4 0x58e 0x7982 0x94b2 0x599 0x7b80 0x9492 0x59d 0x7d7e 0x9471 0x59f 0x7f7c 0x9454 0x5a8 0x817a 0x9438 0x5ad 0x8377 0x941d 0x5b4 0x8575 0x9406 0x5bc 0x8773 0x93ea 0x5bc 0x8971 0x93d2 0x5bc 0x8b6f 0x93bb 0x5bd 0x8d6d 0x93a4 0x5be 0x8f6b 0x938e 0x5be 0x9169 0x9378 0x5be 0x9367 0x935b 0x5bb 0x9565 0x933a 0x5b8 0x9763 0x9313 0x5b4 0x9961 0x92ea 0x5b2 0x9b5f 0x92c4 0x5b7 0x9d5d 0x92a0 0x5c0 0x9f5a 0x9278 0x5cf 0xa158 0x9247 0x5de 0xa356 0x920b 0x5eb 0xa554 0x91c9 0x5f6 0xa752 0x918c 0x604 0xa950 0x914f 0x61e 0xab4e 0x90fc 0x62e 0xad4c 0x90ac 0x63d 0xaf4a 0x907f 0x656 0xb148 0x9067 0x67f 0xb346 0x9055 0x6b7 0xb544 0x903a 0x6fa 0xb742 0x901e 0x772 0xb940 0x8fe7 0x810 0xbb3e 0x8f5a 0x8e0 0xbd3b 0x8deb 0x9ce 0xbf39 0x8bc1 0xbff 0xc137 0x88c7 0x111d 0xc335 0x846e 0x2369 0xc533 0x8434 0x2463>;
		battery1_profile_t2_num = <0x64>;
		battery1_profile_t3 = <0x0 0xab2a 0x974 0x1fe 0xaa9f 0x978 0x3fc 0xaa27 0x97d 0x5fa 0xa9b5 0x913 0x7f8 0xa943 0x944 0x9f6 0xa8ce 0x955 0xbf4 0xa856 0x99e 0xdf2 0xa7e3 0x92b 0xfef 0xa768 0x997 0x11ed 0xa6f0 0x98a 0x13eb 0xa679 0x90f 0x15e9 0xa603 0x8a0 0x17e7 0xa58a 0x898 0x19e5 0xa512 0x8a0 0x1be3 0xa49b 0x88f 0x1de1 0xa424 0x8d5 0x1fdf 0xa3ab 0x960 0x21dd 0xa337 0x948 0x23db 0xa2c4 0x8f3 0x25d9 0xa251 0x8e0 0x27d7 0xa1e1 0x89c 0x29d5 0xa173 0x862 0x2bd2 0xa104 0x85f 0x2dd0 0xa090 0x8d2 0x2fce 0xa022 0x8fb 0x31cc 0x9fb6 0x906 0x33ca 0x9f51 0x91d 0x35c8 0x9eeb 0x91e 0x37c6 0x9e85 0x8e2 0x39c4 0x9e1c 0x8bd 0x3bc2 0x9daf 0x8da 0x3dc0 0x9d42 0x8fc 0x3fbe 0x9cdc 0x8ce 0x41bc 0x9c74 0x8ba 0x43ba 0x9c0d 0x8db 0x45b8 0x9bae 0x910 0x47b6 0x9b53 0x8c9 0x49b3 0x9ae9 0x8fd 0x4bb1 0x9a83 0x8c3 0x4daf 0x9a21 0x884 0x4fad 0x99bb 0x81a 0x51ab 0x9948 0x818 0x53a9 0x98dd 0x7e8 0x55a7 0x987d 0x7c5 0x57a5 0x9819 0x7f8 0x59a3 0x97c4 0x84d 0x5ba1 0x9778 0x86e 0x5d9f 0x9734 0x7eb 0x5f9d 0x96f2 0x7a3 0x619b 0x96b6 0x791 0x6399 0x967d 0x792 0x6596 0x9647 0x763 0x6794 0x960e 0x7eb 0x6992 0x95d9 0x810 0x6b90 0x95ad 0x82c 0x6d8e 0x957e 0x81f 0x6f8c 0x9552 0x851 0x718a 0x9529 0x85c 0x7388 0x9503 0x7be 0x7586 0x94dd 0x7fb 0x7784 0x94ba 0x824 0x7982 0x9493 0x865 0x7b80 0x9475 0x80c 0x7d7e 0x9454 0x871 0x7f7c 0x9434 0x89f 0x817a 0x9416 0x8b1 0x8377 0x93fd 0x8b1 0x8575 0x93e4 0x8e9 0x8773 0x93cd 0x87e 0x8971 0x93bd 0x830 0x8b6f 0x93b0 0x845 0x8d6d 0x939e 0x8bb 0x8f6b 0x938d 0x8d2 0x9169 0x9379 0x923 0x9367 0x935f 0x9b2 0x9565 0x933f 0xa08 0x9763 0x931e 0x9b0 0x9961 0x92f8 0x97f 0x9b5f 0x92ce 0x964 0x9d5d 0x92a5 0x953 0x9f5a 0x927a 0x98d 0xa158 0x9245 0xa38 0xa356 0x9204 0xb2a 0xa554 0x91c1 0xb8e 0xa752 0x9181 0xbbb 0xa950 0x9138 0xc53 0xab4e 0x90e1 0xc85 0xad4c 0x9095 0xc4c 0xaf4a 0x905f 0xd08 0xb148 0x9033 0xeb5 0xb346 0x900f 0x1062 0xb544 0x8fea 0x1120 0xb742 0x8fb9 0x14ae 0xb940 0x8f6e 0x1904 0xbb3e 0x8edc 0x20d4 0xbd3b 0x8d8e 0x2a39 0xbf39 0x8b77 0x2b01 0xc137 0x8b56 0x2b02 0xc335 0x8b56 0x2b02 0xc533 0x8b56 0x2b02>;
		battery1_profile_t3_num = <0x64>;
		battery1_profile_t4 = <0x0 0xab93 0x60e 0x1fe 0xaad6 0x16f6 0x3fc 0xaa3b 0x1715 0x5fa 0xa9ae 0x16fa 0x7f8 0xa926 0x16c5 0x9f6 0xa8a1 0x169d 0xbf4 0xa820 0x165e 0xdf2 0xa7a0 0x163a 0xfef 0xa723 0x1603 0x11ed 0xa6a8 0x15f0 0x13eb 0xa62b 0x159d 0x15e9 0xa5b1 0x154c 0x17e7 0xa537 0x1523 0x19e5 0xa4be 0x14f7 0x1be3 0xa446 0x14d1 0x1de1 0xa3ce 0x14ab 0x1fdf 0xa359 0x149b 0x21dd 0xa2e5 0x1490 0x23db 0xa271 0x1450 0x25d9 0xa1fd 0x1435 0x27d7 0xa18c 0x1428 0x29d5 0xa11a 0x1402 0x2bd2 0xa0a9 0x13dd 0x2dd0 0xa03a 0x13a0 0x2fce 0x9fd0 0x1381 0x31cc 0x9f6b 0x1383 0x33ca 0x9eff 0x1373 0x35c8 0x9e8c 0x135f 0x37c6 0x9e13 0x135d 0x39c4 0x9d98 0x133c 0x3bc2 0x9d1d 0x1310 0x3dc0 0x9ca3 0x12e9 0x3fbe 0x9c2d 0x12c0 0x41bc 0x9bbb 0x1294 0x43ba 0x9b4f 0x1252 0x45b8 0x9aea 0x1237 0x47b6 0x9a8b 0x1239 0x49b3 0x9a2b 0x1235 0x4bb1 0x99c5 0x1220 0x4daf 0x9964 0x1210 0x4fad 0x9904 0x1205 0x51ab 0x98a7 0x11ee 0x53a9 0x9851 0x11fd 0x55a7 0x97fc 0x11fc 0x57a5 0x97af 0x121f 0x59a3 0x9761 0x1212 0x5ba1 0x971b 0x1227 0x5d9f 0x96d9 0x1235 0x5f9d 0x9698 0x1249 0x619b 0x965b 0x1268 0x6399 0x961f 0x127d 0x6596 0x95e7 0x1299 0x6794 0x95b3 0x12b0 0x6992 0x9580 0x12c5 0x6b90 0x9553 0x1308 0x6d8e 0x9526 0x131e 0x6f8c 0x94fa 0x1345 0x718a 0x94cf 0x136d 0x7388 0x94a7 0x138c 0x7586 0x9482 0x13b0 0x7784 0x9461 0x13c4 0x7982 0x9444 0x13ff 0x7b80 0x942c 0x142d 0x7d7e 0x9416 0x1461 0x7f7c 0x9401 0x149f 0x817a 0x93ef 0x14d7 0x8377 0x93df 0x153f 0x8575 0x93cc 0x159b 0x8773 0x93ba 0x15ed 0x8971 0x93a7 0x165a 0x8b6f 0x9391 0x16da 0x8d6d 0x9379 0x177c 0x8f6b 0x935f 0x1809 0x9169 0x9343 0x18ad 0x9367 0x9325 0x1980 0x9565 0x9303 0x1a50 0x9763 0x92e0 0x1b2a 0x9961 0x92b9 0x1c1c 0x9b5f 0x928e 0x1d3e 0x9d5d 0x9260 0x1e77 0x9f5a 0x922e 0x1fd5 0xa158 0x91f7 0x213c 0xa356 0x91be 0x22ae 0xa554 0x9181 0x2447 0xa752 0x9142 0x260c 0xa950 0x9101 0x27d8 0xab4e 0x90be 0x297e 0xad4c 0x907d 0x2b1b 0xaf4a 0x9040 0x2ccf 0xb148 0x9006 0x2ed5 0xb346 0x8fd3 0x3163 0xb544 0x8fa3 0x34e0 0xb742 0x8f70 0x3a38 0xb940 0x8f2d 0x3f76 0xbb3e 0x8eb3 0x35f4 0xbd3b 0x8da6 0xec10 0xbf39 0x8a83 0xe6da 0xc137 0x8555 0xde38 0xc335 0x8555 0xde38 0xc533 0x8555 0xde38>;
		battery1_profile_t4_num = <0x64>;
		battery2_profile_t0 = <0x0 0xaa5a 0x89 0x2bc 0xa816 0x89 0x578 0xa79e 0x87 0x834 0xa74e 0x8c 0xaf0 0xa708 0x8c 0xdac 0xa6ae 0x8a 0x1068 0xa636 0x8a 0x1324 0xa5d2 0x8a 0x15e0 0xa55a 0x8c 0x189c 0xa4ec 0x8c 0x1b58 0xa47e 0x88 0x1e14 0xa406 0x8c 0x20d0 0xa38e 0x8c 0x238c 0xa320 0x8a 0x2648 0xa2a8 0x8a 0x2904 0xa23a 0x8a 0x2bc0 0xa1c2 0x8a 0x2e7c 0xa154 0x8c 0x3138 0xa0dc 0x87 0x33f4 0xa06e 0x8d 0x36b0 0xa000 0x8d 0x396c 0x9f88 0x8b 0x3c28 0x9f1a 0x8c 0x3ee4 0x9eac 0x8d 0x41a0 0x9e3e 0x8d 0x445c 0x9dd0 0x92 0x4718 0x9d62 0x90 0x49d4 0x9cf4 0x8d 0x4c90 0x9c90 0x92 0x4f4c 0x9c22 0x93 0x5208 0x9bbe 0x93 0x54c4 0x9b5a 0x95 0x5780 0x9aec 0x96 0x5a3c 0x9a88 0x98 0x5cf8 0x9a24 0x9a 0x5fb4 0x99c0 0x9d 0x6270 0x9966 0xa0 0x652c 0x9902 0xa0 0x67e8 0x98a8 0xa3 0x6aa4 0x984e 0xa3 0x6d60 0x97f4 0xa6 0x701c 0x979a 0xa4 0x72d8 0x9740 0x9e 0x7594 0x96f0 0x95 0x7850 0x96a0 0x8c 0x7b0c 0x9646 0x89 0x7dc8 0x9600 0x85 0x7fbc 0x95b0 0x85 0x8278 0x956a 0x84 0x8534 0x9524 0x84 0x87f0 0x94e8 0x85 0x8aac 0x94a2 0x81 0x8d68 0x9466 0x84 0x9024 0x9434 0x85 0x92e0 0x93f8 0x84 0x959c 0x93c6 0x85 0x98bc 0x938a 0x85 0x9bdc 0x9358 0x85 0x9e98 0x9326 0x87 0xa154 0x92f4 0x89 0xa410 0x92c2 0x89 0xa6cc 0x9290 0x89 0xa988 0x9268 0x89 0xac44 0x9236 0x8a 0xaf00 0x920e 0x8c 0xb1bc 0x91e6 0x8c 0xb478 0x91be 0x8c 0xb734 0x9196 0x8d 0xb9f0 0x916e 0x8f 0xbcac 0x9146 0x8f 0xbf68 0x9128 0x8f 0xc224 0x9100 0x8d 0xc4e0 0x90d8 0x8c 0xc79c 0x90ba 0x89 0xca58 0x9092 0x89 0xcd14 0x9074 0x89 0xcfd0 0x904c 0x89 0xd28c 0x9024 0x87 0xd548 0x8ffc 0x87 0xd804 0x8fd4 0x85 0xdac0 0x8fb6 0x87 0xdd7c 0x8f84 0x88 0xe038 0x8f66 0x89 0xe2f4 0x8f34 0x89 0xe5b0 0x8f02 0x89 0xe86c 0x8ed0 0x87 0xeb28 0x8e9e 0x8a 0xede4 0x8e62 0x8a 0xf0a0 0x8e26 0x87 0xf35c 0x8df4 0x8a 0xf618 0x8db8 0x88 0xf8d4 0x8d90 0x8d 0xfb90 0x8d5e 0x8f 0xfe4c 0x8d2c 0x92 0x10108 0x8cfa 0x98 0x103c4 0x8cb4 0x9d 0x10680 0x8c5a 0x96 0x1093c 0x8ad4 0x9d 0x10bf8 0x8854 0xa6 0x10eb4 0x84d0 0xb7>;
		battery2_profile_t0_num = <0x64>;
		battery2_profile_t1 = <0x0 0xabb8 0x89 0x2bc 0xa85c 0x89 0x578 0xa7d0 0x87 0x834 0xa758 0x8c 0xaf0 0xa6ea 0x8c 0xdac 0xa686 0x8a 0x1068 0xa622 0x8a 0x1324 0xa5b4 0x8a 0x15e0 0xa550 0x8c 0x189c 0xa4d8 0x8c 0x1b58 0xa46a 0x88 0x1e14 0xa3fc 0x8c 0x20d0 0xa38e 0x8c 0x238c 0xa320 0x8a 0x2648 0xa2b2 0x8a 0x2904 0xa23a 0x8a 0x2bc0 0xa1cc 0x8a 0x2e7c 0xa154 0x8c 0x3138 0xa0dc 0x87 0x33f4 0xa064 0x8d 0x36b0 0x9ff6 0x8d 0x396c 0x9f74 0x8b 0x3c28 0x9f06 0x8c 0x3ee4 0x9e8e 0x8d 0x41a0 0x9e20 0x8d 0x445c 0x9da8 0x92 0x4718 0x9d3a 0x90 0x49d4 0x9ccc 0x8d 0x4c90 0x9c5e 0x92 0x4f4c 0x9bf0 0x93 0x5208 0x9b8c 0x93 0x54c4 0x9b1e 0x95 0x5780 0x9ab0 0x96 0x5a3c 0x9a4c 0x98 0x5cf8 0x99de 0x9a 0x5fb4 0x9966 0x9d 0x6270 0x98f8 0xa0 0x652c 0x9894 0xa0 0x67e8 0x983a 0xa3 0x6aa4 0x97d6 0xa3 0x6d60 0x977c 0xa6 0x701c 0x972c 0xa4 0x72d8 0x96d2 0x9e 0x7594 0x9682 0x95 0x7850 0x9632 0x8c 0x7b0c 0x95e2 0x89 0x7dc8 0x959c 0x85 0x7fbc 0x9542 0x85 0x8278 0x94fc 0x84 0x8534 0x94b6 0x84 0x87f0 0x9470 0x85 0x8aac 0x942a 0x81 0x8d68 0x93ee 0x84 0x9024 0x93b2 0x85 0x92e0 0x936c 0x84 0x959c 0x9330 0x85 0x98bc 0x92f4 0x85 0x9bdc 0x92c2 0x85 0x9e98 0x9286 0x87 0xa154 0x9254 0x89 0xa410 0x9222 0x89 0xa6cc 0x91f0 0x89 0xa988 0x91be 0x89 0xac44 0x9196 0x8a 0xaf00 0x9164 0x8c 0xb1bc 0x913c 0x8c 0xb478 0x910a 0x8c 0xb734 0x90e2 0x8d 0xb9f0 0x90ba 0x8f 0xbcac 0x9092 0x8f 0xbf68 0x906a 0x8f 0xc224 0x9042 0x8d 0xc4e0 0x9024 0x8c 0xc79c 0x8ffc 0x89 0xca58 0x8fde 0x89 0xcd14 0x8fc0 0x89 0xcfd0 0x8fa2 0x89 0xd28c 0x8f7a 0x87 0xd548 0x8f5c 0x87 0xd804 0x8f3e 0x85 0xdac0 0x8f20 0x87 0xdd7c 0x8ef8 0x88 0xe038 0x8eda 0x89 0xe2f4 0x8eb2 0x89 0xe5b0 0x8e8a 0x89 0xe86c 0x8e58 0x87 0xeb28 0x8e26 0x8a 0xede4 0x8df4 0x8a 0xf0a0 0x8db8 0x87 0xf35c 0x8d86 0x8a 0xf618 0x8d54 0x88 0xf8d4 0x8d04 0x8d 0xfb90 0x8cb4 0x8f 0xfe4c 0x8c82 0x92 0x10108 0x8c32 0x98 0x103c4 0x8bd8 0x9d 0x10680 0x8a7a 0x96 0x1093c 0x8912 0x9d 0x10bf8 0x86ce 0xa6 0x10eb4 0x84da 0xb7>;
		battery2_profile_t1_num = <0x64>;
		battery2_profile_t2 = <0x0 0xaae6 0x89 0x2bc 0xa474 0x89 0x578 0xa348 0x87 0x834 0xa29e 0x8c 0xaf0 0xa212 0x8c 0xdac 0xa190 0x8a 0x1068 0xa118 0x8a 0x1324 0xa0a0 0x8a 0x15e0 0xa032 0x8c 0x189c 0x9fc4 0x8c 0x1b58 0x9f56 0x88 0x1e14 0x9ede 0x8c 0x20d0 0x9e70 0x8c 0x238c 0x9e02 0x8a 0x2648 0x9d94 0x8a 0x2904 0x9d30 0x8a 0x2bc0 0x9ccc 0x8a 0x2e7c 0x9c68 0x8c 0x3138 0x9bfa 0x87 0x33f4 0x9b96 0x8d 0x36b0 0x9b28 0x8d 0x396c 0x9ac4 0x8b 0x3c28 0x9a6a 0x8c 0x3ee4 0x9a06 0x8d 0x41a0 0x99ac 0x8d 0x445c 0x993e 0x92 0x4718 0x98e4 0x90 0x49d4 0x988a 0x8d 0x4c90 0x9826 0x92 0x4f4c 0x97c2 0x93 0x5208 0x975e 0x93 0x54c4 0x96f0 0x95 0x5780 0x9696 0x96 0x5a3c 0x9632 0x98 0x5cf8 0x95ce 0x9a 0x5fb4 0x9574 0x9d 0x6270 0x9524 0xa0 0x652c 0x94d4 0xa0 0x67e8 0x9484 0xa3 0x6aa4 0x9434 0xa3 0x6d60 0x93ee 0xa6 0x701c 0x939e 0xa4 0x72d8 0x9362 0x9e 0x7594 0x931c 0x95 0x7850 0x92d6 0x8c 0x7b0c 0x9286 0x89 0x7dc8 0x9240 0x85 0x7fbc 0x920e 0x85 0x8278 0x91d2 0x84 0x8534 0x918c 0x84 0x87f0 0x9150 0x85 0x8aac 0x910a 0x81 0x8d68 0x90ce 0x84 0x9024 0x9088 0x85 0x92e0 0x904c 0x84 0x959c 0x9006 0x85 0x98bc 0x8fd4 0x85 0x9bdc 0x8fa2 0x85 0x9e98 0x8f70 0x87 0xa154 0x8f3e 0x89 0xa410 0x8f0c 0x89 0xa6cc 0x8eda 0x89 0xa988 0x8eb2 0x89 0xac44 0x8e8a 0x8a 0xaf00 0x8e58 0x8c 0xb1bc 0x8e30 0x8c 0xb478 0x8dfe 0x8c 0xb734 0x8dd6 0x8d 0xb9f0 0x8dae 0x8f 0xbcac 0x8d86 0x8f 0xbf68 0x8d68 0x8f 0xc224 0x8d40 0x8d 0xc4e0 0x8d18 0x8c 0xc79c 0x8cfa 0x89 0xca58 0x8cd2 0x89 0xcd14 0x8caa 0x89 0xcfd0 0x8c82 0x89 0xd28c 0x8c5a 0x87 0xd548 0x8c32 0x87 0xd804 0x8c0a 0x85 0xdac0 0x8bd8 0x87 0xdd7c 0x8bb0 0x88 0xe038 0x8b88 0x89 0xe2f4 0x8b56 0x89 0xe5b0 0x8b24 0x89 0xe86c 0x8ae8 0x87 0xeb28 0x8ab6 0x8a 0xede4 0x8a7a 0x8a 0xf0a0 0x8a34 0x87 0xf35c 0x89ee 0x8a 0xf618 0x89a8 0x88 0xf8d4 0x896c 0x8d 0xfb90 0x891c 0x8f 0xfe4c 0x88cc 0x92 0x10108 0x885e 0x98 0x103c4 0x87dc 0x9d 0x10680 0x8750 0x96 0x1093c 0x86d8 0x9d 0x10bf8 0x85fc 0xa6 0x10eb4 0x84d0 0xb7>;
		battery2_profile_t2_num = <0x64>;
		battery2_profile_t3 = <0x0 0xa6cc 0x89 0x2bc 0xa1b8 0x89 0x578 0xa064 0x87 0x834 0x9fd8 0x8c 0xaf0 0x9f60 0x8c 0xdac 0x9efc 0x8a 0x1068 0x9e98 0x8a 0x1324 0x9e20 0x8a 0x15e0 0x9db2 0x8c 0x189c 0x9d44 0x8c 0x1b58 0x9ccc 0x88 0x1e14 0x9c5e 0x8c 0x20d0 0x9bfa 0x8c 0x238c 0x9b96 0x8a 0x2648 0x9b28 0x8a 0x2904 0x9ac4 0x8a 0x2bc0 0x9a74 0x8a 0x2e7c 0x9a10 0x8c 0x3138 0x99ac 0x87 0x33f4 0x9952 0x8d 0x36b0 0x98f8 0x8d 0x396c 0x989e 0x8b 0x3c28 0x9830 0x8c 0x3ee4 0x97e0 0x8d 0x41a0 0x977c 0x8d 0x445c 0x9722 0x92 0x4718 0x96be 0x90 0x49d4 0x965a 0x8d 0x4c90 0x9614 0x92 0x4f4c 0x95b0 0x93 0x5208 0x9556 0x93 0x54c4 0x94fc 0x95 0x5780 0x94b6 0x96 0x5a3c 0x9466 0x98 0x5cf8 0x9420 0x9a 0x5fb4 0x93d0 0x9d 0x6270 0x938a 0xa0 0x652c 0x933a 0xa0 0x67e8 0x92fe 0xa3 0x6aa4 0x92ae 0xa3 0x6d60 0x9268 0xa6 0x701c 0x922c 0xa4 0x72d8 0x91e6 0x9e 0x7594 0x91a0 0x95 0x7850 0x915a 0x8c 0x7b0c 0x911e 0x89 0x7dc8 0x90e2 0x85 0x7fbc 0x909c 0x85 0x8278 0x9060 0x84 0x8534 0x902e 0x84 0x87f0 0x8ffc 0x85 0x8aac 0x8fb6 0x81 0x8d68 0x8f7a 0x84 0x9024 0x8f48 0x85 0x92e0 0x8f0c 0x84 0x959c 0x8eda 0x85 0x98bc 0x8e94 0x85 0x9bdc 0x8e62 0x85 0x9e98 0x8e30 0x87 0xa154 0x8e08 0x89 0xa410 0x8dd6 0x89 0xa6cc 0x8dae 0x89 0xa988 0x8d7c 0x89 0xac44 0x8d54 0x8a 0xaf00 0x8d2c 0x8c 0xb1bc 0x8d04 0x8c 0xb478 0x8cd2 0x8c 0xb734 0x8cb4 0x8d 0xb9f0 0x8c8c 0x8f 0xbcac 0x8c64 0x8f 0xbf68 0x8c46 0x8f 0xc224 0x8c14 0x8d 0xc4e0 0x8be2 0x8c 0xc79c 0x8bba 0x89 0xca58 0x8b92 0x89 0xcd14 0x8b60 0x89 0xcfd0 0x8b2e 0x89 0xd28c 0x8afc 0x87 0xd548 0x8aca 0x87 0xd804 0x8a98 0x85 0xdac0 0x8a66 0x87 0xdd7c 0x8a2a 0x88 0xe038 0x89e4 0x89 0xe2f4 0x89a8 0x89 0xe5b0 0x8962 0x89 0xe86c 0x891c 0x87 0xeb28 0x88d6 0x8a 0xede4 0x8890 0x8a 0xf0a0 0x884a 0x87 0xf35c 0x880e 0x8a 0xf618 0x87c8 0x88 0xf8d4 0x8782 0x8d 0xfb90 0x8728 0x8f 0xfe4c 0x86f6 0x92 0x10108 0x86b0 0x98 0x103c4 0x866a 0x9d 0x10680 0x861a 0x96 0x1093c 0x85d4 0x9d 0x10bf8 0x8584 0xa6 0x10eb4 0x84d0 0xb7>;
		battery2_profile_t3_num = <0x64>;
		battery2_profile_t4 = <0x0 0xa6cc 0x89 0x2bc 0xa1b8 0x89 0x578 0xa064 0x87 0x834 0x9fd8 0x8c 0xaf0 0x9f60 0x8c 0xdac 0x9efc 0x8a 0x1068 0x9e98 0x8a 0x1324 0x9e20 0x8a 0x15e0 0x9db2 0x8c 0x189c 0x9d44 0x8c 0x1b58 0x9ccc 0x88 0x1e14 0x9c5e 0x8c 0x20d0 0x9bfa 0x8c 0x238c 0x9b96 0x8a 0x2648 0x9b28 0x8a 0x2904 0x9ac4 0x8a 0x2bc0 0x9a74 0x8a 0x2e7c 0x9a10 0x8c 0x3138 0x99ac 0x87 0x33f4 0x9952 0x8d 0x36b0 0x98f8 0x8d 0x396c 0x989e 0x8b 0x3c28 0x9830 0x8c 0x3ee4 0x97e0 0x8d 0x41a0 0x977c 0x8d 0x445c 0x9722 0x92 0x4718 0x96be 0x90 0x49d4 0x965a 0x8d 0x4c90 0x9614 0x92 0x4f4c 0x95b0 0x93 0x5208 0x9556 0x93 0x54c4 0x94fc 0x95 0x5780 0x94b6 0x96 0x5a3c 0x9466 0x98 0x5cf8 0x9420 0x9a 0x5fb4 0x93d0 0x9d 0x6270 0x938a 0xa0 0x652c 0x933a 0xa0 0x67e8 0x92fe 0xa3 0x6aa4 0x92ae 0xa3 0x6d60 0x9268 0xa6 0x701c 0x922c 0xa4 0x72d8 0x91e6 0x9e 0x7594 0x91a0 0x95 0x7850 0x915a 0x8c 0x7b0c 0x911e 0x89 0x7dc8 0x90e2 0x85 0x7fbc 0x909c 0x85 0x8278 0x9060 0x84 0x8534 0x902e 0x84 0x87f0 0x8ffc 0x85 0x8aac 0x8fb6 0x81 0x8d68 0x8f7a 0x84 0x9024 0x8f48 0x85 0x92e0 0x8f0c 0x84 0x959c 0x8eda 0x85 0x98bc 0x8e94 0x85 0x9bdc 0x8e62 0x85 0x9e98 0x8e30 0x87 0xa154 0x8e08 0x89 0xa410 0x8dd6 0x89 0xa6cc 0x8dae 0x89 0xa988 0x8d7c 0x89 0xac44 0x8d54 0x8a 0xaf00 0x8d2c 0x8c 0xb1bc 0x8d04 0x8c 0xb478 0x8cd2 0x8c 0xb734 0x8cb4 0x8d 0xb9f0 0x8c8c 0x8f 0xbcac 0x8c64 0x8f 0xbf68 0x8c46 0x8f 0xc224 0x8c14 0x8d 0xc4e0 0x8be2 0x8c 0xc79c 0x8bba 0x89 0xca58 0x8b92 0x89 0xcd14 0x8b60 0x89 0xcfd0 0x8b2e 0x89 0xd28c 0x8afc 0x87 0xd548 0x8aca 0x87 0xd804 0x8a98 0x85 0xdac0 0x8a66 0x87 0xdd7c 0x8a2a 0x88 0xe038 0x89e4 0x89 0xe2f4 0x89a8 0x89 0xe5b0 0x8962 0x89 0xe86c 0x891c 0x87 0xeb28 0x88d6 0x8a 0xede4 0x8890 0x8a 0xf0a0 0x884a 0x87 0xf35c 0x880e 0x8a 0xf618 0x87c8 0x88 0xf8d4 0x8782 0x8d 0xfb90 0x8728 0x8f 0xfe4c 0x86f6 0x92 0x10108 0x86b0 0x98 0x103c4 0x866a 0x9d 0x10680 0x861a 0x96 0x1093c 0x85d4 0x9d 0x10bf8 0x8584 0xa6 0x10eb4 0x84d0 0xb7>;
		battery2_profile_t4_num = <0x64>;
		compatible = "mediatek,bat_gm30";
		g_FG_PSEUDO100_T0 = <0x64>;
		g_FG_PSEUDO100_T1 = <0x64>;
		g_FG_PSEUDO100_T2 = <0x64>;
		g_FG_PSEUDO100_T3 = <0x64>;
		g_FG_PSEUDO100_T4 = <0x64>;
		linux,phandle = <0x7b>;
		phandle = <0x7b>;
	};

	bpi_bsi_slv0@1021e000 {
		compatible = "mediatek,bpi_bsi_slv0";
		reg = <0x0 0x1021e000 0x0 0x1000>;
	};

	bpi_bsi_slv1@1021f000 {
		compatible = "mediatek,bpi_bsi_slv1";
		reg = <0x0 0x1021f000 0x0 0x6000>;
	};

	bpi_bsi_slv2@10225000 {
		compatible = "mediatek,bpi_bsi_slv2";
		reg = <0x0 0x10225000 0x0 0x1000>;
	};

	btif@1100c000 {
		clock-names = "btifc", "apdmac";
		clocks = <0x24 0x1a 0x24 0x26>;
		compatible = "mediatek,btif";
		interrupts = <0x0 0x70 0x8 0x0 0x84 0x8 0x0 0x85 0x8>;
		reg = <0x0 0x1100c000 0x0 0x1000 0x0 0x11000880 0x0 0x80 0x0 0x11000900 0x0 0x80>;
	};

	bus_dbg@10208000 {
		compatible = "mediatek,bus_dbg-v2";
		interrupts = <0x0 0x8d 0x8>;
		mediatek,bus_dbg_con_offset = <0x2fc>;
		reg = <0x0 0x10208000 0x0 0x1000 0x0 0x10001000 0x0 0x1000>;
	};

	cam1@1a003000 {
		compatible = "mediatek,cam1";
		interrupts = <0x0 0xeb 0x8>;
		reg = <0x0 0x1a003000 0x0 0x1000>;
	};

	cam2@1a004000 {
		compatible = "mediatek,cam2";
		interrupts = <0x0 0xec 0x8>;
		reg = <0x0 0x1a004000 0x0 0x1000>;
	};

	cam3@1a005000 {
		compatible = "mediatek,cam3";
		interrupts = <0x0 0xed 0x8>;
		reg = <0x0 0x1a005000 0x0 0x1000>;
	};

	cam_clear@1a01b000 {
		compatible = "mediatek,cam_clear";
		reg = <0x0 0x1a01b000 0x0 0x1000>;
	};

	cam_inner@1a013000 {
		compatible = "mediatek,cam_inner";
		reg = <0x0 0x1a013000 0x0 0x1000>;
	};

	cam_set@1a00b000 {
		compatible = "mediatek,cam_set";
		reg = <0x0 0x1a00b000 0x0 0x1000>;
	};

	cama_clear@1a01c000 {
		compatible = "mediatek,cama_clear";
		reg = <0x0 0x1a01c000 0x0 0x1000>;
	};

	cama_ext@1a024000 {
		compatible = "mediatek,cama_ext";
		reg = <0x0 0x1a024000 0x0 0x1000>;
	};

	cama_inner@1a014000 {
		compatible = "mediatek,cama_inner";
		reg = <0x0 0x1a014000 0x0 0x1000>;
	};

	cama_set@1a00c000 {
		compatible = "mediatek,cama_set";
		reg = <0x0 0x1a00c000 0x0 0x1000>;
	};

	camb_clear@1a01d000 {
		compatible = "mediatek,camb_clear";
		reg = <0x0 0x1a01d000 0x0 0x1000>;
	};

	camb_ext@1a025000 {
		compatible = "mediatek,camb_ext";
		reg = <0x0 0x1a025000 0x0 0x1000>;
	};

	camb_inner@1a015000 {
		compatible = "mediatek,camb_inner";
		reg = <0x0 0x1a015000 0x0 0x1000>;
	};

	camb_set@1a00d000 {
		compatible = "mediatek,camb_set";
		reg = <0x0 0x1a00d000 0x0 0x1000>;
	};

	camsv1@1a050000 {
		compatible = "mediatek,camsv1";
		interrupts = <0x0 0xf3 0x8>;
		reg = <0x0 0x1a050000 0x0 0x1000>;
	};

	camsv2@1a051000 {
		compatible = "mediatek,camsv2";
		interrupts = <0x0 0xf4 0x8>;
		reg = <0x0 0x1a051000 0x0 0x1000>;
	};

	camsv3@1a052000 {
		compatible = "mediatek,camsv3";
		interrupts = <0x0 0xf1 0x8>;
		reg = <0x0 0x1a052000 0x0 0x1000>;
	};

	camsv4@1a053000 {
		compatible = "mediatek,camsv4";
		interrupts = <0x0 0xf2 0x8>;
		reg = <0x0 0x1a053000 0x0 0x1000>;
	};

	camsys@1a000000 {
		#clock-cells = <0x1>;
		compatible = "mediatek,camsys", "syscon";
		linux,phandle = <0x44>;
		phandle = <0x44>;
		reg = <0x0 0x1a000000 0x0 0x1000>;
	};

	ccu@1a0b0000 {
		clock-names = "CCU_CLK_CAM_CCU";
		clocks = <0x44 0x8>;
		compatible = "mediatek,ccu";
		interrupts = <0x0 0xf6 0x8>;
		reg = <0x0 0x1a0b1000 0x0 0x1000>;
	};

	charger {
		ac_charger_current = <0x1f47d0>;
		ac_charger_input_current = <0x30d400>;
		algorithm_name = "SwitchCharging";
		apple_1_0a_charger_current = <0x9eb10>;
		apple_2_1a_charger_current = <0xc3500>;
		battery_cv = <0x426030>;
		bif_cv_under_threshold2 = <0x43e6d0>;
		bif_threshold1 = <0x40d990>;
		bif_threshold2 = <0x419ce0>;
		cable_imp_threshold = <0x2bb>;
		charging_host_charger_current = <0x16e360>;
		chg1_ta_ac_charger_current = <0x16e360>;
		chg2_ta_ac_charger_current = <0x16e360>;
		compatible = "mediatek,charger";
		disable_pd_dual;
		dual_polling_ieoc = <0x6ddd0>;
		enable_dynamic_mivr;
		enable_min_charge_temp;
		enable_pe_2;
		enable_pe_3;
		enable_pe_4;
		enable_pe_plus;
		enable_type_c;
		high_temp_to_enter_pe40 = <0x27>;
		high_temp_to_leave_pe40 = <0x2e>;
		ibus_err = <0xe>;
		jeita_temp_above_t4_cv = <0x40b280>;
		jeita_temp_below_t0_cv = <0x3da540>;
		jeita_temp_t0_to_t1_cv = <0x3da540>;
		jeita_temp_t1_to_t2_cv = <0x40b280>;
		jeita_temp_t2_to_t3_cv = <0x423920>;
		jeita_temp_t3_to_t4_cv = <0x40b280>;
		linux,phandle = <0x9f>;
		low_temp_to_enter_pe40 = <0x10>;
		low_temp_to_leave_pe40 = <0xa>;
		max_charge_temp = <0x32>;
		max_charge_temp_minus_x_degree = <0x2f>;
		max_charger_voltage = <0x632ea0>;
		max_dmivr_charger_current = <0x155cc0>;
		min_charge_temp = <0x0>;
		min_charge_temp_plus_x_degree = <0x6>;
		min_charger_voltage = <0x4630c0>;
		min_charger_voltage_1 = <0x432380>;
		min_charger_voltage_2 = <0x401640>;
		non_std_ac_charger_current = <0x7a120>;
		pd_ichg_level_threshold = <0xf4240>;
		pd_stop_battery_soc = <0x50>;
		pd_vbus_low_bound = <0x4c4b40>;
		pd_vbus_upper_bound = <0x4c4b40>;
		pe20_ichg_level_threshold = <0xf4240>;
		pe40_dual_charger_chg1_current = <0x1e8480>;
		pe40_dual_charger_chg2_current = <0x1e8480>;
		pe40_dual_charger_input_current = <0x2dc6c0>;
		pe40_r_cable_1a_lower = <0x229>;
		pe40_r_cable_2a_lower = <0x19f>;
		pe40_r_cable_3a_lower = <0x113>;
		pe40_single_charger_current = <0x2dc6c0>;
		pe40_single_charger_input_current = <0x2dc6c0>;
		pe40_stop_battery_soc = <0x50>;
		pe_ichg_level_threshold = <0xf4240>;
		phandle = <0x9f>;
		power_path_support;
		slave_mivr_diff = <0x186a0>;
		ta_12v_support;
		ta_9v_support;
		ta_ac_12v_input_current = <0x30d400>;
		ta_ac_7v_input_current = <0x30d400>;
		ta_ac_9v_input_current = <0x30d400>;
		ta_ac_charger_current = <0x2dc6c0>;
		ta_start_battery_soc = <0x0>;
		ta_stop_battery_soc = <0x55>;
		temp_neg_10_thres = <0x0>;
		temp_t0_thres = <0x0>;
		temp_t0_thres_plus_x_degree = <0x0>;
		temp_t1_thres = <0x0>;
		temp_t1_thres_plus_x_degree = <0x6>;
		temp_t2_thres = <0xa>;
		temp_t2_thres_plus_x_degree = <0x10>;
		temp_t3_thres = <0x2d>;
		temp_t3_thres_minus_x_degree = <0x27>;
		temp_t4_thres = <0x32>;
		temp_t4_thres_minus_x_degree = <0x2f>;
		usb_charger_current = <0x7a120>;
		usb_charger_current_configured = <0x7a120>;
		usb_charger_current_suspend = <0x0>;
		usb_charger_current_unconfigured = <0x11170>;
		vbat_cable_imp_threshold = <0x3b8260>;
		vsys_watt = <0x4c4b40>;
	};

	chipid@08000000 {
		compatible = "mediatek,chipid";
		reg = <0x0 0x8000000 0x0 0x4 0x0 0x8000004 0x0 0x4 0x0 0x8000008 0x0 0x4 0x0 0x800000c 0x0 0x4>;
	};

	chosen {
		bootargs = "console=tty0 console=ttyS0,921600n1 vmalloc=400M slub_debug=OFZPU page_owner=on swiotlb=noforce androidboot.hardware=mt6765 maxcpus=8 loop.max_part=7 firmware_class.path=/vendor/firmware";
		kaslr-seed = <0x0 0x0>;
		linux,phandle = <0x4d>;
		phandle = <0x4d>;
	};

	clocks {

		clk26m {
			#clock-cells = <0x0>;
			clock-frequency = <0x18cba80>;
			compatible = "fixed-clock";
			linux,phandle = <0x1f>;
			phandle = <0x1f>;
		};

		clk32k {
			#clock-cells = <0x0>;
			clock-frequency = <0x7d00>;
			compatible = "fixed-clock";
			linux,phandle = <0x1d>;
			phandle = <0x1d>;
		};
	};

	consys@18002000 {
		#address-cells = <0x2>;
		#size-cells = <0x2>;
		clock-names = "conn";
		clocks = <0x25 0x1>;
		compatible = "mediatek,mt6765-consys";
		interrupts = <0x0 0x10b 0x8 0x0 0x10d 0x8 0x0 0x10e 0x1>;
		linux,phandle = <0x1b>;
		phandle = <0x1b>;
		reg = <0x0 0x18002000 0x0 0x1000 0x0 0x10007000 0x0 0x100 0x0 0x10001000 0x0 0x1000 0x0 0x10006000 0x0 0x1000 0x0 0x18007000 0x0 0x1000 0x0 0x180b1000 0x0 0x1000 0x0 0x180a3000 0x0 0x1000 0x0 0x180a5000 0x0 0x800 0x0 0x180c1000 0x0 0x1000 0x0 0x18004000 0x0 0x1000 0x0 0x0 0x0 0x0 0x0 0x0 0x0 0x0 0x0 0x1020e000 0x0 0x1000>;
	};

	cpu_dbgapb@0d410000 {
		compatible = "mediatek,hw_dbg";
		linux,phandle = <0x4f>;
		num = <0x8>;
		phandle = <0x4f>;
		reg = <0x0 0xd410000 0x0 0x1000 0x0 0xd510000 0x0 0x1000 0x0 0xd610000 0x0 0x1000 0x0 0xd710000 0x0 0x1000 0x0 0xd810000 0x0 0x1000 0x0 0xd910000 0x0 0x1000 0x0 0xda10000 0x0 0x1000 0x0 0xdb10000 0x0 0x1000>;
	};

	cpus {
		#address-cells = <0x1>;
		#size-cells = <0x0>;

		cpu-map {

			cluster0 {

				core0 {
					cpu = <0x9>;
				};

				core1 {
					cpu = <0xa>;
				};

				core2 {
					cpu = <0xb>;
				};

				core3 {
					cpu = <0xc>;
				};
			};

			cluster1 {

				core0 {
					cpu = <0xd>;
				};

				core1 {
					cpu = <0xe>;
				};

				core2 {
					cpu = <0xf>;
				};

				core3 {
					cpu = <0x10>;
				};
			};
		};

		cpu@000 {
			clock-frequency = <0x89267940>;
			compatible = "arm,cortex-a53";
			cpu-idle-states = <0x2 0x3 0x4 0x5 0x6 0x7 0x8>;
			device_type = "cpu";
			enable-method = "psci";
			linux,phandle = <0x9>;
			phandle = <0x9>;
			reg = <0x0>;
		};

		cpu@001 {
			clock-frequency = <0x89267940>;
			compatible = "arm,cortex-a53";
			cpu-idle-states = <0x2 0x3 0x4 0x5 0x6 0x7 0x8>;
			device_type = "cpu";
			enable-method = "psci";
			linux,phandle = <0xa>;
			phandle = <0xa>;
			reg = <0x1>;
		};

		cpu@002 {
			clock-frequency = <0x89267940>;
			compatible = "arm,cortex-a53";
			cpu-idle-states = <0x2 0x3 0x4 0x5 0x6 0x7 0x8>;
			device_type = "cpu";
			enable-method = "psci";
			linux,phandle = <0xb>;
			phandle = <0xb>;
			reg = <0x2>;
		};

		cpu@003 {
			clock-frequency = <0x89267940>;
			compatible = "arm,cortex-a53";
			cpu-idle-states = <0x2 0x3 0x4 0x5 0x6 0x7 0x8>;
			device_type = "cpu";
			enable-method = "psci";
			linux,phandle = <0xc>;
			phandle = <0xc>;
			reg = <0x3>;
		};

		cpu@100 {
			clock-frequency = <0x6b49d200>;
			compatible = "arm,cortex-a53";
			cpu-idle-states = <0x2 0x3 0x4 0x5 0x6 0x7 0x8>;
			device_type = "cpu";
			enable-method = "psci";
			linux,phandle = <0xd>;
			phandle = <0xd>;
			reg = <0x100>;
		};

		cpu@101 {
			clock-frequency = <0x6b49d200>;
			compatible = "arm,cortex-a53";
			cpu-idle-states = <0x2 0x3 0x4 0x5 0x6 0x7 0x8>;
			device_type = "cpu";
			enable-method = "psci";
			linux,phandle = <0xe>;
			phandle = <0xe>;
			reg = <0x101>;
		};

		cpu@102 {
			clock-frequency = <0x6b49d200>;
			compatible = "arm,cortex-a53";
			cpu-idle-states = <0x2 0x3 0x4 0x5 0x6 0x7 0x8>;
			device_type = "cpu";
			enable-method = "psci";
			linux,phandle = <0xf>;
			phandle = <0xf>;
			reg = <0x102>;
		};

		cpu@103 {
			clock-frequency = <0x6b49d200>;
			compatible = "arm,cortex-a53";
			cpu-idle-states = <0x2 0x3 0x4 0x5 0x6 0x7 0x8>;
			device_type = "cpu";
			enable-method = "psci";
			linux,phandle = <0x10>;
			phandle = <0x10>;
			reg = <0x103>;
		};

		idle-states {
			entry-method = "arm,psci";

			dpidle {
				arm,psci-suspend-param = <0x1010004>;
				compatible = "arm,idle-state";
				entry-latency-us = <0x320>;
				exit-latency-us = <0x3e8>;
				linux,phandle = <0x7>;
				min-residency-us = <0x7d0>;
				phandle = <0x7>;
			};

			mcdi-cluster {
				arm,psci-suspend-param = <0x1010001>;
				compatible = "arm,idle-state";
				entry-latency-us = <0x258>;
				exit-latency-us = <0x258>;
				linux,phandle = <0x4>;
				min-residency-us = <0x4b0>;
				phandle = <0x4>;
			};

			mcdi-cpu {
				arm,psci-suspend-param = <0x10001>;
				compatible = "arm,idle-state";
				entry-latency-us = <0x258>;
				exit-latency-us = <0x258>;
				linux,phandle = <0x3>;
				min-residency-us = <0x4b0>;
				phandle = <0x3>;
			};

			sodi {
				arm,psci-suspend-param = <0x1010002>;
				compatible = "arm,idle-state";
				entry-latency-us = <0x320>;
				exit-latency-us = <0x3e8>;
				linux,phandle = <0x5>;
				min-residency-us = <0x7d0>;
				phandle = <0x5>;
			};

			sodi3 {
				arm,psci-suspend-param = <0x1010003>;
				compatible = "arm,idle-state";
				entry-latency-us = <0x320>;
				exit-latency-us = <0x3e8>;
				linux,phandle = <0x6>;
				min-residency-us = <0x7d0>;
				phandle = <0x6>;
			};

			standby {
				arm,psci-suspend-param = <0x1>;
				compatible = "arm,idle-state";
				entry-latency-us = <0x258>;
				exit-latency-us = <0x258>;
				linux,phandle = <0x2>;
				min-residency-us = <0x4b0>;
				phandle = <0x2>;
			};

			suspend {
				arm,psci-suspend-param = <0x1010005>;
				compatible = "arm,idle-state";
				entry-latency-us = <0x320>;
				exit-latency-us = <0x3e8>;
				linux,phandle = <0x8>;
				min-residency-us = <0x7d0>;
				phandle = <0x8>;
			};
		};
	};

	cq_dma@10212000 {
		clock-names = "cqdma";
		clocks = <0x24 0x43>;
		compatible = "mediatek,mt-cqdma-v1";
		interrupts = <0x0 0x71 0x8 0x0 0x72 0x8>;
		keep_clock_ao = "yes";
		nr_channel = <0x2>;
		reg = <0x0 0x10212000 0x0 0x80 0x0 0x10212080 0x0 0x80>;
	};

	dbg_apmcu_mp0@0d400000 {
		compatible = "mediatek,dbg_apmcu_mp0";
		reg = <0x0 0xd400000 0x0 0x1000>;
	};

	dbg_apmcu_mp0@0d410000 {
		compatible = "mediatek,dbg_apmcu_mp0";
		reg = <0x0 0xd410000 0x0 0x1000>;
	};

	dbg_apmcu_mp0@0d420000 {
		compatible = "mediatek,dbg_apmcu_mp0";
		reg = <0x0 0xd420000 0x0 0x1000>;
	};

	dbg_apmcu_mp0@0d430000 {
		compatible = "mediatek,dbg_apmcu_mp0";
		reg = <0x0 0xd430000 0x0 0x1000>;
	};

	dbg_apmcu_mp0@0d440000 {
		compatible = "mediatek,dbg_apmcu_mp0";
		reg = <0x0 0xd440000 0x0 0x1000>;
	};

	dbg_apmcu_mp0@0d510000 {
		compatible = "mediatek,dbg_apmcu_mp0";
		reg = <0x0 0xd510000 0x0 0x1000>;
	};

	dbg_apmcu_mp0@0d520000 {
		compatible = "mediatek,dbg_apmcu_mp0";
		reg = <0x0 0xd520000 0x0 0x1000>;
	};

	dbg_apmcu_mp0@0d530000 {
		compatible = "mediatek,dbg_apmcu_mp0";
		reg = <0x0 0xd530000 0x0 0x1000>;
	};

	dbg_apmcu_mp0@0d540000 {
		compatible = "mediatek,dbg_apmcu_mp0";
		reg = <0x0 0xd540000 0x0 0x1000>;
	};

	dbg_apmcu_mp0@0d610000 {
		compatible = "mediatek,dbg_apmcu_mp0";
		reg = <0x0 0xd610000 0x0 0x1000>;
	};

	dbg_apmcu_mp0@0d620000 {
		compatible = "mediatek,dbg_apmcu_mp0";
		reg = <0x0 0xd620000 0x0 0x1000>;
	};

	dbg_apmcu_mp0@0d630000 {
		compatible = "mediatek,dbg_apmcu_mp0";
		reg = <0x0 0xd630000 0x0 0x1000>;
	};

	dbg_apmcu_mp0@0d640000 {
		compatible = "mediatek,dbg_apmcu_mp0";
		reg = <0x0 0xd640000 0x0 0x1000>;
	};

	dbg_apmcu_mp0@0d710000 {
		compatible = "mediatek,dbg_apmcu_mp0";
		reg = <0x0 0xd710000 0x0 0x1000>;
	};

	dbg_apmcu_mp0@0d720000 {
		compatible = "mediatek,dbg_apmcu_mp0";
		reg = <0x0 0xd720000 0x0 0x1000>;
	};

	dbg_apmcu_mp0@0d730000 {
		compatible = "mediatek,dbg_apmcu_mp0";
		reg = <0x0 0xd730000 0x0 0x1000>;
	};

	dbg_apmcu_mp0@0d740000 {
		compatible = "mediatek,dbg_apmcu_mp0";
		reg = <0x0 0xd740000 0x0 0x1000>;
	};

	dbg_apmcu_mp1@0d800000 {
		compatible = "mediatek,dbg_apmcu_mp1";
		reg = <0x0 0xd800000 0x0 0x1000>;
	};

	dbg_apmcu_mp1@0d810000 {
		compatible = "mediatek,dbg_apmcu_mp1";
		reg = <0x0 0xd810000 0x0 0x1000>;
	};

	dbg_apmcu_mp1@0d820000 {
		compatible = "mediatek,dbg_apmcu_mp1";
		reg = <0x0 0xd820000 0x0 0x1000>;
	};

	dbg_apmcu_mp1@0d830000 {
		compatible = "mediatek,dbg_apmcu_mp1";
		reg = <0x0 0xd830000 0x0 0x1000>;
	};

	dbg_apmcu_mp1@0d840000 {
		compatible = "mediatek,dbg_apmcu_mp1";
		reg = <0x0 0xd840000 0x0 0x1000>;
	};

	dbg_apmcu_mp1@0d910000 {
		compatible = "mediatek,dbg_apmcu_mp1";
		reg = <0x0 0xd910000 0x0 0x1000>;
	};

	dbg_apmcu_mp1@0d920000 {
		compatible = "mediatek,dbg_apmcu_mp1";
		reg = <0x0 0xd920000 0x0 0x1000>;
	};

	dbg_apmcu_mp1@0d930000 {
		compatible = "mediatek,dbg_apmcu_mp1";
		reg = <0x0 0xd930000 0x0 0x1000>;
	};

	dbg_apmcu_mp1@0d940000 {
		compatible = "mediatek,dbg_apmcu_mp1";
		reg = <0x0 0xd940000 0x0 0x1000>;
	};

	dbg_apmcu_mp1@0da10000 {
		compatible = "mediatek,dbg_apmcu_mp1";
		reg = <0x0 0xda10000 0x0 0x1000>;
	};

	dbg_apmcu_mp1@0da20000 {
		compatible = "mediatek,dbg_apmcu_mp1";
		reg = <0x0 0xda20000 0x0 0x1000>;
	};

	dbg_apmcu_mp1@0da30000 {
		compatible = "mediatek,dbg_apmcu_mp1";
		reg = <0x0 0xda30000 0x0 0x1000>;
	};

	dbg_apmcu_mp1@0da40000 {
		compatible = "mediatek,dbg_apmcu_mp1";
		reg = <0x0 0xda40000 0x0 0x1000>;
	};

	dbg_apmcu_mp1@0db10000 {
		compatible = "mediatek,dbg_apmcu_mp1";
		reg = <0x0 0xdb10000 0x0 0x1000>;
	};

	dbg_apmcu_mp1@0db20000 {
		compatible = "mediatek,dbg_apmcu_mp1";
		reg = <0x0 0xdb20000 0x0 0x1000>;
	};

	dbg_apmcu_mp1@0db30000 {
		compatible = "mediatek,dbg_apmcu_mp1";
		reg = <0x0 0xdb30000 0x0 0x1000>;
	};

	dbg_apmcu_mp1@0db40000 {
		compatible = "mediatek,dbg_apmcu_mp1";
		reg = <0x0 0xdb40000 0x0 0x1000>;
	};

	dbg_cti@0d020000 {
		compatible = "mediatek,dbg_cti";
		reg = <0x0 0xd020000 0x0 0x10000>;
	};

	dbg_dem@0d0a0000 {
		compatible = "mediatek,dbg_dem";
		interrupts = <0x0 0x8c 0x8>;
		reg = <0x0 0xd0a0000 0x0 0x10000>;
	};

	dbg_etr@0d030000 {
		compatible = "mediatek,dbg_etr";
		reg = <0x0 0xd030000 0x0 0x10000>;
	};

	dbg_funnel@0d040000 {
		compatible = "mediatek,dbg_funnel";
		reg = <0x0 0xd040000 0x0 0x10000>;
	};

	dbg_mdsys1@0d0c0000 {
		compatible = "mediatek,dbg_mdsys1";
		reg = <0x0 0xd0c0000 0x0 0x40000>;
	};

	ddrphy@10015000 {
		compatible = "mediatek,ddrphy";
		reg = <0x0 0x10015000 0x0 0x1000>;
	};

	ddrphy@1001e000 {
		compatible = "mediatek,ddrphy";
		reg = <0x0 0x1001e000 0x0 0x1000>;
	};

	devapc@10207000 {
		clock-names = "devapc-infra-clock";
		clocks = <0x24 0x28>;
		compatible = "mediatek,devapc";
		interrupts = <0x0 0x8e 0x8>;
		reg = <0x0 0x10207000 0x0 0x1000 0x0 0x1000e000 0x0 0x1000>;
	};

	dfd@10200b00 {
		compatible = "mediatek,dfd";
		mediatek,chain_length = <0xc350>;
		mediatek,enabled = <0x1>;
		mediatek,rg_dfd_timeout = <0xa0>;
		reg = <0x0 0x10200b00 0x0 0x10000>;
	};

	dip1@15022000 {
		compatible = "mediatek,dip1";
		interrupts = <0x0 0xff 0x8>;
		reg = <0x0 0x15022000 0x0 0x3000>;
	};

	disp_aal0@14011000 {
		compatible = "mediatek,disp_aal0";
		interrupts = <0x0 0xde 0x8>;
		reg = <0x0 0x14011000 0x0 0x1000>;
	};

	disp_ccorr0@14010000 {
		compatible = "mediatek,disp_ccorr0";
		interrupts = <0x0 0xdd 0x8>;
		reg = <0x0 0x14010000 0x0 0x1000>;
	};

	disp_color0@1400f000 {
		clock-names = "MDP_COLOR";
		clocks = <0x26 0xc>;
		compatible = "mediatek,disp_color0";
		interrupts = <0x0 0xdc 0x8>;
		linux,phandle = <0x2d>;
		phandle = <0x2d>;
		reg = <0x0 0x1400f000 0x0 0x1000>;
	};

	disp_dither0@14013000 {
		compatible = "mediatek,disp_dither0";
		interrupts = <0x0 0xe0 0x8>;
		reg = <0x0 0x14013000 0x0 0x1000>;
	};

	disp_gamma0@14012000 {
		compatible = "mediatek,disp_gamma0";
		interrupts = <0x0 0xdf 0x8>;
		reg = <0x0 0x14012000 0x0 0x1000>;
	};

	disp_mutex0@14001000 {
		compatible = "mediatek,disp_mutex0";
		interrupts = <0x0 0xd2 0x8>;
		linux,phandle = <0x2f>;
		phandle = <0x2f>;
		reg = <0x0 0x14001000 0x0 0x1000>;
	};

	disp_ovl0@1400b000 {
		compatible = "mediatek,disp_ovl0";
		interrupts = <0x0 0xd9 0x8>;
		reg = <0x0 0x1400b000 0x0 0x1000>;
	};

	disp_ovl0_2l@1400c000 {
		compatible = "mediatek,disp_ovl0_2l";
		interrupts = <0x0 0xe5 0x8>;
		reg = <0x0 0x1400c000 0x0 0x1000>;
	};

	disp_pwm@1100e000 {
		compatible = "mediatek,disp_pwm";
		reg = <0x0 0x1100e000 0x0 0x1000>;
	};

	disp_rdma0@1400d000 {
		compatible = "mediatek,disp_rdma0";
		interrupts = <0x0 0xda 0x8>;
		reg = <0x0 0x1400d000 0x0 0x1000>;
	};

	disp_rsz0@14015000 {
		compatible = "mediatek,disp_rsz0";
		interrupts = <0x0 0x114 0x8>;
		reg = <0x0 0x14015000 0x0 0x1000>;
	};

	disp_wdma0@1400e000 {
		compatible = "mediatek,disp_wdma0";
		interrupts = <0x0 0xdb 0x8>;
		reg = <0x0 0x1400e000 0x0 0x1000>;
	};

	dispsys {
		clock-names = "MMSYS_MTCMOS", "MMSYS_SMI_COMMON", "MMSYS_SMI_LARB0", "MMSYS_GALS_COMM0", "MMSYS_GALS_COMM1", "MMSYS_DISP_OVL0", "MMSYS_DISP_OVL0_2L", "MMSYS_DISP_RDMA0", "MMSYS_DISP_WDMA0", "MMSYS_DISP_COLOR0", "MMSYS_DISP_CCORR0", "MMSYS_DISP_AAL0", "MMSYS_DISP_GAMMA0", "MMSYS_DISP_DITHER0", "MMSYS_DSI0_MM_CK", "MMSYS_DSI0_IF_CK", "MMSYS_26M", "MMSYS_DISP_RSZ0", "APMIXED_MIPI_26M", "TOP_MUX_DISP_PWM", "DISP_PWM", "TOP_26M", "TOP_UNIVPLL2_D4", "TOP_ULPOSC1_D2", "TOP_ULPOSC1_D8";
		clocks = <0x25 0x3 0x26 0x13 0x26 0x14 0x26 0x15 0x26 0x16 0x26 0x7 0x26 0x8 0x26 0xa 0x26 0xb 0x26 0xc 0x26 0xd 0x26 0xe 0x26 0xf 0x26 0x10 0x26 0x11 0x26 0x1c 0x26 0x1d 0x26 0x9 0x42 0x15 0x1e 0x73 0x24 0x31 0x1f 0x1e 0x1b 0x1e 0x2e 0x1e 0x30>;
		compatible = "mediatek,dispsys";
		mediatek,larb = <0x20>;
	};

	dma-controller@11000580 {
		#dma-cells = <0x1>;
		clock-names = "apdma";
		clocks = <0x24 0x26>;
		compatible = "mediatek,mt6577-uart-dma";
		interrupts = <0x0 0x6d 0x8 0x0 0x6e 0x8 0x0 0x6f 0x8 0x0 0x74 0x8>;
		linux,phandle = <0x32>;
		phandle = <0x32>;
		reg = <0x0 0x11000680 0x0 0x80 0x0 0x11000700 0x0 0x80 0x0 0x11000780 0x0 0x80 0x0 0x11000800 0x0 0x80>;
	};

	dpe@15028000 {
		clock-names = "DPE_CG_IMG_DPE";
		clocks = <0x43 0x3>;
		compatible = "mediatek,dpe";
		interrupts = <0x0 0x100 0x8>;
		reg = <0x0 0x15028000 0x0 0x1000>;
	};

	dramc0@1001d000 {
		compatible = "mediatek,dramc0";
		reg = <0x0 0x1001d000 0x0 0x1000>;
	};

	dramc@1022a000 {
		compatible = "mediatek,dramc";
		reg = <0x0 0x1022a000 0x0 0x2000 0x0 0x10232000 0x0 0x2000 0x0 0x1022c000 0x0 0x1000 0x0 0x10234000 0x0 0x1000 0x0 0x10228000 0x0 0x2000 0x0 0x10230000 0x0 0x2000 0x0 0x1022e000 0x0 0x1000 0x0 0x10236000 0x0 0x1000>;
	};

	dramc_nao@1021d000 {
		compatible = "mediatek,dramc_nao";
		reg = <0x0 0x1021d000 0x0 0x1000>;
	};

	dsi0@14014000 {
		compatible = "mediatek,dsi0";
		interrupts = <0x0 0xe1 0x8>;
		reg = <0x0 0x14014000 0x0 0x1000>;
	};

	dsi_te {
		compatible = "mediatek, DSI_TE-eint";
		linux,phandle = <0x99>;
		phandle = <0x99>;
		status = "disabled";
	};

	dvfsp@00110800 {
		compatible = "mediatek,mt6765-dvfsp";
		reg = <0x0 0x110800 0x0 0x1400 0x0 0x110800 0x0 0x1400>;
	};

	dvfsp@10227000 {
		compatible = "mediatek,dvfsp";
		reg = <0x0 0x10227000 0x0 0x1000>;
	};

	dvfsrc@10012000 {
		compatible = "mediatek,dvfsrc";
		reg = <0x0 0x10012000 0x0 0x1000 0x0 0x110780 0x0 0x80>;
	};

	dxcc_sec@10210000 {
		compatible = "mediatek,dxcc_sec";
		interrupts = <0x0 0xa2 0x4>;
		reg = <0x0 0x10210000 0x0 0x1000>;
	};

	dynamic_options {
		compatible = "mediatek,dynamic_options";
		linux,phandle = <0xae>;
		phandle = <0xae>;
	};

	eas {
		eff_turn_point = <0x1d3>;
		tiny = <0x32>;
	};

	eem_fsm@1100b000 {
		compatible = "mediatek,eem_fsm";
		interrupts = <0x0 0x7d 0x8>;
		reg = <0x0 0x1100b000 0x0 0x1000>;
	};

	efuse_dbg@10004000 {
		compatible = "mediatek,efuse_dbg";
		reg = <0x0 0x10004000 0x0 0x1000>;
	};

	efusec@11c50000 {
		compatible = "mediatek,efusec";
		reg = <0x0 0x11c50000 0x0 0x10000>;
	};

	emi@10219000 {
		compatible = "mediatek,emi";
		interrupts = <0x0 0x90 0x8>;
		reg = <0x0 0x10219000 0x0 0x1000 0x0 0x10226000 0x0 0x1000 0x0 0x1022d000 0x0 0x1000 0x0 0x10235000 0x0 0x1000>;
	};

	fdvt@1502b000 {
		clock-names = "FD_CLK_IMG_FDVT";
		clocks = <0x43 0x2>;
		compatible = "mediatek,fdvt";
		interrupts = <0x0 0x102 0x8>;
		reg = <0x0 0x1502b000 0x0 0x1000>;
	};

	fhctl@1000ce00 {
		compatible = "mediatek,fhctl";
		reg = <0x0 0x1000ce00 0x0 0x200>;
	};

	fingerprint {
		compatible = "mediatek,goodix-fp";
		linux,phandle = <0x79>;
		phandle = <0x79>;
	};

	flashlight_core {
		compatible = "mediatek,flashlight_core";
		linux,phandle = <0x9b>;
		phandle = <0x9b>;
	};

	flashlights_mt6370 {
		compatible = "mediatek,flashlights_mt6370";
		decouple = <0x0>;
		linux,phandle = <0x9c>;
		phandle = <0x9c>;

		channel@1 {
			ct = <0x0>;
			part = <0x0>;
			type = <0x0>;
		};

		channel@2 {
			ct = <0x1>;
			part = <0x0>;
			type = <0x0>;
		};
	};

	gauge_timer {
		compatible = "mediatek,gauge_timer_service";
	};

	gce@10238000 {
		#clock-cells = <0x1>;
		ap_dma_base = <0x18010000 0x17 0xffff0000>;
		audio_base = <0x17000000 0x12 0xffff0000>;
		buf_underrun_event_0 = <0x8c>;
		camsys1_base = <0x180a0000 0x1c 0xffff0000>;
		camsys2_base = <0x180b0000 0x1d 0xffff0000>;
		camsys_base = <0x18080000 0x1b 0xffff0000>;
		clock-names = "GCE", "GCE_TIMER";
		clocks = <0x24 0x9 0x24 0x18>;
		compatible = "mediatek,gce", "syscon";
		conn_peri_base = <0x18820000 0x7 0xffff0000>;
		dip_cq_thread0_frame_done = <0x101>;
		dip_cq_thread10_frame_done = <0x10b>;
		dip_cq_thread11_frame_done = <0x10c>;
		dip_cq_thread12_frame_done = <0x10d>;
		dip_cq_thread13_frame_done = <0x10e>;
		dip_cq_thread14_frame_done = <0x10f>;
		dip_cq_thread15_frame_done = <0x110>;
		dip_cq_thread16_frame_done = <0x111>;
		dip_cq_thread17_frame_done = <0x112>;
		dip_cq_thread18_frame_done = <0x113>;
		dip_cq_thread1_frame_done = <0x102>;
		dip_cq_thread2_frame_done = <0x103>;
		dip_cq_thread3_frame_done = <0x104>;
		dip_cq_thread4_frame_done = <0x105>;
		dip_cq_thread5_frame_done = <0x106>;
		dip_cq_thread6_frame_done = <0x107>;
		dip_cq_thread7_frame_done = <0x108>;
		dip_cq_thread8_frame_done = <0x109>;
		dip_cq_thread9_frame_done = <0x10a>;
		disp_2l_ovl0_frame_done = <0x1c>;
		disp_2l_ovl0_sof = <0x8>;
		disp_aal0_frame_done = <0x22>;
		disp_aal0_sof = <0xd>;
		disp_ccorr0_frame_done = <0x21>;
		disp_ccorr0_sof = <0xc>;
		disp_color0_frame_done = <0x20>;
		disp_color0_sof = <0xb>;
		disp_dither0_frame_done = <0x24>;
		disp_dither0_sof = <0xf>;
		disp_dither_base = <0x14010000 0x2 0xffff0000>;
		disp_dsi0_frame_done = <0x25>;
		disp_dsi0_sof = <0x10>;
		disp_gamma0_frame_done = <0x23>;
		disp_gamma0_sof = <0xe>;
		disp_ovl0_frame_done = <0x1b>;
		disp_ovl0_frame_rst_done_pusle = <0x98>;
		disp_ovl0_sof = <0x7>;
		disp_pwm0_sof = <0x13>;
		disp_rdma0_frame_done = <0x1e>;
		disp_rdma0_sof = <0x9>;
		disp_rsz0_frame_done = <0x1d>;
		disp_rsz0_sof = <0x11>;
		disp_wdma0_frame_done = <0x1f>;
		disp_wdma0_rst_done = <0x93>;
		disp_wdma0_sof = <0xa>;
		dsi0_done_event = <0x8f>;
		dsi0_irq_event = <0x8e>;
		dsi0_te_event = <0x8d>;
		dve_frame_done = <0x114>;
		g3d_config_base = <0x13000000 0x0 0xffff0000>;
		gce_base = <0x18020000 0x18 0xffff0000>;
		gcpu_base = <0x10050000 0xf 0xffff0000>;
		img_dl_relay_sof = <0x12>;
		imgsys_base = <0x15020000 0x4 0xffff0000>;
		infra_na3_base = <0x10010000 0xb 0xffff0000>;
		infra_na4_base = <0x10020000 0xc 0xffff0000>;
		interrupts = <0x0 0x9a 0x8 0x0 0x9b 0x8>;
		jpgdec_done = <0x123>;
		jpgenc_done = <0x122>;
		kp_base = <0x18840000 0x9 0xffff0000>;
		linux,phandle = <0x7c>;
		max_prefetch_cnt = <0x1>;
		mboxes = <0x30 0x0 0x0 0x4 0x30 0x1 0x0 0x4 0x30 0x2 0x0 0x5 0x30 0x3 0x0 0x4 0x30 0x4 0x0 0x4 0x30 0x5 0x0 0x4 0x30 0x6 0x0 0x3 0x30 0x7 0xffffffff 0x2 0x31 0x8 0x0 0x4 0x31 0x9 0x0 0x4 0x31 0xa 0x0 0x1 0x30 0xb 0x0 0x1 0x30 0xc 0x0 0x1 0x30 0xd 0x0 0x1 0x30 0xe 0x0 0x1 0x30 0xf 0xffffffff 0x1>;
		mcucfg_base = <0x10040000 0xe 0xffff0000>;
		mdp_ccorr0 = <0x2e>;
		mdp_ccorr0_frame_done = <0x15>;
		mdp_ccorr0_sof = <0x1>;
		mdp_color0 = <0x2d>;
		mdp_rdma0 = <0x27>;
		mdp_rdma0_frame_done = <0x14>;
		mdp_rdma0_rst_done = <0x97>;
		mdp_rdma0_sof = <0x0>;
		mdp_rsz0 = <0x28>;
		mdp_rsz0_frame_done = <0x16>;
		mdp_rsz0_sof = <0x2>;
		mdp_rsz1 = <0x29>;
		mdp_rsz1_frame_done = <0x17>;
		mdp_rsz1_sof = <0x3>;
		mdp_tdshp0 = <0x2c>;
		mdp_tdshp0_frame_done = <0x1a>;
		mdp_tdshp0_sof = <0x6>;
		mdp_wdma0 = <0x2a>;
		mdp_wdma_frame_done = <0x19>;
		mdp_wdma_rst_done = <0x94>;
		mdp_wdma_sof = <0x4>;
		mdp_wrot0 = <0x2b>;
		mdp_wrot0_rst_done = <0x95>;
		mdp_wrot0_sof = <0x5>;
		mdp_wrot0_write_frame_done = <0x18>;
		mediatek,mailbox-gce = <0x30>;
		mipitx0_base = <0x11c80000 0x63 0xffff0000>;
		mm_mutex = <0x2f>;
		mm_na_base = <0x14020000 0x3 0xffff0000>;
		mmsys_config = <0x26>;
		mmsys_config_base = <0x14000000 0x1 0xffff0000>;
		msdc2_base = <0x17020000 0x14 0xffff0000>;
		msdc3_base = <0x18000000 0x16 0xffff0000>;
		phandle = <0x7c>;
		prefetch_size = <0x60>;
		pwm_sw_base = <0x1100e000 0x63 0xffff0000>;
		reg = <0x0 0x10238000 0x0 0x4000>;
		rsc_frame_done = <0x116>;
		scp_base = <0x10030000 0xd 0xffff0000>;
		scp_sram_base = <0x10000000 0xa 0xffff0000>;
		secure_thread = <0x8 0xa>;
		sram_share_cnt = <0x1>;
		sram_share_engine = <0xa>;
		sram_share_event = <0x2c6>;
		sram_size_cpr_64 = <0x40>;
		stream_done_0 = <0x82>;
		stream_done_1 = <0x83>;
		stream_done_2 = <0x84>;
		stream_done_3 = <0x85>;
		stream_done_4 = <0x86>;
		stream_done_5 = <0x87>;
		stream_done_6 = <0x88>;
		stream_done_7 = <0x89>;
		stream_done_8 = <0x8a>;
		stream_done_9 = <0x8b>;
		thread_count = <0x10>;
		topckgen_base = <0x18830000 0x8 0xffff0000>;
		usb0_base = <0x10200000 0x10 0xffff0000>;
		usb_sif_base = <0x10280000 0x11 0xffff0000>;
		vdec1_base = <0x17030000 0x15 0xffff0000>;
		vdec2_base = <0x18040000 0x19 0xffff0000>;
		vdec3_base = <0x18050000 0x1a 0xffff0000>;
		vdec_base = <0x17010000 0x13 0xffff0000>;
		vdec_gcon_base = <0x18800000 0x5 0xffff0000>;
		venc_128byte_cnt_done = <0x125>;
		venc_done = <0x121>;
		venc_gcon_base = <0x18810000 0x6 0xffff0000>;
		venc_mb_done = <0x124>;
		wmf_frame_done = <0x115>;
	};

	gce_mbox@10238000 {
		#gce-event-cells = <0x1>;
		#gce-subsys-cells = <0x2>;
		#mbox-cells = <0x3>;
		clock-names = "gce", "GCE_TIMER";
		clocks = <0x24 0x9 0x24 0x18>;
		compatible = "mediatek,mailbox-gce";
		interrupts = <0x0 0x9a 0x8 0x0 0x9b 0x8>;
		linux,phandle = <0x30>;
		phandle = <0x30>;
		reg = <0x0 0x10238000 0x0 0x4000>;
	};

	gce_mbox_svp@10238000 {
		#mbox-cells = <0x3>;
		clock-names = "gce", "GCE_TIMER";
		clocks = <0x24 0x9 0x24 0x18>;
		compatible = "mediatek,mailbox-gce-svp";
		interrupts = <0x0 0x9a 0x8 0x0 0x9b 0x8>;
		linux,phandle = <0x31>;
		phandle = <0x31>;
		reg = <0x0 0x10238000 0x0 0x4000>;
	};

	gic500@0c000000 {
		compatible = "mediatek,gic500";
		reg = <0x0 0xc000000 0x0 0x1000>;
	};

	gic_cpu@0c400000 {
		compatible = "mediatek,gic_cpu";
		reg = <0x0 0xc400000 0x0 0x40000>;
	};

	gpio {
		compatible = "mediatek,gpio_usage_mapping";
		linux,phandle = <0x51>;
		phandle = <0x51>;
	};

	gpio@10005000 {
		compatible = "mediatek,gpio";
		linux,phandle = <0x52>;
		phandle = <0x52>;
		reg = <0x0 0x10005000 0x0 0x1000>;
	};

	gps {
		compatible = "mediatek,gps";
	};

	gpufreq {
		clock-names = "clk_mux", "clk_main_parent", "clk_sub_parent", "mtcmos_mfg_async", "mtcmos_mfg", "mtcmos_mfg_core0";
		clocks = <0x1e 0x64 0x1e 0x26 0x1f 0x25 0x8 0x25 0x4 0x25 0x7>;
		compatible = "mediatek,mt6765-gpufreq";
	};

	hacc@1000a000 {
		compatible = "mediatek,hacc";
		interrupts = <0x0 0xbd 0x8>;
		reg = <0x0 0x1000a000 0x0 0x1000>;
	};

	i2c0@11007000 {
		aed = <0x1a>;
		clock-div = <0x5>;
		clock-names = "main", "dma";
		clocks = <0x24 0xb 0x24 0x26>;
		compatible = "mediatek,i2c";
		eh_cfg = <0x20>;
		gpio_start = <0x10002a00>;
		id = <0x0>;
		interrupts = <0x0 0x54 0x8>;
		linux,phandle = <0x81>;
		mediatek,hs_only;
		mem_len = <0x200>;
		phandle = <0x81>;
		pu_cfg = <0x50>;
		reg = <0x0 0x11007000 0x0 0x1000 0x0 0x11000080 0x0 0x80>;
		rsel_cfg = <0x70>;
		scl-gpio-id = <0x53>;
		sda-gpio-id = <0x52>;
	};

	i2c1@11008000 {
		aed = <0x1a>;
		clock-div = <0x5>;
		clock-names = "main", "dma";
		clocks = <0x24 0xb 0x24 0x26>;
		compatible = "mediatek,i2c";
		eh_cfg = <0x20>;
		gpio_start = <0x10002a00>;
		id = <0x1>;
		interrupts = <0x0 0x55 0x8>;
		linux,phandle = <0x82>;
		mediatek,hs_only;
		mem_len = <0x200>;
		phandle = <0x82>;
		pu_cfg = <0x50>;
		reg = <0x0 0x11008000 0x0 0x1000 0x0 0x11000100 0x0 0x80>;
		rsel_cfg = <0x70>;
		scl-gpio-id = <0x54>;
		sda-gpio-id = <0x51>;
	};

	i2c2@11009000 {
		aed = <0x1a>;
		ch_offset_ccu = <0x200>;
		ch_offset_default = <0x100>;
		clock-div = <0x5>;
		clock-names = "main", "dma";
		clocks = <0x24 0xb 0x24 0x26>;
		compatible = "mediatek,i2c";
		eh_cfg = <0x20>;
		gpio_start = <0x10002800>;
		id = <0x2>;
		interrupts = <0x0 0x56 0x8>;
		linux,phandle = <0x83>;
		mediatek,hs_only;
		mem_len = <0x200>;
		phandle = <0x83>;
		pu_cfg = <0x60>;
		reg = <0x0 0x11009000 0x0 0x1000 0x0 0x11000180 0x0 0x180>;
		rsel_cfg = <0xa0>;
		scl-gpio-id = <0x67>;
		sda-gpio-id = <0x68>;
	};

	i2c3@1100f000 {
		aed = <0x1a>;
		ch_offset_default = <0x100>;
		clock-div = <0x5>;
		clock-names = "main", "dma";
		clocks = <0x24 0xb 0x24 0x26>;
		compatible = "mediatek,i2c";
		eh_cfg = <0x20>;
		gpio_start = <0x10002600>;
		id = <0x3>;
		interrupts = <0x0 0x57 0x8>;
		linux,phandle = <0x84>;
		mediatek,hs_only;
		mem_len = <0x200>;
		phandle = <0x84>;
		pu_cfg = <0x90>;
		reg = <0x0 0x1100f000 0x0 0x1000 0x0 0x11000300 0x0 0x100>;
		rsel_cfg = <0xb0>;
		scl-gpio-id = <0x32>;
		sda-gpio-id = <0x33>;
	};

	i2c4@11011000 {
		aed = <0x1a>;
		ch_offset_ccu = <0x200>;
		ch_offset_default = <0x100>;
		clock-div = <0x5>;
		clock-names = "main", "dma";
		clocks = <0x24 0xb 0x24 0x26>;
		compatible = "mediatek,i2c";
		eh_cfg = <0x20>;
		gpio_start = <0x10002800>;
		id = <0x4>;
		interrupts = <0x0 0x58 0x8>;
		linux,phandle = <0x85>;
		mediatek,hs_only;
		mem_len = <0x200>;
		phandle = <0x85>;
		pu_cfg = <0x60>;
		reg = <0x0 0x11011000 0x0 0x1000 0x0 0x11000400 0x0 0x180>;
		rsel_cfg = <0xa0>;
		scl-gpio-id = <0x69>;
		sda-gpio-id = <0x6a>;
	};

	i2c5@11016000 {
		aed = <0x1a>;
		clock-div = <0x5>;
		clock-names = "main", "dma";
		clocks = <0x24 0xb 0x24 0x26>;
		compatible = "mediatek,i2c";
		eh_cfg = <0x20>;
		gpio_start = <0x10002600>;
		id = <0x5>;
		interrupts = <0x0 0x82 0x8>;
		linux,phandle = <0x86>;
		mediatek,hs_only;
		mem_len = <0x200>;
		phandle = <0x86>;
		pu_cfg = <0x90>;
		reg = <0x0 0x11016000 0x0 0x1000 0x0 0x11000580 0x0 0x80>;
		rsel_cfg = <0xb0>;
		scl-gpio-id = <0x30>;
		sda-gpio-id = <0x31>;
	};

	i2c6@1100d000 {
		aed = <0x1a>;
		ch_offset_ccu = <0x200>;
		ch_offset_default = <0x100>;
		clock-div = <0x5>;
		clock-names = "main", "dma";
		clocks = <0x24 0xb 0x24 0x26>;
		compatible = "mediatek,i2c";
		eh_cfg = <0x20>;
		gpio_start = <0x10002c00>;
		id = <0x6>;
		interrupts = <0x0 0x83 0x8>;
		linux,phandle = <0x87>;
		mediatek,hs_only;
		mem_len = <0x200>;
		phandle = <0x87>;
		pu_cfg = <0x50>;
		reg = <0x0 0x1100d000 0x0 0x1000 0x0 0x11000600 0x0 0x80>;
		rsel_cfg = <0x70>;
		scl-gpio-id = <0xa1>;
		sda-gpio-id = <0xa2>;
	};

	i2c7 {
		linux,phandle = <0xa7>;
		phandle = <0xa7>;
	};

	i2c8 {
		linux,phandle = <0xa8>;
		phandle = <0xa8>;
	};

	i2c9 {
		linux,phandle = <0xa9>;
		phandle = <0xa9>;
	};

	i2c_common {
		check_max_freq = [01];
		cnt_constraint = [01];
		compatible = "mediatek,i2c_common";
		dma_support = [02];
		ext_time_config = [18 01];
		idvfs = [01];
		linux,phandle = <0x80>;
		phandle = <0x80>;
		set_dt_div = [01];
		set_ltiming = [01];
		ver = [02];
	};

	imgsys@15020000 {
		#clock-cells = <0x1>;
		clock-names = "ISP_SCP_SYS_DIS", "ISP_SCP_SYS_ISP", "ISP_SCP_SYS_CAM", "ISP_CLK_IMG_DIP", "ISP_CLK_CAM", "ISP_CLK_CAMTG", "ISP_CLK_CAM_SENINF", "ISP_CLK_CAMSV0", "ISP_CLK_CAMSV1", "ISP_CLK_CAMSV2";
		clocks = <0x25 0x3 0x25 0x5 0x25 0x9 0x43 0x1 0x44 0x2 0x44 0x3 0x44 0x4 0x44 0x5 0x44 0x6 0x44 0x7>;
		compatible = "mediatek,imgsys", "syscon";
		linux,phandle = <0x43>;
		phandle = <0x43>;
		reg = <0x0 0x15020000 0x0 0x1000>;
	};

	imp_iic@11017000 {
		compatible = "mediatek,imp_iic";
		reg = <0x0 0x11017000 0x0 0x1000>;
	};

	infra_mbist@1020d000 {
		compatible = "mediatek,infra_mbist";
		reg = <0x0 0x1020d000 0x0 0x1000>;
	};

	infracfg@1020e000 {
		compatible = "mediatek,infracfg";
		reg = <0x0 0x1020e000 0x0 0x1000>;
	};

	infracfg_ao@10001000 {
		#clock-cells = <0x1>;
		compatible = "mediatek,infracfg_ao", "syscon";
		interrupts = <0x0 0x93 0x1>;
		linux,phandle = <0x24>;
		phandle = <0x24>;
		reg = <0x0 0x10001000 0x0 0x1000>;
	};

	interrupt-controller@0c000000 {
		#address-cells = <0x2>;
		#interrupt-cells = <0x3>;
		#redistributor-regions = <0x1>;
		#size-cells = <0x2>;
		compatible = "arm,gic-v3";
		interrupt-controller;
		interrupt-parent = <0x11>;
		interrupts = <0x1 0x9 0x4>;
		linux,phandle = <0x11>;
		phandle = <0x11>;
		reg = <0x0 0xc000000 0x0 0x40000 0x0 0xc100000 0x0 0x200000 0x0 0x10200a80 0x0 0x50>;
	};

	intpol-controller@10200a80 {
		#interrupt-cells = <0x3>;
		compatible = "mediatek,mt6577-sysirq";
		interrupt-controller;
		interrupt-parent = <0x11>;
		linux,phandle = <0x1>;
		phandle = <0x1>;
		reg = <0x0 0x10200a80 0x0 0x50>;
	};

	io_cfg_bl@10002600 {
		compatible = "mediatek,io_cfg_bl";
		reg = <0x0 0x10002600 0x0 0x200>;
	};

	io_cfg_lb@10002400 {
		compatible = "mediatek,io_cfg_lb";
		reg = <0x0 0x10002400 0x0 0x200>;
	};

	io_cfg_lm@10002200 {
		compatible = "mediatek,io_cfg_lm";
		reg = <0x0 0x10002200 0x0 0x200>;
	};

	io_cfg_lt@10002000 {
		compatible = "mediatek,io_cfg_lt";
		reg = <0x0 0x10002000 0x0 0x200>;
	};

	io_cfg_rb@10002a00 {
		compatible = "mediatek,io_cfg_rb";
		reg = <0x0 0x10002a00 0x0 0x200>;
	};

	io_cfg_rr@10002800 {
		compatible = "mediatek,io_cfg_rr";
		reg = <0x0 0x10002800 0x0 0x200>;
	};

	io_cfg_rt@10002c00 {
		compatible = "mediatek,io_cfg_rt";
		reg = <0x0 0x10002c00 0x0 0x200>;
	};

	iocfg_0@10002000 {
		compatible = "mediatek,iocfg_0";
		reg = <0x0 0x10002000 0x0 0x200>;
	};

	iocfg_1@10002200 {
		compatible = "mediatek,iocfg_1";
		reg = <0x0 0x10002200 0x0 0x200>;
	};

	iocfg_2@10002400 {
		compatible = "mediatek,iocfg_2";
		reg = <0x0 0x10002400 0x0 0x200>;
	};

	iocfg_3@10002600 {
		compatible = "mediatek,iocfg_3";
		reg = <0x0 0x10002600 0x0 0x200>;
	};

	iocfg_4@10002800 {
		compatible = "mediatek,iocfg_4";
		reg = <0x0 0x10002800 0x0 0x200>;
	};

	iocfg_5@10002a00 {
		compatible = "mediatek,iocfg_5";
		reg = <0x0 0x10002a00 0x0 0x200>;
	};

	irq_nfc {
		compatible = "mediatek,irq_nfc-eint";
		linux,phandle = <0x97>;
		phandle = <0x97>;
	};

	irtx_pwm {
		compatible = "mediatek,irtx-pwm";
		linux,phandle = <0xa4>;
		phandle = <0xa4>;
		pwm_ch = <0x0>;
		pwm_data_invert = <0x0>;
	};

	kd_camera_hw1@1a040000 {
		clock-names = "CLK_TOP_CAMTG_SEL", "CLK_TOP_CAMTG1_SEL", "CLK_TOP_CAMTG2_SEL", "CLK_TOP_CAMTG3_SEL", "CLK_MCLK_6M", "CLK_MCLK_12M", "CLK_MCLK_13M", "CLK_MCLK_48M", "CLK_MCLK_52M", "CLK_MCLK_24M", "CLK_MCLK_26M", "CLK_CAM_SENINF_CG", "CLK_MIPI_C0_26M_CG", "CLK_MIPI_C1_26M_CG", "CLK_MIPI_ANA_0A_CG", "CLK_MIPI_ANA_0B_CG", "CLK_MIPI_ANA_1A_CG", "CLK_MIPI_ANA_1B_CG", "CLK_MIPI_ANA_2A_CG", "CLK_MIPI_ANA_2B_CG", "CLK_TOP_CAMTM_SEL_CG", "CLK_TOP_CAMTM_208_CG", "CLK_SCP_SYS_CAM";
		clocks = <0x1e 0x66 0x1e 0x67 0x1e 0x68 0x1e 0x69 0x1e 0x14 0x1e 0x13 0x1e 0x1d 0x1e 0x11 0x1e 0x1c 0x1e 0x12 0x1f 0x44 0x4 0x42 0xe 0x42 0x12 0x46 0x0 0x47 0x0 0x48 0x0 0x49 0x0 0x4a 0x0 0x4b 0x0 0x1e 0x7d 0x1e 0x1a 0x25 0x9>;
		compatible = "mediatek,camera_hw";
		linux,phandle = <0x9a>;
		phandle = <0x9a>;
		reg = <0x0 0x1a040000 0x0 0x1000>;
	};

	kp@10010000 {
		compatible = "mediatek,kp";
		interrupts = <0x0 0xb4 0x2>;
		linux,phandle = <0x1a>;
		phandle = <0x1a>;
		reg = <0x0 0x10010000 0x0 0x1000>;
	};

	l2c_parity {
		compatible = "mediatek,l2c_parity-v1";
		interrupts = <0x0 0x18 0x4 0x0 0x19 0x4>;
	};

	lk_charger {
		ac_charger_current = <0x1f47d0>;
		ac_charger_input_current = <0x30d400>;
		charging_host_charger_current = <0x16e360>;
		compatible = "mediatek,lk_charger";
		enable_anime;
		enable_pd20_reset;
		enable_pe_plus;
		fast_charge_voltage = <0x2dc6c0>;
		linux,phandle = <0x9e>;
		max_charger_voltage = <0x632ea0>;
		non_std_ac_charger_current = <0x7a120>;
		pd_charger_current = <0x7a120>;
		phandle = <0x9e>;
		power_path_support;
		ta_ac_charger_current = <0x2dc6c0>;
		temp_t1_threshold = <0x0>;
		temp_t3_threshold = <0x2d>;
		temp_t4_threshold = <0x32>;
		usb_charger_current = <0x7a120>;
	};

	m4u@10205000 {
		#iommu-cells = <0x1>;
		cell-index = <0x0>;
		compatible = "mediatek,iommu_v0";
		interrupts = <0x0 0x9e 0x8>;
		linux,phandle = <0x4c>;
		mediatek,larbs = <0x20 0x21 0x22 0x23>;
		phandle = <0x4c>;
		reg = <0x0 0x10205000 0x0 0x1000>;
	};

	mbist@17050000 {
		compatible = "mediatek,mbist";
		reg = <0x0 0x17050000 0x0 0x10000>;
	};

	mbist_ao@10013000 {
		compatible = "mediatek,mbist_ao";
		reg = <0x0 0x10013000 0x0 0x1000>;
	};

	mcdi@0010fc00 {
		compatible = "mediatek,mt6765-mcdi";
		reg = <0x0 0x10fc00 0x0 0x800>;
	};

	mcucfg@10200000 {
		compatible = "mediatek,mcucfg";
		interrupts = <0x0 0x0 0x8>;
		reg = <0x0 0x10200000 0x0 0x1000>;
	};

	mcucfg_mp0_counter@10200000 {
		compatible = "mediatek,mcucfg_mp0_counter";
		reg = <0x0 0x10200000 0x0 0x4000>;
	};

	mcupm_reg@10216000 {
		compatible = "mediatek,mcupm_reg";
		reg = <0x0 0x10216000 0x0 0x1000>;
	};

	mcupm_sram0@10217000 {
		compatible = "mediatek,mcupm_sram0";
		reg = <0x0 0x10217000 0x0 0x1000>;
	};

	mcupm_sram1@10218000 {
		compatible = "mediatek,mcupm_sram1";
		reg = <0x0 0x10218000 0x0 0x1000>;
	};

	mcupm_sram2@10211000 {
		compatible = "mediatek,mcupm_sram2";
		reg = <0x0 0x10211000 0x0 0x1000>;
	};

	mcupm_sram3@10213000 {
		compatible = "mediatek,mcupm_sram3";
		reg = <0x0 0x10213000 0x0 0x1000>;
	};

	md1_sim1_hot_plug_eint {
		linux,phandle = <0xab>;
		phandle = <0xab>;
	};

	md1_sim2_hot_plug_eint {
		linux,phandle = <0xac>;
		phandle = <0xac>;
	};

	md_ccif0@1020a000 {
		compatible = "mediatek,md_ccif0";
		reg = <0x0 0x1020a000 0x0 0x1000>;
	};

	md_ccif1@1020c000 {
		compatible = "mediatek,md_ccif1";
		reg = <0x0 0x1020c000 0x0 0x1000>;
	};

	md_ccif2@1023d000 {
		compatible = "mediatek,md_ccif2";
		reg = <0x0 0x1023d000 0x0 0x1000>;
	};

	md_ccif3@1023f000 {
		compatible = "mediatek,md_ccif3";
		reg = <0x0 0x1023f000 0x0 0x1000>;
	};

	mdcldma@10014000 {
		clock-names = "scp-sys-md1-main", "infra-cldma-bclk", "infra-ccif-ap", "infra-ccif-md", "infra-ccif1-ap", "infra-ccif1-md", "infra-ccif2-ap", "infra-ccif2-md";
		clocks = <0x25 0x0 0x24 0x32 0x24 0x29 0x24 0x2c 0x24 0x23 0x24 0x24 0x24 0x51 0x24 0x52>;
		compatible = "mediatek,mdcldma";
		interrupts = <0x0 0xa5 0x4 0x0 0x94 0x8 0x0 0x95 0x8 0x0 0x105 0x2>;
		linux,phandle = <0x1c>;
		mediatek,cldma_capability = <0x6>;
		mediatek,md_id = <0x0>;
		phandle = <0x1c>;
		reg = <0x0 0x10014000 0x0 0x1000 0x0 0x1021b000 0x0 0x1000 0x0 0x10209000 0x0 0x1000 0x0 0x1020a000 0x0 0x1000>;
	};

	mdcldmain@1021c000 {
		compatible = "mediatek,mdcldmain";
		reg = <0x0 0x1021c000 0x0 0x400>;
	};

	mdcldmain_ao@10015000 {
		compatible = "mediatek,mdcldmain_ao";
		reg = <0x0 0x10015000 0x0 0x400>;
	};

	mdcldmamisc@1021c800 {
		compatible = "mediatek,mdcldmamisc";
		reg = <0x0 0x1021c800 0x0 0x1000>;
	};

	mdcldmamisc_ao@10015800 {
		compatible = "mediatek,mdcldmamisc_ao";
		reg = <0x0 0x10015800 0x0 0x400>;
	};

	mdcldmaout@1021c400 {
		compatible = "mediatek,mdcldmaout";
		reg = <0x0 0x1021c400 0x0 0x400>;
	};

	mdcldmaout_ao@10015400 {
		compatible = "mediatek,mdcldmaout_ao";
		reg = <0x0 0x10015400 0x0 0x400>;
	};

	mdp_ccorr0@14005000 {
		clock-names = "MDP_CCORR";
		clocks = <0x26 0x1>;
		compatible = "mediatek,mdp_ccorr0";
		interrupts = <0x0 0xe2 0x8>;
		linux,phandle = <0x2e>;
		phandle = <0x2e>;
		reg = <0x0 0x14005000 0x0 0x1000>;
	};

	mdp_rdma0@14004000 {
		clock-names = "MDP_RDMA0";
		clocks = <0x26 0x0>;
		compatible = "mediatek,mdp_rdma0";
		interrupts = <0x0 0xd3 0x8>;
		linux,phandle = <0x27>;
		phandle = <0x27>;
		reg = <0x0 0x14004000 0x0 0x1000>;
	};

	mdp_rsz0@14006000 {
		clock-names = "MDP_RSZ0";
		clocks = <0x26 0x2>;
		compatible = "mediatek,mdp_rsz0";
		interrupts = <0x0 0xd4 0x8>;
		linux,phandle = <0x28>;
		phandle = <0x28>;
		reg = <0x0 0x14006000 0x0 0x1000>;
	};

	mdp_rsz1@14007000 {
		clock-names = "MDP_RSZ1";
		clocks = <0x26 0x3>;
		compatible = "mediatek,mdp_rsz1";
		interrupts = <0x0 0xd5 0x8>;
		linux,phandle = <0x29>;
		phandle = <0x29>;
		reg = <0x0 0x14007000 0x0 0x1000>;
	};

	mdp_tdshp0@1400a000 {
		clock-names = "MDP_TDSHP";
		clocks = <0x26 0x4>;
		compatible = "mediatek,mdp_tdshp0";
		linux,phandle = <0x2c>;
		phandle = <0x2c>;
		reg = <0x0 0x1400a000 0x0 0x1000>;
	};

	mdp_wdma0@14008000 {
		clock-names = "MDP_WDMA";
		clocks = <0x26 0x6>;
		compatible = "mediatek,mdp_wdma0";
		interrupts = <0x0 0xd8 0x8>;
		linux,phandle = <0x2a>;
		phandle = <0x2a>;
		reg = <0x0 0x14008000 0x0 0x1000>;
	};

	mdp_wrot0@14009000 {
		clock-names = "MDP_WROT0";
		clocks = <0x26 0x5>;
		compatible = "mediatek,mdp_wrot0";
		interrupts = <0x0 0xd7 0x8>;
		linux,phandle = <0x2b>;
		phandle = <0x2b>;
		reg = <0x0 0x14009000 0x0 0x1000>;
	};

	memory {
		device_type = "memory";
		reg = <0x0 0x40000000 0x0 0x20000000>;
	};

	mfg_cfg@13ffe000 {
		#clock-cells = <0x1>;
		compatible = "mediatek,mfgcfg", "syscon";
		linux,phandle = <0x95>;
		phandle = <0x95>;
		reg = <0x0 0x13ffe000 0x0 0x1000>;
	};

	mfg_doma@13000000 {
		clock-frequency = <0x21f98280>;
		compatible = "mediatek,doma";
		interrupt-names = "RGX";
		interrupts = <0x0 0x103 0x8>;
		reg = <0x0 0x13000000 0x0 0x80000>;
	};

	mipi_rx_ana_csi0a@11c10000 {
		#clock-cells = <0x1>;
		compatible = "mediatek,mipi_rx_ana_csi0a", "syscon";
		linux,phandle = <0x46>;
		phandle = <0x46>;
		reg = <0x0 0x11c10000 0x0 0x1000>;
	};

	mipi_rx_ana_csi0b@11c11000 {
		#clock-cells = <0x1>;
		compatible = "mediatek,mipi_rx_ana_csi0b", "syscon";
		linux,phandle = <0x47>;
		phandle = <0x47>;
		reg = <0x0 0x11c11000 0x0 0x1000>;
	};

	mipi_rx_ana_csi1a@11c12000 {
		#clock-cells = <0x1>;
		compatible = "mediatek,mipi_rx_ana_csi1a", "syscon";
		linux,phandle = <0x48>;
		phandle = <0x48>;
		reg = <0x0 0x11c12000 0x0 0x1000>;
	};

	mipi_rx_ana_csi1b@11c13000 {
		#clock-cells = <0x1>;
		compatible = "mediatek,mipi_rx_ana_csi1b", "syscon";
		linux,phandle = <0x49>;
		phandle = <0x49>;
		reg = <0x0 0x11c13000 0x0 0x1000>;
	};

	mipi_rx_ana_csi2a@11c14000 {
		#clock-cells = <0x1>;
		compatible = "mediatek,mipi_rx_ana_csi2a", "syscon";
		linux,phandle = <0x4a>;
		phandle = <0x4a>;
		reg = <0x0 0x11c14000 0x0 0x1000>;
	};

	mipi_rx_ana_csi2b@11c15000 {
		#clock-cells = <0x1>;
		compatible = "mediatek,mipi_rx_ana_csi2b", "syscon";
		linux,phandle = <0x4b>;
		phandle = <0x4b>;
		reg = <0x0 0x11c15000 0x0 0x1000>;
	};

	mipi_tx0@11c80000 {
		compatible = "mediatek,mipi_tx0";
		reg = <0x0 0x11c80000 0x0 0x10000>;
	};

	mmdvfs_pmqos {
		cam_freq = "mm_step0", "mm_step1", "mm_step2";
		clock-names = "mmdvfs_clk_mm_sel_ck", "mmdvfs_clk_mmpll_ck", "mmdvfs_clk_univpll1_d2_ck", "mmdvfs_clk_mmpll_d2_ck";
		clocks = <0x1e 0x62 0x1e 0x21 0x1e 0x17 0x1e 0x22>;
		compatible = "mediatek,mmdvfs_pmqos";
		disp_freq = "mm_step0", "mm_step1", "mm_step2";
		img_freq = "mm_step0", "mm_step1", "mm_step2";
		mdp_freq = "mm_step0", "mm_step1", "mm_step2";
		mm_step0 = <0x1c9 0x1 0x0 0x1>;
		mm_step1 = <0x138 0x1 0x0 0x2>;
		mm_step2 = <0xe4 0x1 0x0 0x3>;
		vdec_freq = "mm_step0", "mm_step1", "mm_step2";
		venc_freq = "mm_step0", "mm_step1", "mm_step2";
		vopp_steps = <0x0 0x1 0x3>;
	};

	mmsys_config@14000000 {
		#clock-cells = <0x1>;
		clock-names = "CAM_MDP", "IMG_DL_RELAY", "IMG_DL_ASYNC_TOP";
		clocks = <0x26 0x17 0x26 0x1a 0x26 0x1b>;
		compatible = "mediatek,mmsys_config", "syscon";
		interrupts = <0x0 0xe3 0x8>;
		linux,phandle = <0x26>;
		phandle = <0x26>;
		reg = <0x0 0x14000000 0x0 0x1000>;
	};

	mobicore {
		compatible = "trustonic,mobicore";
		interrupts = <0x0 0x10f 0x1>;
	};

	modem_temp_share@10018000 {
		compatible = "mediatek,modem_temp_share";
		reg = <0x0 0x10018000 0x0 0x1000>;
	};

	mrdump_ext_rst {
		compatible = "mediatek, mrdump_ext_rst-eint";
		force_mode = "EINT";
		linux,phandle = <0x76>;
		mode = "IRQ";
		phandle = <0x76>;
		status = "okay";
	};

	msdc0_pad_macro@11cd0000 {
		compatible = "mediatek,msdc0_pad_macro";
		reg = <0x0 0x11cd0000 0x0 0x10000>;
	};

	msdc0_top@11cd0000 {
		compatible = "mediatek,msdc0_top";
		reg = <0x0 0x11cd0000 0x0 0x1000>;
	};

	msdc1_ins@0 {
		compatible = "mediatek,mt6765-sdcard-ins";
		linux,phandle = <0x93>;
		phandle = <0x93>;
	};

	msdc1_pad_macro@11c90000 {
		compatible = "mediatek,msdc1_pad_macro";
		reg = <0x0 0x11c90000 0x0 0x10000>;
	};

	msdc1_top@11c90000 {
		compatible = "mediatek,msdc1_top";
		reg = <0x0 0x11c90000 0x0 0x1000>;
	};

	msdc@11230000 {
		bootable;
		bus-width = <0x8>;
		cap-mmc-highspeed;
		clk_src = [01];
		clock-names = "msdc0-clock", "msdc0-hclock", "msdc0-aes-clock";
		clocks = <0x24 0x4c 0x24 0x1c 0x24 0x44>;
		compatible = "mediatek,msdc";
		host_function = [00];
		index = [00];
		interrupts = <0x0 0x4f 0x8>;
		linux,phandle = <0x8f>;
		max-frequency = <0xbebc200>;
		mmc-ddr-1_8v;
		mmc-hs200-1_8v;
		mmc-hs400-1_8v;
		no-sd;
		no-sdio;
		non-removable;
		phandle = <0x8f>;
		pinctl = <0x33>;
		pinctl_hs200 = <0x35>;
		pinctl_hs400 = <0x34>;
		reg = <0x0 0x11230000 0x0 0x10000>;
		register_setting = <0x36>;
		status = "okay";
		vmmc-supply = <0x37>;
	};

	msdc@11240000 {
		bus-width = <0x4>;
		cap-sd-highspeed;
		cd-gpios = <0x3d 0x1 0x0>;
		cd_level = [01];
		clk_src = [02];
		clock-names = "msdc1-clock", "msdc1-hclock";
		clocks = <0x24 0x4d 0x24 0x1d>;
		compatible = "mediatek,msdc";
		host_function = [01];
		index = [01];
		interrupts = <0x0 0x50 0x8>;
		linux,phandle = <0x90>;
		max-frequency = <0xbebc200>;
		no-mmc;
		no-sdio;
		phandle = <0x90>;
		pinctl = <0x38>;
		pinctl_ddr50 = <0x3b>;
		pinctl_sdr104 = <0x39>;
		pinctl_sdr50 = <0x3a>;
		reg = <0x0 0x11240000 0x0 0x10000>;
		register_setting = <0x3c>;
		sd-uhs-ddr50;
		sd-uhs-sdr104;
		sd-uhs-sdr12;
		sd-uhs-sdr25;
		sd-uhs-sdr50;
		status = "okay";
		vmmc-supply = <0x3e>;
		vqmmc-supply = <0x3f>;
	};

	msdc@11250000 {
		compatible = "mediatek,msdc2";
		linux,phandle = <0x91>;
		phandle = <0x91>;
		reg = <0x0 0x11250000 0x0 0x10000>;
		status = "disable";
	};

	msdc@11260000 {
		compatible = "mediatek,msdc3";
		linux,phandle = <0x92>;
		phandle = <0x92>;
		reg = <0x0 0x11250000 0x0 0x10000>;
		status = "disable";
	};

	mt-pmic {
		compatible = "mediatek,mt_pmic";
		interrupt-controller;
		linux,phandle = <0x56>;
		phandle = <0x56>;

		buck_regulators {

			buck_vcore {
				linux,phandle = <0x5a>;
				phandle = <0x5a>;
				regulator-enable-ramp-delay = <0xdc>;
				regulator-max-microvolt = <0x1406f4>;
				regulator-min-microvolt = <0x7ea5e>;
				regulator-name = "vcore";
				regulator-ramp-delay = <0x186a>;
			};

			buck_vmodem {
				linux,phandle = <0x59>;
				phandle = <0x59>;
				regulator-enable-ramp-delay = <0xdc>;
				regulator-max-microvolt = <0x123716>;
				regulator-min-microvolt = <0x7a120>;
				regulator-name = "vmodem";
				regulator-ramp-delay = <0x186a>;
			};

			buck_vpa {
				linux,phandle = <0x5c>;
				phandle = <0x5c>;
				regulator-enable-ramp-delay = <0xdc>;
				regulator-max-microvolt = <0x37b1d0>;
				regulator-min-microvolt = <0x7a120>;
				regulator-name = "vpa";
				regulator-ramp-delay = <0xc350>;
			};

			buck_vproc {
				linux,phandle = <0x5b>;
				phandle = <0x5b>;
				regulator-enable-ramp-delay = <0xdc>;
				regulator-max-microvolt = <0x1406f4>;
				regulator-min-microvolt = <0x7ea5e>;
				regulator-name = "vproc";
				regulator-ramp-delay = <0x186a>;
			};

			buck_vs1 {
				linux,phandle = <0x58>;
				phandle = <0x58>;
				regulator-enable-ramp-delay = <0xdc>;
				regulator-max-microvolt = <0x2191c0>;
				regulator-min-microvolt = <0x124f80>;
				regulator-name = "vs1";
				regulator-ramp-delay = <0x30d4>;
			};
		};

		ldo_regulators {

			ldo_vaud28 {
				compatible = "regulator-fixed";
				linux,phandle = <0x6d>;
				phandle = <0x6d>;
				regulator-enable-ramp-delay = <0x108>;
				regulator-max-microvolt = <0x2ab980>;
				regulator-min-microvolt = <0x2ab980>;
				regulator-name = "vaud28";
			};

			ldo_vaux18 {
				compatible = "regulator-fixed";
				linux,phandle = <0x6c>;
				phandle = <0x6c>;
				regulator-enable-ramp-delay = <0x108>;
				regulator-max-microvolt = <0x1b7740>;
				regulator-min-microvolt = <0x1b7740>;
				regulator-name = "vaux18";
			};

			ldo_vcama {
				linux,phandle = <0x66>;
				phandle = <0x66>;
				regulator-enable-ramp-delay = <0x108>;
				regulator-max-microvolt = <0x2ab980>;
				regulator-min-microvolt = <0x2625a0>;
				regulator-name = "vcama";
			};

			ldo_vcamd {
				linux,phandle = <0x67>;
				phandle = <0x67>;
				regulator-enable-ramp-delay = <0x108>;
				regulator-max-microvolt = <0x1b7740>;
				regulator-min-microvolt = <0xf4240>;
				regulator-name = "vcamd";
			};

			ldo_vcamio {
				compatible = "regulator-fixed";
				linux,phandle = <0x68>;
				phandle = <0x68>;
				regulator-enable-ramp-delay = <0x108>;
				regulator-max-microvolt = <0x1b7740>;
				regulator-min-microvolt = <0x1b7740>;
				regulator-name = "vcamio";
			};

			ldo_vcn18 {
				compatible = "regulator-fixed";
				linux,phandle = <0x65>;
				phandle = <0x65>;
				regulator-enable-ramp-delay = <0x108>;
				regulator-max-microvolt = <0x1b7740>;
				regulator-min-microvolt = <0x1b7740>;
				regulator-name = "vcn18";
			};

			ldo_vcn28 {
				compatible = "regulator-fixed";
				linux,phandle = <0x64>;
				phandle = <0x64>;
				regulator-enable-ramp-delay = <0x108>;
				regulator-max-microvolt = <0x2ab980>;
				regulator-min-microvolt = <0x2ab980>;
				regulator-name = "vcn28";
			};

			ldo_vcn33_bt {
				linux,phandle = <0x62>;
				phandle = <0x62>;
				regulator-enable-ramp-delay = <0x108>;
				regulator-max-microvolt = <0x3567e0>;
				regulator-min-microvolt = <0x325aa0>;
				regulator-name = "vcn33_bt";
			};

			ldo_vcn33_wifi {
				linux,phandle = <0x63>;
				phandle = <0x63>;
				regulator-enable-ramp-delay = <0x108>;
				regulator-max-microvolt = <0x3567e0>;
				regulator-min-microvolt = <0x325aa0>;
				regulator-name = "vcn33_wifi";
			};

			ldo_vdram {
				linux,phandle = <0x70>;
				phandle = <0x70>;
				regulator-enable-ramp-delay = <0xce4>;
				regulator-max-microvolt = <0x124f80>;
				regulator-min-microvolt = <0x10c8e0>;
				regulator-name = "vdram";
			};

			ldo_vefuse {
				linux,phandle = <0x61>;
				phandle = <0x61>;
				regulator-enable-ramp-delay = <0x108>;
				regulator-max-microvolt = <0x325aa0>;
				regulator-min-microvolt = <0x124f80>;
				regulator-name = "vefuse";
			};

			ldo_vemc {
				linux,phandle = <0x37>;
				phandle = <0x37>;
				regulator-enable-ramp-delay = <0x2c>;
				regulator-max-microvolt = <0x325aa0>;
				regulator-min-microvolt = <0x2c4020>;
				regulator-name = "vemc";
			};

			ldo_vfe28 {
				compatible = "regulator-fixed";
				linux,phandle = <0x5d>;
				phandle = <0x5d>;
				regulator-enable-ramp-delay = <0x108>;
				regulator-max-microvolt = <0x2ab980>;
				regulator-min-microvolt = <0x2ab980>;
				regulator-name = "vfe28";
			};

			ldo_vibr {
				linux,phandle = <0x73>;
				phandle = <0x73>;
				regulator-enable-ramp-delay = <0x2c>;
				regulator-max-microvolt = <0x325aa0>;
				regulator-min-microvolt = <0x124f80>;
				regulator-name = "vibr";
			};

			ldo_vio18 {
				compatible = "regulator-fixed";
				linux,phandle = <0x6f>;
				phandle = <0x6f>;
				regulator-enable-ramp-delay = <0x108>;
				regulator-max-microvolt = <0x1b7740>;
				regulator-min-microvolt = <0x1b7740>;
				regulator-name = "vio18";
			};

			ldo_vio28 {
				compatible = "regulator-fixed";
				linux,phandle = <0x6e>;
				phandle = <0x6e>;
				regulator-enable-ramp-delay = <0x108>;
				regulator-max-microvolt = <0x2ab980>;
				regulator-min-microvolt = <0x2ab980>;
				regulator-name = "vio28";
			};

			ldo_vldo28 {
				linux,phandle = <0x69>;
				phandle = <0x69>;
				regulator-enable-ramp-delay = <0x108>;
				regulator-max-microvolt = <0x2dc6c0>;
				regulator-min-microvolt = <0x2ab980>;
				regulator-name = "vldo28";
			};

			ldo_vmc {
				linux,phandle = <0x3f>;
				phandle = <0x3f>;
				regulator-enable-ramp-delay = <0x2c>;
				regulator-max-microvolt = <0x325aa0>;
				regulator-min-microvolt = <0x1b7740>;
				regulator-name = "vmc";
			};

			ldo_vmch {
				linux,phandle = <0x3e>;
				phandle = <0x3e>;
				regulator-enable-ramp-delay = <0x2c>;
				regulator-max-microvolt = <0x325aa0>;
				regulator-min-microvolt = <0x2c4020>;
				regulator-name = "vmch";
			};

			ldo_vrf12 {
				compatible = "regulator-fixed";
				linux,phandle = <0x60>;
				phandle = <0x60>;
				regulator-enable-ramp-delay = <0x6e>;
				regulator-max-microvolt = <0x124f80>;
				regulator-min-microvolt = <0x124f80>;
				regulator-name = "vrf12";
			};

			ldo_vrf18 {
				compatible = "regulator-fixed";
				linux,phandle = <0x5f>;
				phandle = <0x5f>;
				regulator-enable-ramp-delay = <0x6e>;
				regulator-max-microvolt = <0x1b7740>;
				regulator-min-microvolt = <0x1b7740>;
				regulator-name = "vrf18";
			};

			ldo_vsim1 {
				linux,phandle = <0x71>;
				phandle = <0x71>;
				regulator-enable-ramp-delay = <0x108>;
				regulator-max-microvolt = <0x2f4d60>;
				regulator-min-microvolt = <0x19f0a0>;
				regulator-name = "vsim1";
			};

			ldo_vsim2 {
				linux,phandle = <0x72>;
				phandle = <0x72>;
				regulator-enable-ramp-delay = <0x108>;
				regulator-max-microvolt = <0x2f4d60>;
				regulator-min-microvolt = <0x19f0a0>;
				regulator-name = "vsim2";
			};

			ldo_vsram_others {
				linux,phandle = <0x6a>;
				phandle = <0x6a>;
				regulator-enable-ramp-delay = <0x6e>;
				regulator-max-microvolt = <0x1406f4>;
				regulator-min-microvolt = <0x7ea5e>;
				regulator-name = "vsram_others";
				regulator-ramp-delay = <0x186a>;
			};

			ldo_vsram_proc {
				linux,phandle = <0x6b>;
				phandle = <0x6b>;
				regulator-enable-ramp-delay = <0x6e>;
				regulator-max-microvolt = <0x1406f4>;
				regulator-min-microvolt = <0x7ea5e>;
				regulator-name = "vsram_proc";
				regulator-ramp-delay = <0x186a>;
			};

			ldo_vusb33 {
				linux,phandle = <0x74>;
				phandle = <0x74>;
				regulator-enable-ramp-delay = <0x108>;
				regulator-max-microvolt = <0x2f4d60>;
				regulator-min-microvolt = <0x2dc6c0>;
				regulator-name = "vusb33";
			};

			ldo_vxo22 {
				linux,phandle = <0x5e>;
				phandle = <0x5e>;
				regulator-enable-ramp-delay = <0x6e>;
				regulator-max-microvolt = <0x249f00>;
				regulator-min-microvolt = <0x2191c0>;
				regulator-name = "vxo22";
			};
		};

		mt635x-auxadc {
			#io-channel-cells = <0x1>;
			compatible = "mediatek,mt635x-auxadc";
			linux,phandle = <0x57>;
			phandle = <0x57>;

			accdet {
				channel = <0x9>;
			};

			bat_temp {
				channel = <0x3>;
				resistance-ratio = <0x1 0x1>;
			};

			batadc {
				avg-num = <0x80>;
				channel = <0x0>;
				resistance-ratio = <0x3 0x1>;
			};

			chip_temp {
				channel = <0x5>;
			};

			dcxo_temp {
				avg-num = <0x10>;
				channel = <0xd>;
			};

			hpofs_cal {
				avg-num = <0x100>;
				channel = <0xc>;
			};

			isense {
				avg-num = <0x80>;
				channel = <0x1>;
				resistance-ratio = <0x3 0x1>;
			};

			tsx_temp {
				avg-num = <0x80>;
				channel = <0xb>;
			};

			vbif {
				channel = <0xe>;
				resistance-ratio = <0x1 0x1>;
			};

			vcdt {
				channel = <0x2>;
			};

			vcore_temp {
				channel = <0x6>;
			};

			vproc_temp {
				channel = <0x7>;
			};
		};
	};

	mt6357_gauge {
		alias_name = "mt6357";
		compatible = "mediatek,mt6357_gauge";
		gauge_name = "gauge";
	};

	mt6370_pd_eint {
		linux,phandle = <0xa3>;
		phandle = <0xa3>;
	};

	mt6370_pmu_dts {
		#interrupt-cells = <0x1>;
		interrupt-controller;
		linux,phandle = <0xaf>;
		mt6370,intr_gpio = <0x3d 0x3 0x0>;
		mt6370,intr_gpio_num = <0x3>;
		phandle = <0xaf>;

		bled {
			compatible = "mediatek,mt6370_pmu_bled";
			interrupt-names = "bled_ocp";
			mt,bl_ocp_level = <0x2>;
			mt,bl_ovp_level = <0x3>;
			mt,bled_curr_scale = <0x0>;
			mt,bled_flash_ramp = <0x1>;
			mt,bled_name = "mt6370_pmu_bled";
			mt,bled_ramptime = <0x3>;
			mt,chan_en = <0xf>;
			mt,map_linear;
			mt,max_bled_brightness = <0x200>;
			mt,pwm_avg_cycle = <0x0>;
			mt,pwm_deglitch = <0x1>;
			mt,pwm_fsample = <0x2>;
			mt,pwm_hys = <0x0>;
			mt,pwm_hys_en = <0x1>;
			mt,pwm_lpf_coef = <0x0>;
			mt,use_pwm;
		};

		charger {
			aicr = <0x7a120>;
			charger_name = "primary_chg";
			compatible = "mediatek,mt6370_pmu_charger";
			cv = <0x426030>;
			dc_wdt = <0x3d0900>;
			enable_te;
			enable_wdt;
			ichg = <0x1e8480>;
			ieoc = <0x249f0>;
			interrupt-names = "chg_mivr", "chg_aiclmeasi", "attachi", "ovpctrl_uvp_d_evt", "chg_wdtmri", "chg_vbusov", "chg_tmri", "chg_treg", "dcdti";
			ircmp_resistor = <0x61a8>;
			ircmp_vclamp = <0x7d00>;
			lbp_dt = <0x1>;
			lbp_hys_sel = <0x1>;
			load_switch_name = "primary_load_switch";
			mivr = <0x432380>;
			safety_timer = <0xc>;
		};

		core {
			compatible = "mediatek,mt6370_pmu_core";
			i2cstmr_rst_tmr = <0x0>;
			int_deg = <0x0>;
			int_wdt = <0x0>;
			interrupt-names = "otp", "vdda_ovp", "vdda_uv";
			mrstb_en;
			mrstb_tmr = <0x3>;
		};

		dsv {
			compatible = "mediatek,mt6370_pmu_dsv";
			db_delay = <0x3>;
			db_ext_en = <0x0>;
			db_freq_pm = <0x0>;
			db_periodic_fix = <0x0>;
			db_periodic_mode = <0x0>;
			db_single_pin = <0x0>;
			db_startup = <0x0>;
			db_vbst = <0x1644>;
			db_vneg_20ms = <0x1>;
			db_vneg_disc = <0x0>;
			db_vneg_slew = <0x1>;
			db_vpos_20ms = <0x1>;
			db_vpos_disc = <0x1>;
			db_vpos_slew = <0x1>;
			interrupt-names = "dsv_vneg_ocp", "dsv_vpos_ocp", "dsv_bst_ocp", "dsv_vneg_scp", "dsv_vpos_scp";

			mt6370_dsvn {
				regulator-max-microvolt = <0x5b8d80>;
				regulator-min-microvolt = <0x3d0900>;
				regulator-name = "dsv_neg";
			};

			mt6370_dsvp {
				regulator-max-microvolt = <0x5b8d80>;
				regulator-min-microvolt = <0x3d0900>;
				regulator-name = "dsv_pos";
			};
		};

		ldo {
			compatible = "mediatek,mt6370_pmu_ldo";
			interrupt-names = "ldo_oc";
			ldo_oms = <0x1>;
			ldo_vrc_lt = <0x1>;

			mt6370_ldo {
				regulator-max-microvolt = <0x3d0900>;
				regulator-min-microvolt = <0x186a00>;
				regulator-name = "irtx_ldo";
			};
		};

		mt6370_pmu_fled1 {
			compatible = "mediatek,mt6370_pmu_fled1";
			fled_enable = <0x1>;
			interrupt-names = "fled_lvf", "fled2_short", "fled1_short";
			strobe_cur = <0x124f80>;
			strobe_timeout = <0x960>;
			torch_cur = <0x493e0>;
		};

		mt6370_pmu_fled2 {
			compatible = "mediatek,mt6370_pmu_fled2";
			fled_enable = <0x1>;
			strobe_cur = <0xf4240>;
			strobe_timeout = <0x4b0>;
			torch_cur = <0x30d40>;
		};

		rgbled {
			compatible = "mediatek,mt6370_pmu_rgbled";
			interrupt-names = "isink4_short", "isink3_short", "isink2_short", "isink1_short", "isink4_open", "isink3_open", "isink2_open", "isink1_open";
			mt,led_default_trigger = "cc_mode", "cc_mode", "cc_mode", "none";
			mt,led_name = "mt6370_pmu_led1", "mt6370_pmu_led2", "mt6370_pmu_led3", "mt6370_pmu_led4";
		};
	};

	mt6370_pmu_eint {
		linux,phandle = <0xa2>;
		phandle = <0xa2>;
	};

	mt_charger {
		compatible = "mediatek,mt-charger";
		linux,phandle = <0x9d>;
		phandle = <0x9d>;
	};

	mt_soc_anc_pcm {
		compatible = "mediatek,mt_soc_pcm_anc";
	};

	mt_soc_codec_dummy_name {
		compatible = "mediatek,mt_soc_codec_dummy";
	};

	mt_soc_codec_name {
		compatible = "mediatek,mt_soc_codec_63xx";
		use_hp_depop_flow = <0x0>;
		use_ul_260k = <0x0>;
	};

	mt_soc_dai_name {
		compatible = "mediatek,mt_soc_dai_stub";
	};

	mt_soc_deep_buffer_dl_pcm {
		compatible = "mediatek,mt_soc_pcm_deep_buffer_dl";
	};

	mt_soc_dl1_awb_pcm {
		compatible = "mediatek,mt_soc_pcm_dl1_awb";
	};

	mt_soc_dl1_pcm@11220000 {
		clock-names = "aud_afe_clk", "aud_dac_clk", "aud_dac_predis_clk", "aud_adc_clk", "aud_apll22m_clk", "aud_apll1_tuner_clk", "aud_tml_clk", "aud_infra_clk", "mtkaif_26m_clk", "top_mux_audio", "top_mux_audio_int", "top_sys_pll1_d4", "top_mux_aud_1", "top_apll1_ck", "top_mux_aud_eng1", "top_apll1_d8", "apmixed_apll1", "top_clk26m_clk";
		clocks = <0x41 0x0 0x41 0x4 0x41 0x5 0x41 0x3 0x41 0x1 0x41 0x2 0x41 0x6 0x24 0x2b 0x24 0x33 0x1e 0x6f 0x1e 0x70 0x1e 0x3 0x1e 0x71 0x1e 0x29 0x1e 0x72 0x1e 0x2c 0x42 0x8 0x1f>;
		compatible = "mediatek,mt_soc_pcm_dl1";
		interrupts = <0x0 0x99 0x8>;
		linux,phandle = <0x94>;
		phandle = <0x94>;
		reg = <0x0 0x11220000 0x0 0x1000>;
	};

	mt_soc_dl2_pcm {
		compatible = "mediatek,mt_soc_pcm_dl2";
	};

	mt_soc_dummy_pcm {
		compatible = "mediatek,mt_soc_pcm_dummy";
	};

	mt_soc_fm_i2s_awb_pcm {
		compatible = "mediatek,mt_soc_pcm_fm_i2s_awb";
	};

	mt_soc_fm_i2s_pcm {
		compatible = "mediatek,mt_soc_pcm_fm_i2s";
	};

	mt_soc_fm_mrgtx_pcm {
		compatible = "mediatek,mt_soc_pcm_fmtx";
	};

	mt_soc_hp_impedance_pcm {
		compatible = "mediatek,mt_soc_pcm_hp_impedance";
	};

	mt_soc_i2s0_awb_pcm {
		compatible = "mediatek,mt_soc_pcm_i2s0_awb";
	};

	mt_soc_i2s0_pcm {
		compatible = "mediatek,mt_soc_pcm_dl1_i2s0";
	};

	mt_soc_i2s0dl1_pcm {
		compatible = "mediatek,mt_soc_pcm_dl1_i2s0dl1";
	};

	mt_soc_mrgrx_awb_pcm {
		compatible = "mediatek,mt_soc_pcm_mrgrx_awb";
	};

	mt_soc_mrgrx_pcm {
		compatible = "mediatek,mt_soc_pcm_mrgrx";
	};

	mt_soc_pcm_dl1_scp_spk {
		compatible = "mediatek,mt_soc_pcm_dl1_scp_spk";
	};

	mt_soc_pcm_voice_scp {
		compatible = "mediatek,mt_soc_pcm_voice_scp";
	};

	mt_soc_pcm_voice_ultra {
		compatible = "mediatek,mt_soc_pcm_voice_ultra";
	};

	mt_soc_pcm_voice_usb {
		compatible = "mediatek,mt_soc_pcm_voice_usb";
	};

	mt_soc_pcm_voice_usb_echoref {
		compatible = "mediatek,mt_soc_pcm_voice_usb_echoref";
	};

	mt_soc_routing_dai_name {
		compatible = "mediatek,mt_soc_dai_routing";
	};

	mt_soc_routing_pcm {
		compatible = "mediatek,mt_soc_pcm_routing";
	};

	mt_soc_tdmrx_pcm {
		compatible = "mediatek,mt_soc_tdm_capture";
	};

	mt_soc_ul1_pcm {
		compatible = "mediatek,mt_soc_pcm_capture";
	};

	mt_soc_ul2_pcm {
		compatible = "mediatek,mt_soc_pcm_capture2";
	};

	mt_soc_uldlloopback_pcm {
		compatible = "mediatek,mt_soc_pcm_uldlloopback";
	};

	mt_soc_voice_md1 {
		compatible = "mediatek,mt_soc_pcm_voice_md1";
	};

	mt_soc_voice_md1_bt {
		compatible = "mediatek,mt_soc_pcm_voice_md1_bt";
	};

	mt_soc_voice_md2 {
		compatible = "mediatek,mt_soc_pcm_voice_md2";
	};

	mt_soc_voice_md2_bt {
		compatible = "mediatek,mt_soc_pcm_voice_md2_bt";
	};

	mt_soc_voip_bt_in {
		compatible = "mediatek,mt_soc_pcm_bt_dai";
	};

	mt_soc_voip_bt_out {
		compatible = "mediatek,mt_soc_pcm_dl1_bt";
	};

	mtk-btcvsd-snd@18050000 {
		compatible = "mediatek,mtk-btcvsd-snd";
		interrupts = <0x0 0x10a 0x8>;
		linux,phandle = <0x40>;
		mediatek,infracfg = <0x24>;
		mediatek,offset = <0xf00 0x800 0x140 0x144 0x148>;
		phandle = <0x40>;
		reg = <0x0 0x18050000 0x0 0x1000 0x0 0x18080000 0x0 0x10000>;
	};

	mtkfb@0 {
		compatible = "mediatek,mtkfb";
		linux,phandle = <0x98>;
		phandle = <0x98>;
	};

	nfc {
		compatible = "mediatek,nfc-gpio-v2";
		gpio-irq = <0xa>;
		gpio-irq-std = <0x3d 0xa 0x0>;
		gpio-rst = <0xac>;
		gpio-rst-std = <0x3d 0xac 0x0>;
		linux,phandle = <0x96>;
		phandle = <0x96>;
	};

	nfi@11018000 {
		compatible = "mediatek,nfi";
		reg = <0x0 0x11018000 0x0 0x1000>;
	};

	nfiecc@11019000 {
		compatible = "mediatek,nfiecc";
		reg = <0x0 0x11019000 0x0 0x1000>;
	};

	odm {
		compatible = "simple-bus";
		linux,phandle = <0xa5>;
		phandle = <0xa5>;
	};

	otg_iddig {
		compatible = "mediatek,usb_iddig_bi_eint";
		linux,phandle = <0x75>;
		phandle = <0x75>;
	};

	pd_adapter {
		adapter_name = "pd_adapter";
		compatible = "mediatek,pd_adapter";
		linux,phandle = <0xa0>;
		phandle = <0xa0>;
	};

	pericfg@10003000 {
		#clock-cells = <0x1>;
		compatible = "mediatek,pericfg", "syscon";
		linux,phandle = <0x50>;
		phandle = <0x50>;
		reg = <0x0 0x10003000 0x0 0x1000>;
	};

	pinctrl@1000b000 {
		#gpio-cells = <0x2>;
		#interrupt-cells = <0x4>;
		compatible = "mediatek,mt6765-pinctrl";
		gpio-controller;
		interrupt-controller;
		interrupts = <0x0 0xab 0x4>;
		linux,phandle = <0x3d>;
		mediatek,pctl-regmap = <0x12 0x13 0x14 0x15 0x16 0x17 0x18 0x19>;
		phandle = <0x3d>;
		pins-are-numbered;
		reg = <0x0 0x1000b000 0x0 0x1000>;

		msdc0@default {
			linux,phandle = <0x33>;
			phandle = <0x33>;

			pins_clk {
				drive-strength = [03];
			};

			pins_cmd {
				drive-strength = [03];
			};

			pins_dat {
				drive-strength = [03];
			};

			pins_ds {
				drive-strength = [03];
			};

			pins_rst {
				drive-strength = [03];
			};
		};

		msdc0@hs200 {
			linux,phandle = <0x35>;
			phandle = <0x35>;

			pins_clk {
				drive-strength = [04];
			};

			pins_cmd {
				drive-strength = [03];
			};

			pins_dat {
				drive-strength = [04];
			};

			pins_ds {
				drive-strength = [04];
			};

			pins_rst {
				drive-strength = [03];
			};
		};

		msdc0@hs400 {
			linux,phandle = <0x34>;
			phandle = <0x34>;

			pins_clk {
				drive-strength = [04];
			};

			pins_cmd {
				drive-strength = [03];
			};

			pins_dat {
				drive-strength = [04];
			};

			pins_ds {
				drive-strength = [04];
			};

			pins_rst {
				drive-strength = [03];
			};
		};

		msdc0@register_default {
			cmd_edge = [00];
			linux,phandle = <0x36>;
			phandle = <0x36>;
			rdata_edge = [00];
			wdata_edge = [00];
		};

		msdc1@ddr50 {
			linux,phandle = <0x3b>;
			phandle = <0x3b>;

			pins_clk {
				drive-strength = [03];
			};

			pins_cmd {
				drive-strength = [03];
			};

			pins_dat {
				drive-strength = [03];
			};
		};

		msdc1@default {
			linux,phandle = <0x38>;
			phandle = <0x38>;

			pins_clk {
				drive-strength = [03];
			};

			pins_cmd {
				drive-strength = [03];
			};

			pins_dat {
				drive-strength = [03];
			};
		};

		msdc1@register_default {
			cmd_edge = [00];
			linux,phandle = <0x3c>;
			phandle = <0x3c>;
			rdata_edge = [00];
			wdata_edge = [00];
		};

		msdc1@sdr104 {
			linux,phandle = <0x39>;
			phandle = <0x39>;

			pins_clk {
				drive-strength = [03];
			};

			pins_cmd {
				drive-strength = [03];
			};

			pins_dat {
				drive-strength = [03];
			};
		};

		msdc1@sdr50 {
			linux,phandle = <0x3a>;
			phandle = <0x3a>;

			pins_clk {
				drive-strength = [03];
			};

			pins_cmd {
				drive-strength = [03];
			};

			pins_dat {
				drive-strength = [03];
			};
		};

		msdc3@default {
			linux,phandle = <0x54>;
			phandle = <0x54>;

			pins_clk {
				drive-strength = [04];
			};

			pins_cmd {
				drive-strength = [04];
			};

			pins_dat {
				drive-strength = [04];
			};
		};

		msdc3@register_default {
			cmd_edge = [01];
			linux,phandle = <0x55>;
			phandle = <0x55>;
			rdata_edge = [01];
			wdata_edge = [01];
		};
	};

	plat_sram_flag@0011db00 {
		compatible = "mediatek,plat_sram_flag";
		reg = <0x0 0x10e5f0 0x0 0x10>;
	};

	pmic_clock_buffer_ctrl {
		compatible = "mediatek,pmic_clock_buffer";
		linux,phandle = <0xa6>;
		mediatek,clkbuf-config = <0x2 0x1 0x1 0x2 0x0 0x0 0x0>;
		mediatek,clkbuf-driving-current = <0x1 0x1 0x1 0x1 0x1 0x1 0x1>;
		mediatek,clkbuf-quantity = <0x7>;
		phandle = <0xa6>;
	};

	pmu {
		compatible = "arm,armv8-pmuv3";
		interrupt-parent = <0x11>;
		interrupts = <0x1 0x7 0x8>;
	};

	psci {
		compatible = "arm,psci-1.0";
		method = "smc";
	};

	pseudo_m4u {
		compatible = "mediatek,mt-pseudo_m4u";
		iommus = <0x4c 0x2>;
	};

	pseudo_m4u-larb0 {
		compatible = "mediatek,mt-pseudo_m4u-port";
		iommus = <0x4c 0x0 0x4c 0x1 0x4c 0x2 0x4c 0x3 0x4c 0x4 0x4c 0x5 0x4c 0x6 0x4c 0x7>;
		mediatek,larbid = <0x0>;
	};

	pseudo_m4u-larb1 {
		compatible = "mediatek,mt-pseudo_m4u-port";
		iommus = <0x4c 0x20 0x4c 0x21>;
		mediatek,larbid = <0x1>;
	};

	pseudo_m4u-larb2 {
		compatible = "mediatek,mt-pseudo_m4u-port";
		iommus = <0x4c 0x40 0x4c 0x41>;
		mediatek,larbid = <0x2>;
	};

	pseudo_m4u-larb3 {
		compatible = "mediatek,mt-pseudo_m4u-port";
		iommus = <0x4c 0x60 0x4c 0x61>;
		mediatek,larbid = <0x3>;
	};

	pwm@11006000 {
		clock-names = "PWM1-main", "PWM2-main", "PWM3-main", "PWM4-main", "PWM5-main", "PWM6-main", "PWM-HCLK-main", "PWM-main";
		clocks = <0x24 0x10 0x24 0x11 0x24 0x12 0x24 0x13 0x24 0x14 0x24 0x30 0x24 0xf 0x24 0x15>;
		compatible = "mediatek,pwm";
		interrupts = <0x0 0x4d 0x8>;
		linux,phandle = <0x88>;
		phandle = <0x88>;
		reg = <0x0 0x11006000 0x0 0x10000>;
	};

	pwrap@1000d000 {
		compatible = "mediatek,pwrap";
		interrupts = <0x0 0xb3 0x4>;
		reg = <0x0 0x1000d000 0x0 0x1000>;
	};

	radio_md_cfg {
		compatible = "mediatek,radio_md_cfg";
		linux,phandle = <0xad>;
		phandle = <0xad>;
	};

	reserved-memory {
		#address-cells = <0x2>;
		#size-cells = <0x2>;
		linux,phandle = <0x4e>;
		phandle = <0x4e>;
		ranges;

		consys-reserve-memory {
			alignment = <0x0 0x1000000>;
			alloc-ranges = <0x0 0x40000000 0x0 0x80000000>;
			compatible = "mediatek,consys-reserve-memory";
			no-map;
			size = <0x0 0x400000>;
		};

		reserve-memory-scp_share {
			alignment = <0x0 0x1000000>;
			alloc-ranges = <0x0 0x40000000 0x0 0x50000000>;
			compatible = "mediatek,reserve-memory-scp_share";
			no-map;
			size = <0x0 0x300000>;
		};

		reserve-memory-sspm_share {
			alignment = <0x0 0x10000>;
			alloc-ranges = <0x0 0x40000000 0x0 0x60000000>;
			compatible = "mediatek,reserve-memory-sspm_share";
			no-map;
			size = <0x0 0x510000>;
			status = "okay";
		};

		soter-shared-mem {
			alignment = <0x0 0x2000000>;
			alloc-ranges = <0x0 0x40000000 0x0 0x50000000>;
			compatible = "microtrust,shared_mem";
			no-map;
			size = <0x0 0x2000000>;
		};

		wifi-reserve-memory {
			alignment = <0x0 0x1000000>;
			alloc-ranges = <0x0 0x40000000 0x0 0x80000000>;
			compatible = "mediatek,wifi-reserve-memory";
			no-map;
			size = <0x0 0x300000>;
		};

		zmc-default {
			alignment = <0x0 0x10000000>;
			alloc-ranges = <0x0 0xc0000000 0x1 0x80000000>;
			compatible = "mediatek,zone_movable_cma";
			size = <0x0 0xffc00000>;
		};
	};

	rt-pd-manager {
		compatible = "mediatek,rt-pd-manager";
	};

	rt9465_slave_chr {
		compatible = "richtek,rt9465";
		linux,phandle = <0xa1>;
		phandle = <0xa1>;
		status = "disabled";
	};

	scp@10500000 {
		compatible = "mediatek,scp";
		core_1 = "enable";
		interrupts = <0x0 0xc0 0x4>;
		reg = <0x0 0x10500000 0x0 0x40000 0x0 0x105c0000 0x0 0x3000 0x0 0x105c4000 0x0 0x1000 0x0 0x105d4000 0x0 0x6000>;
		scp_sramSize = <0x40000>;
		status = "okay";
	};

	scp_dvfs {
		clock-names = "clk_mux", "clk_pll_0", "clk_pll_1", "clk_pll_2", "clk_pll_3", "clk_pll_4", "clk_pll_5", "clk_pll_6";
		clocks = <0x1e 0x63 0x1f 0x1e 0xe 0x1e 0x1a 0x1e 0x2 0x1e 0x17 0x1e 0x6 0x1e 0x19>;
		compatible = "mediatek,scp_dvfs";
	};

	scpsys@10001000 {
		#clock-cells = <0x1>;
		compatible = "mediatek,scpsys", "syscon";
		linux,phandle = <0x25>;
		phandle = <0x25>;
		reg = <0x0 0x10001000 0x0 0x1000 0x0 0x10006000 0x0 0x1000 0x0 0x14002000 0x0 0x1000 0x0 0x1020e000 0x0 0x1000 0x0 0x18004000 0x0 0x1000 0x0 0x18002000 0x0 0x1000>;
	};

	security_ao@1001a000 {
		compatible = "mediatek,security_ao";
		reg = <0x0 0x1001a000 0x0 0x1000>;
	};

	seninf1@1a040000 {
		compatible = "mediatek,seninf1";
		reg = <0x0 0x1a040000 0x0 0x1000>;
	};

	seninf2@1a041000 {
		compatible = "mediatek,seninf2";
		reg = <0x0 0x1a041000 0x0 0x1000>;
	};

	seninf3@1a042000 {
		compatible = "mediatek,seninf3";
		reg = <0x0 0x1a042000 0x0 0x1000>;
	};

	seninf4@1a043000 {
		compatible = "mediatek,seninf4";
		reg = <0x0 0x1a043000 0x0 0x1000>;
	};

	serial@11020000 {
		clock-names = "baud", "bus";
		clocks = <0x1f 0x24 0x16>;
		compatible = "mediatek,mt6758-uart", "mediatek,mt6577-uart";
		dma-names = "tx", "rx";
		dmas = <0x32 0x0 0x32 0x1>;
		interrupts = <0x0 0x5b 0x8>;
		linux,phandle = <0x7e>;
		phandle = <0x7e>;
		reg = <0x0 0x11002000 0x0 0x1000>;
	};

	serial@11030000 {
		clock-names = "baud", "bus";
		clocks = <0x1f 0x24 0x17>;
		compatible = "mediatek,mt6758-uart", "mediatek,mt6577-uart";
		interrupts = <0x0 0x5c 0x8>;
		linux,phandle = <0x7f>;
		phandle = <0x7f>;
		reg = <0x0 0x11003000 0x0 0x1000>;
	};

	sleep@10006000 {
		compatible = "mediatek,sleep";
		interrupts = <0x0 0xb5 0x8>;
		reg = <0x0 0x10006000 0x0 0x1000>;
		wakeup-source = <0x1a 0x0 0x4 0x1b 0x1 0x20 0x1c 0x3 0x2000000>;
	};

	sleep_reg_md@1000f000 {
		compatible = "mediatek,sleep_reg_md";
		reg = <0x0 0x1000f000 0x0 0x1000>;
	};

	smart_pa {
		linux,phandle = <0xaa>;
		phandle = <0xaa>;
	};

	smi_common@14002000 {
		clock-names = "mtcmos-mm", "smi-common-gals-comm0", "smi-common-gals-comm1", "smi-common", "mmdvfs_clk_mm_sel_ck", "mmdvfs_clk_mmpll_ck", "mmdvfs_clk_univpll1_d2_ck", "mmdvfs_clk_mmpll_d2_ck";
		clocks = <0x25 0x3 0x26 0x15 0x26 0x16 0x26 0x13 0x1e 0x62 0x1e 0x21 0x1e 0x17 0x1e 0x22>;
		compatible = "mediatek,smi_common";
		larbs = <0x20 0x21 0x22 0x23>;
		mmsys_config = <0x26>;
		nr_larbs = <0x4>;
		reg = <0x0 0x14002000 0x0 0x1000>;
	};

	smi_larb0@14003000 {
		cell-index = <0x0>;
		clock-names = "mtcmos-mm", "mm-larb0";
		clocks = <0x25 0x3 0x26 0x14>;
		compatible = "mediatek,smi_larb0", "mediatek,smi_larb";
		linux,phandle = <0x20>;
		phandle = <0x20>;
		reg = <0x0 0x14003000 0x0 0x1000>;
	};

	smi_larb1@17010000 {
		cell-index = <0x1>;
		clock-names = "mtcmos-vcodec", "venc-larb1";
		clocks = <0x25 0xa 0x45 0x1>;
		compatible = "mediatek,smi_larb1", "mediatek,smi_larb";
		linux,phandle = <0x21>;
		phandle = <0x21>;
		reg = <0x0 0x17010000 0x0 0x1000>;
	};

	smi_larb2@15021000 {
		cell-index = <0x2>;
		clock-names = "mtcmos-isp", "gals-img2mm", "img-larb2";
		clocks = <0x25 0x5 0x26 0x18 0x43 0x0>;
		compatible = "mediatek,smi_larb2", "mediatek,smi_larb";
		linux,phandle = <0x22>;
		phandle = <0x22>;
		reg = <0x0 0x15021000 0x0 0x1000>;
	};

	smi_larb3@1a002000 {
		cell-index = <0x3>;
		clock-names = "mtcmos-cam", "gals-cam2mm", "cam-larb3";
		clocks = <0x25 0x9 0x26 0x19 0x44 0x0>;
		compatible = "mediatek,smi_larb3", "mediatek,smi_larb";
		linux,phandle = <0x23>;
		phandle = <0x23>;
		reg = <0x0 0x1a002000 0x0 0x1000>;
	};

	soc {
		compatible = "dbmdx,dbmdx-soundcard";
		linux,phandle = <0x7a>;
		phandle = <0x7a>;
	};

	spi@1100a000 {
		clock-names = "parent-clk", "sel-clk", "spi-clk";
		clocks = <0x1e 0xb 0x1e 0x6b 0x24 0x1b>;
		compatible = "mediatek,mt6765-spi";
		interrupts = <0x0 0x76 0x8>;
		linux,phandle = <0x89>;
		mediatek,pad-select = <0x0>;
		phandle = <0x89>;
		reg = <0x0 0x1100a000 0x0 0x1000>;
	};

	spi@11010000 {
		clock-names = "parent-clk", "sel-clk", "spi-clk";
		clocks = <0x1e 0xb 0x1e 0x6b 0x24 0x34>;
		compatible = "mediatek,mt6765-spi";
		interrupts = <0x0 0x7a 0x8>;
		linux,phandle = <0x8a>;
		mediatek,pad-select = <0x0>;
		phandle = <0x8a>;
		reg = <0x0 0x11010000 0x0 0x1000>;
	};

	spi@11012000 {
		clock-names = "parent-clk", "sel-clk", "spi-clk";
		clocks = <0x1e 0xb 0x1e 0x6b 0x24 0x37>;
		compatible = "mediatek,mt6765-spi";
		interrupts = <0x0 0x80 0x8>;
		linux,phandle = <0x8b>;
		mediatek,pad-select = <0x0>;
		phandle = <0x8b>;
		reg = <0x0 0x11012000 0x0 0x1000>;
	};

	spi@11013000 {
		clock-names = "parent-clk", "sel-clk", "spi-clk";
		clocks = <0x1e 0xb 0x1e 0x6b 0x24 0x38>;
		compatible = "mediatek,mt6765-spi";
		interrupts = <0x0 0x81 0x8>;
		linux,phandle = <0x8c>;
		mediatek,pad-select = <0x0>;
		phandle = <0x8c>;
		reg = <0x0 0x11013000 0x0 0x1000>;
	};

	spi@11014000 {
		clock-names = "parent-clk", "sel-clk", "spi-clk";
		clocks = <0x1e 0xb 0x1e 0x6b 0x24 0x41>;
		compatible = "mediatek,mt6765-spi";
		interrupts = <0x0 0x5f 0x8>;
		linux,phandle = <0x8d>;
		mediatek,pad-select = <0x0>;
		phandle = <0x8d>;
		reg = <0x0 0x11014000 0x0 0x1000>;
	};

	spi@11015000 {
		clock-names = "parent-clk", "sel-clk", "spi-clk";
		clocks = <0x1e 0xb 0x1e 0x6b 0x24 0x42>;
		compatible = "mediatek,mt6765-spi";
		interrupts = <0x0 0x60 0x8>;
		linux,phandle = <0x8e>;
		mediatek,pad-select = <0x0>;
		phandle = <0x8e>;
		reg = <0x0 0x11015000 0x0 0x1000>;
	};

	sramrom@10214000 {
		compatible = "mediatek,sramrom";
		reg = <0x0 0x10214000 0x0 0x1000>;
	};

	sspm@10440000 {
		compatible = "mediatek,sspm";
		interrupt-names = "ipc", "mbox0", "mbox1", "mbox2", "mbox3", "mbox4";
		interrupts = <0x0 0xca 0x4 0x0 0xcd 0x4 0x0 0xce 0x4 0x0 0xcf 0x4 0x0 0xd0 0x4 0x0 0xd1 0x4>;
		reg = <0x0 0x10440000 0x0 0x10000 0x0 0x10450000 0x0 0x100 0x0 0x10451000 0x0 0x8 0x0 0x10460000 0x0 0x100 0x0 0x10461000 0x0 0x8 0x0 0x10470000 0x0 0x100 0x0 0x10471000 0x0 0x8 0x0 0x10480000 0x0 0x100 0x0 0x10481000 0x0 0x8 0x0 0x10490000 0x0 0x100 0x0 0x10491000 0x0 0x8>;
		reg-names = "cfgreg", "mbox0_base", "mbox0_ctrl", "mbox1_base", "mbox1_ctrl", "mbox2_base", "mbox2_ctrl", "mbox3_base", "mbox3_ctrl", "mbox4_base", "mbox4_ctrl";
	};

	swtp {
		compatible = "mediatek, swtp-eint";
		linux,phandle = <0x53>;
		phandle = <0x53>;
	};

	sys_cirq@10204000 {
		compatible = "mediatek,sys_cirq";
		interrupts = <0x0 0x118 0x8>;
		mediatek,cirq_num = <0xd1>;
		mediatek,spi_start_offset = <0x48>;
		reg = <0x0 0x10204000 0x0 0x1000>;
	};

	sys_timer@10017000 {
		compatible = "mediatek,sys_timer";
		interrupts = <0x0 0xc2 0x4>;
		reg = <0x0 0x10017000 0x0 0x1000>;
		reg-names = "sys_timer_base";
	};

	syscfg_pctl_0@10005000 {
		compatible = "mediatek,mt6765-pctl-0-syscfg", "syscon";
		linux,phandle = <0x12>;
		phandle = <0x12>;
		reg = <0x0 0x10005000 0x0 0x1000>;
	};

	syscfg_pctl_1@0x10002000 {
		compatible = "mediatek,mt6765-pctl-1-syscfg", "syscon";
		linux,phandle = <0x13>;
		phandle = <0x13>;
		reg = <0x0 0x10002000 0x0 0x1000>;
	};

	syscfg_pctl_2@0x10002200 {
		compatible = "mediatek,mt6765-pctl-2-syscfg", "syscon";
		linux,phandle = <0x14>;
		phandle = <0x14>;
		reg = <0x0 0x10002200 0x0 0x1000>;
	};

	syscfg_pctl_3@0x10002400 {
		compatible = "mediatek,mt6765-pctl-3-syscfg", "syscon";
		linux,phandle = <0x15>;
		phandle = <0x15>;
		reg = <0x0 0x10002400 0x0 0x1000>;
	};

	syscfg_pctl_4@0x10002600 {
		compatible = "mediatek,mt6765-pctl-4-syscfg", "syscon";
		linux,phandle = <0x16>;
		phandle = <0x16>;
		reg = <0x0 0x10002600 0x0 0x1000>;
	};

	syscfg_pctl_5@0x10002800 {
		compatible = "mediatek,mt6765-pctl-5-syscfg", "syscon";
		linux,phandle = <0x17>;
		phandle = <0x17>;
		reg = <0x0 0x10002800 0x0 0x1000>;
	};

	syscfg_pctl_6@0x10002a00 {
		compatible = "mediatek,mt6765-pctl-6-syscfg", "syscon";
		linux,phandle = <0x18>;
		phandle = <0x18>;
		reg = <0x0 0x10002a00 0x0 0x1000>;
	};

	syscfg_pctl_7@0x10002c00 {
		compatible = "mediatek,mt6765-pctl-7-syscfg", "syscon";
		linux,phandle = <0x19>;
		phandle = <0x19>;
		reg = <0x0 0x10002c00 0x0 0x1000>;
	};

	therm_ctrl@1100b000 {
		clock-names = "therm-main";
		clocks = <0x24 0xa>;
		compatible = "mediatek,therm_ctrl";
		interrupts = <0x0 0x4e 0x8>;
		reg = <0x0 0x1100b000 0x0 0x1000>;
	};

	timer {
		clock-frequency = <0xc65d40>;
		compatible = "arm,armv8-timer";
		interrupt-parent = <0x11>;
		interrupts = <0x1 0xd 0x8 0x1 0xe 0x8 0x1 0xb 0x8 0x1 0xa 0x8>;
	};

	tkcore {
		compatible = "trustkernel,tkcore";
		interrupts = <0x0 0xf8 0x1>;
	};

	topckgen@10000000 {
		#clock-cells = <0x1>;
		compatible = "mediatek,topckgen", "syscon";
		linux,phandle = <0x1e>;
		phandle = <0x1e>;
		reg = <0x0 0x10000000 0x0 0x1000>;
	};

	topckgen_ao@1001b000 {
		compatible = "mediatek,topckgen_ao";
		reg = <0x0 0x1001b000 0x0 0x1000>;
	};

	topmisc@10011000 {
		compatible = "mediatek,topmisc";
		reg = <0x0 0x10011000 0x0 0x1000>;
	};

	toprgu@10007000 {
		compatible = "mediatek,mt6765-toprgu";
		interrupts = <0x0 0x8b 0x0>;
		reg = <0x0 0x10007000 0x0 0x1000>;
	};

	touch {
		compatible = "mediatek,touch";
		linux,phandle = <0x77>;
		phandle = <0x77>;
	};

	trng@1020f000 {
		compatible = "mediatek,trng";
		interrupts = <0x0 0xa1 0x8>;
		reg = <0x0 0x1020f000 0x0 0x1000>;
	};

	type_c_port0 {
		linux,phandle = <0xb0>;
		mt-tcpc,name = "type_c_port0";
		mt-tcpc,role_def = <0x4>;
		mt-tcpc,rp_level = <0x0>;
		mt-tcpc,vconn_supply = <0x1>;
		mt6370pd,intr_gpio = <0x3d 0x18 0x0>;
		mt6370pd,intr_gpio_num = <0x18>;
		phandle = <0xb0>;
		tcpc-dual,supported_modes = <0x0>;

		dpm_caps {
			attemp_discover_cable;
			attemp_discover_id;
			attemp_enter_dp_mode;
			dr_check = <0x0>;
			local_dr_data;
			local_dr_power;
			local_no_suspend;
			local_usb_comm;
			local_vconn_supply;
			pr_check = <0x0>;
			pr_check_gp_source;
		};

		pd-data {
			bat,nr = <0x1>;
			pd,charging_policy = <0x21>;
			pd,country_nr = <0x0>;
			pd,id-vdo-data = <0xd10029cf 0x0 0x10000>;
			pd,id-vdo-size = <0x3>;
			pd,mfrs = "RichtekTCPC";
			pd,pid = <0x5081>;
			pd,sink-pdo-data = <0x190c8 0xc0761e3c>;
			pd,sink-pdo-size = <0x2>;
			pd,source-cap-ext = <0x171129cf 0x0 0x102 0x0 0x0 0x2000000>;
			pd,source-pdo-data = <0x19032>;
			pd,source-pdo-size = <0x1>;
			pd,vid = <0x29cf>;

			bat-info0 {
				bat,design_cap = <0xbb8>;
				bat,mfrs = "bat1";
				bat,pid = <0x1711>;
				bat,vid = <0x29cf>;
			};
		};
	};

	usb0@11200000 {
		clock-names = "usb0", "usb0_clk_top_sel", "usb0_clk_univpll3_d4";
		clocks = <0x24 0x8 0x1e 0x76 0x1e 0x20>;
		compatible = "mediatek,mt6765-usb20";
		interrupts = <0x0 0x49 0x8>;
		mode = <0x2>;
		multipoint = <0x1>;
		num_eps = <0x10>;
		reg = <0x0 0x11200000 0x0 0x10000 0x0 0x11cc0000 0x0 0x10000>;
	};

	usb1p_sif@11210000 {
		compatible = "mediatek,usb1p_sif";
		reg = <0x0 0x11210000 0x0 0x10000>;
	};

	usb_sif@11210000 {
		compatible = "mediatek,usb_sif";
		reg = <0x0 0x11210000 0x0 0x10000>;
	};

	utos {
		compatible = "microtrust,utos";
		interrupts = <0x0 0xf9 0x1 0x0 0xfa 0x1>;
	};

	utos_tester {
		compatible = "microtrust,tester-v1";
	};

	vdec@17040000 {
		compatible = "mediatek,vdec";
		interrupts = <0x0 0xe9 0x8>;
		reg = <0x0 0x17040000 0x0 0x10000>;
	};

	venc@17020000 {
		compatible = "mediatek,venc";
		interrupts = <0x0 0xe6 0x8>;
		reg = <0x0 0x17020000 0x0 0x10000>;
	};

	venc_gcon@17000000 {
		#clock-cells = <0x1>;
		clock-names = "MT_SCP_SYS_DIS", "MT_SCP_SYS_VCODEC", "MT_CG_MM_SMI_COMM0", "MT_CG_MM_SMI_COMM1", "MT_CG_MM_SMI_COMMON", "MT_CG_VDEC", "MT_CG_VENC";
		clocks = <0x25 0x3 0x25 0xa 0x26 0x15 0x26 0x16 0x26 0x13 0x45 0x3 0x45 0x1>;
		compatible = "mediatek,venc_gcon", "syscon";
		linux,phandle = <0x45>;
		phandle = <0x45>;
		reg = <0x0 0x17000000 0x0 0x10000>;
	};

	venc_jpg@17030000 {
		clock-names = "MT_CG_VENC_JPGENC";
		clocks = <0x45 0x2>;
		compatible = "mediatek,venc_jpg";
		interrupts = <0x0 0xe8 0x8>;
		reg = <0x0 0x17030000 0x0 0x10000>;
	};

	wifi@18000000 {
		compatible = "mediatek,wifi";
		interrupts = <0x0 0x10c 0x8>;
		reg = <0x0 0x18000000 0x0 0x100000>;
	};
};
